## CMakeLists.txt
```
cmake_minimum_required(VERSION 3.20.0)

find_package(Zephyr REQUIRED HINTS $ENV{ZEPHYR_BASE})
project(ai_bms LANGUAGES C CXX)

set(NO_THREADSAFE_STATICS $<TARGET_PROPERTY:compiler-cpp,no_threadsafe_statics>)
zephyr_compile_options($<$<COMPILE_LANGUAGE:CXX>:${NO_THREADSAFE_STATICS}>)

target_sources(app PRIVATE
    src/main.c
    src/cmd_bms.c
    src/cycles_db.cpp
    src/tflm_bms.cpp
    src/model.cpp
)
```

## prj.conf
```kconfig
# --- C++ + TFLM ---
CONFIG_CPP=y
CONFIG_STD_CPP17=y
CONFIG_TENSORFLOW_LITE_MICRO=y
CONFIG_TENSORFLOW_LITE_MICRO_CMSIS_NN_KERNELS=y
CONFIG_REQUIRES_FLOAT_PRINTF=y
CONFIG_FPU=y
CONFIG_MAIN_STACK_SIZE=4096

CONFIG_GPIO=y

CONFIG_LOG=y
CONFIG_LOG_MODE_DEFERRED=y
CONFIG_LOG_BUFFER_SIZE=2048

CONFIG_SHELL=y
CONFIG_SHELL_BACKEND_SERIAL=y
CONFIG_SHELL_PROMPT_UART="g474> "
CONFIG_SHELL_HISTORY=y
CONFIG_SHELL_TAB=y
CONFIG_SHELL_TAB_AUTOCOMPLETION=y
CONFIG_SHELL_STACK_SIZE=4096

CONFIG_KERNEL_SHELL=y
CONFIG_DEVICE_SHELL=y
CONFIG_THREAD_MONITOR=y
CONFIG_THREAD_NAME=y
CONFIG_THREAD_STACK_INFO=y
CONFIG_INIT_STACKS=y
```

## src/main.c
```c
/*
 * ai_bms — battery-cycle anomaly detection demo.
 *
 * Boots TFLM, then idles. Embedded discharge cycles from NASA PCoE B0018
 * (a cell the AE never trained on) can be scored from the shell with
 * `bms scan` or `bms cycle aged`.
 */

#include <zephyr/kernel.h>
#include <zephyr/drivers/gpio.h>
#include <zephyr/logging/log.h>

#include "tflm_bms.h"

LOG_MODULE_REGISTER(ai_bms, LOG_LEVEL_INF);

#define LED0_NODE DT_ALIAS(led0)
static const struct gpio_dt_spec led = GPIO_DT_SPEC_GET(LED0_NODE, gpios);

int main(void)
{
	int rc = tflm_bms_init();
	if (rc != 0) {
		LOG_ERR("TFLM init failed: %d", rc);
		return rc;
	}
	LOG_INF("ai_bms up — try `bms list`, `bms scan`, `bms cycle aged`");

	if (!gpio_is_ready_dt(&led)) {
		return 0;
	}
	gpio_pin_configure_dt(&led, GPIO_OUTPUT_INACTIVE);

	while (1) {
		gpio_pin_toggle_dt(&led);
		k_msleep(1000);
	}
	return 0;
}
```

## src/cmd_bms.c
```c
/*
 * Shell command tree: `bms ...`
 *
 *   bms list                  — list embedded sample cycles
 *   bms info                  — model + threshold + arena info
 *   bms cycle <name>          — score one of the embedded cycles (early/mid/aged)
 *   bms scan                  — run all embedded cycles, table of scores
 *   bms bench [iterations]    — inference latency
 *   bms threshold [value]     — show / set advisory warning threshold
 *
 * All cycles use int8-quantized voltage curves trained on NASA PCoE
 * B0005/B0006/B0007 healthy data; the embedded cycles are from B0018,
 * which the AE never saw during training.
 */

#include <zephyr/kernel.h>
#include <zephyr/shell/shell.h>
#include <zephyr/sys/util.h>
#include <stdlib.h>
#include <string.h>

#include "tflm_bms.h"
#include "cycles_db.h"

static float s_threshold = 0.005f;   /* tune for the trained model */

static const struct bms_cycle *find_cycle(const char *name)
{
	for (unsigned int i = 0; i < g_cycle_count; ++i) {
		if (!strcmp(g_cycles[i].name, name)) {
			return &g_cycles[i];
		}
	}
	return NULL;
}

static int cmd_list(const struct shell *sh, size_t argc, char **argv)
{
	ARG_UNUSED(argc); ARG_UNUSED(argv);
	shell_print(sh, "%-7s %-7s %-5s %s",
		    "name", "cell", "idx", "capacity");
	for (unsigned int i = 0; i < g_cycle_count; ++i) {
		const struct bms_cycle *c = &g_cycles[i];
		shell_print(sh, "%-7s %-7s %-5u %.4f Ah",
			    c->name, c->cell, c->index, (double)c->capacity_ah);
	}
	return 0;
}

static int cmd_info(const struct shell *sh, size_t argc, char **argv)
{
	ARG_UNUSED(argc); ARG_UNUSED(argv);
	shell_print(sh, "Model      : autoencoder (int8) trained on NASA PCoE");
	shell_print(sh, "Trained on : B0005, B0006, B0007 healthy discharge cycles");
	shell_print(sh, "Holdout    : B0018 — embedded cycles all from this cell");
	shell_print(sh, "Cycles     : %u embedded", g_cycle_count);
	shell_print(sh, "Arena      : %u bytes", tflm_bms_arena_size());
	shell_print(sh, "Threshold  : %.5f", (double)s_threshold);
	return 0;
}

static int score_cycle(const struct shell *sh, const struct bms_cycle *c)
{
	float score;
	int rc = tflm_bms_score(c->voltage, &score);
	if (rc != 0) {
		shell_error(sh, "inference failed: %d", rc);
		return rc;
	}
	const char *flag = (score > s_threshold) ? " ★ ANOMALY" : "";
	shell_print(sh, "%-7s cap=%.3f Ah  score=%.5f%s",
		    c->name, (double)c->capacity_ah, (double)score, flag);
	return 0;
}

static int cmd_cycle(const struct shell *sh, size_t argc, char **argv)
{
	if (argc != 2) {
		shell_error(sh, "usage: bms cycle <name>");
		shell_error(sh, "       valid names from `bms list`");
		return -EINVAL;
	}
	const struct bms_cycle *c = find_cycle(argv[1]);
	if (!c) {
		shell_error(sh, "unknown cycle '%s' (try `bms list`)", argv[1]);
		return -EINVAL;
	}
	return score_cycle(sh, c);
}

static int cmd_scan(const struct shell *sh, size_t argc, char **argv)
{
	ARG_UNUSED(argc); ARG_UNUSED(argv);
	shell_print(sh, "Scanning all embedded cycles (threshold=%.5f):",
		    (double)s_threshold);
	for (unsigned int i = 0; i < g_cycle_count; ++i) {
		score_cycle(sh, &g_cycles[i]);
	}
	return 0;
}

static int cmd_bench(const struct shell *sh, size_t argc, char **argv)
{
	uint32_t n = 1000;
	if (argc == 2) {
		n = (uint32_t)strtoul(argv[1], NULL, 10);
		if (n == 0) { n = 1000; }
	}
	if (g_cycle_count == 0) {
		shell_error(sh, "no cycles embedded");
		return -ENODATA;
	}
	const float *window = g_cycles[0].voltage;
	float score;

	for (int i = 0; i < 4; ++i) {
		tflm_bms_score(window, &score);
	}

	uint32_t cyc_per_us = sys_clock_hw_cycles_per_sec() / 1000000U;
	uint32_t min_cyc = UINT32_MAX, max_cyc = 0;
	uint64_t total = 0;

	for (uint32_t i = 0; i < n; ++i) {
		uint32_t t0 = k_cycle_get_32();
		tflm_bms_score(window, &score);
		uint32_t dt = k_cycle_get_32() - t0;
		total += dt;
		if (dt < min_cyc) { min_cyc = dt; }
		if (dt > max_cyc) { max_cyc = dt; }
	}
	uint32_t avg = (uint32_t)(total / n);
	shell_print(sh, "iterations : %u", n);
	shell_print(sh, "avg        : %u cycles  (%u.%03u us)",
		    avg, avg / cyc_per_us, (avg * 1000U / cyc_per_us) % 1000U);
	shell_print(sh, "min        : %u cycles  (%u.%03u us)",
		    min_cyc, min_cyc / cyc_per_us, (min_cyc * 1000U / cyc_per_us) % 1000U);
	shell_print(sh, "max        : %u cycles  (%u.%03u us)",
		    max_cyc, max_cyc / cyc_per_us, (max_cyc * 1000U / cyc_per_us) % 1000U);
	shell_print(sh, "throughput : ~%u inf/sec",
		    (uint32_t)(sys_clock_hw_cycles_per_sec() / avg));
	return 0;
}

static int cmd_threshold(const struct shell *sh, size_t argc, char **argv)
{
	if (argc == 1) {
		shell_print(sh, "threshold: %.5f", (double)s_threshold);
		return 0;
	}
	float v = strtof(argv[1], NULL);
	if (v <= 0.0f) {
		shell_error(sh, "threshold must be > 0");
		return -EINVAL;
	}
	s_threshold = v;
	shell_print(sh, "threshold = %.5f", (double)s_threshold);
	return 0;
}

SHELL_STATIC_SUBCMD_SET_CREATE(sub_bms,
	SHELL_CMD(list,       NULL, "List embedded sample cycles",      cmd_list),
	SHELL_CMD(info,       NULL, "Model + arena + threshold info",   cmd_info),
	SHELL_CMD_ARG(cycle,  NULL, "Score one cycle: bms cycle <name>",
		      cmd_cycle, 2, 0),
	SHELL_CMD(scan,       NULL, "Score every embedded cycle",       cmd_scan),
	SHELL_CMD_ARG(bench,  NULL, "Inference latency [iterations]",
		      cmd_bench, 1, 1),
	SHELL_CMD_ARG(threshold, NULL,
		      "Show or set anomaly threshold",
		      cmd_threshold, 1, 1),
	SHELL_SUBCMD_SET_END
);

SHELL_CMD_REGISTER(bms, &sub_bms,
		   "Battery cycle anomaly detection (NASA PCoE)", NULL);
```

## src/cycles_db.cpp
```c
/* Generated by apps/ai_bms/train/train.py — DO NOT EDIT */
#include "cycles_db.h"

const unsigned int g_cycle_count = 3;
const struct bms_cycle g_cycles[] = {
    {
        .name = "early",
        .cell = "B0018",
        .index = 0,
        .capacity_ah = 1.8550f,
        .voltage = {
            +0.882219f,
            +0.569933f,
            +0.516675f,
            +0.479717f,
            +0.449252f,
            +0.420132f,
            +0.392644f,
            +0.366708f,
            +0.341704f,
            +0.317695f,
            +0.294884f,
            +0.272839f,
            +0.251508f,
            +0.231363f,
            +0.211955f,
            +0.194255f,
            +0.177787f,
            +0.162895f,
            +0.149286f,
            +0.136579f,
            +0.124047f,
            +0.111265f,
            +0.098037f,
            +0.083668f,
            +0.067476f,
            +0.048986f,
            +0.024955f,
            -0.011611f,
            -0.079479f,
            -0.223626f,
            -0.613054f,
            -0.312389f,
        },
    },
    {
        .name = "mid",
        .cell = "B0018",
        .index = 66,
        .capacity_ah = 1.5223f,
        .voltage = {
            +0.883471f,
            +0.575782f,
            +0.517594f,
            +0.479436f,
            +0.445214f,
            +0.405906f,
            +0.367840f,
            +0.337099f,
            +0.307961f,
            +0.280152f,
            +0.253667f,
            +0.229095f,
            +0.205914f,
            +0.184800f,
            +0.165010f,
            +0.147134f,
            +0.130491f,
            +0.114702f,
            +0.099120f,
            +0.083407f,
            +0.066908f,
            +0.049196f,
            +0.029269f,
            +0.005303f,
            -0.025652f,
            -0.072685f,
            -0.156891f,
            -0.317533f,
            -0.726938f,
            -0.097852f,
            +0.048591f,
            +0.119838f,
        },
    },
    {
        .name = "aged",
        .cell = "B0018",
        .index = 131,
        .capacity_ah = 1.3411f,
        .voltage = {
            +0.879378f,
            +0.551911f,
            +0.487980f,
            +0.447979f,
            +0.410082f,
            +0.367694f,
            +0.328608f,
            +0.296042f,
            +0.264911f,
            +0.234929f,
            +0.206683f,
            +0.180390f,
            +0.155910f,
            +0.133417f,
            +0.112345f,
            +0.092606f,
            +0.073943f,
            +0.055603f,
            +0.037293f,
            +0.018409f,
            -0.001762f,
            -0.023739f,
            -0.049403f,
            -0.082518f,
            -0.129927f,
            -0.202344f,
            -0.320219f,
            -0.529439f,
            -0.363312f,
            -0.038284f,
            +0.073044f,
            +0.133976f,
        },
    },
};
```

## src/cycles_db.h
```c
/* Generated — DO NOT EDIT */
#ifndef CYCLES_DB_H
#define CYCLES_DB_H
#include <stddef.h>

#define BMS_CYCLE_LEN 32

struct bms_cycle {
    const char *name;
    const char *cell;
    unsigned int index;
    float capacity_ah;
    float voltage[BMS_CYCLE_LEN];
};

extern const unsigned int g_cycle_count;
extern const struct bms_cycle g_cycles[];
#endif
```

## src/tflm_bms.cpp
```c
/*
 * BMS autoencoder inference + reconstruction-error scoring.
 * Model architecture: Dense(24→12→4→12→24→32) on int8 with ReLU.
 * Trained on NASA PCoE B0005/B0006/B0007 healthy discharge cycles.
 */

#include "tflm_bms.h"
#include "model.hpp"

#include <tensorflow/lite/micro/micro_mutable_op_resolver.h>
#include <tensorflow/lite/micro/micro_log.h>
#include <tensorflow/lite/micro/micro_interpreter.h>
#include <tensorflow/lite/micro/system_setup.h>
#include <tensorflow/lite/schema/schema_generated.h>

#include <math.h>
#include <stdint.h>

namespace {

constexpr int kArenaSize = 4 * 1024;
alignas(16) uint8_t g_arena[kArenaSize];

const tflite::Model       *s_model       = nullptr;
tflite::MicroInterpreter  *s_interpreter = nullptr;
TfLiteTensor              *s_input       = nullptr;
TfLiteTensor              *s_output      = nullptr;
bool                       s_ready       = false;

}

extern "C" int tflm_bms_init(void)
{
	s_model = tflite::GetModel(::g_model);
	if (s_model->version() != TFLITE_SCHEMA_VERSION) {
		MicroPrintf("model schema %d != supported %d",
			    s_model->version(), TFLITE_SCHEMA_VERSION);
		return -1;
	}

	static tflite::MicroMutableOpResolver<3> resolver;
	resolver.AddFullyConnected();
	resolver.AddRelu();
	resolver.AddReshape();

	static tflite::MicroInterpreter interpreter(
		s_model, resolver, g_arena, kArenaSize);
	s_interpreter = &interpreter;

	if (s_interpreter->AllocateTensors() != kTfLiteOk) {
		MicroPrintf("AllocateTensors failed");
		return -2;
	}

	s_input  = s_interpreter->input(0);
	s_output = s_interpreter->output(0);

	if (s_input->dims->data[s_input->dims->size - 1] != TFLM_BMS_WINDOW) {
		MicroPrintf("unexpected input shape");
		return -3;
	}

	s_ready = true;
	return 0;
}

extern "C" int tflm_bms_score(const float *window, float *out_score)
{
	if (!s_ready || !window || !out_score) {
		return -1;
	}

	const float in_scale = s_input->params.scale;
	const int   in_zp    = s_input->params.zero_point;

	for (int i = 0; i < TFLM_BMS_WINDOW; ++i) {
		int32_t q = (int32_t)lroundf(window[i] / in_scale) + in_zp;
		if (q < -128) { q = -128; }
		if (q >  127) { q =  127; }
		s_input->data.int8[i] = (int8_t)q;
	}

	if (s_interpreter->Invoke() != kTfLiteOk) {
		return -2;
	}

	const float out_scale = s_output->params.scale;
	const int   out_zp    = s_output->params.zero_point;

	float sse = 0.0f;
	for (int i = 0; i < TFLM_BMS_WINDOW; ++i) {
		float y = (s_output->data.int8[i] - out_zp) * out_scale;
		float diff = window[i] - y;
		sse += diff * diff;
	}
	*out_score = sse / (float)TFLM_BMS_WINDOW;
	return 0;
}

extern "C" uint32_t tflm_bms_arena_size(void)
{
	return (uint32_t)kArenaSize;
}
```

## src/tflm_bms.h
```c
#ifndef TFLM_BMS_H
#define TFLM_BMS_H

#include <stdint.h>

#ifdef __cplusplus
extern "C" {
#endif

#define TFLM_BMS_WINDOW 32

int      tflm_bms_init(void);
int      tflm_bms_score(const float *window, float *out_score);
uint32_t tflm_bms_arena_size(void);

#ifdef __cplusplus
}
#endif

#endif
```
