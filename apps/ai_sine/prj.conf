## CMakeLists.txt
```
cmake_minimum_required(VERSION 3.20.0)

find_package(Zephyr REQUIRED HINTS $ENV{ZEPHYR_BASE})
project(ai_sine LANGUAGES C CXX)

# TFLM uses local statics whose thread-safe initialization needs the C++ ABI
# helpers Zephyr does not pull in. Disable thread-safe statics for this app.
set(NO_THREADSAFE_STATICS $<TARGET_PROPERTY:compiler-cpp,no_threadsafe_statics>)
zephyr_compile_options($<$<COMPILE_LANGUAGE:CXX>:${NO_THREADSAFE_STATICS}>)

target_sources(app PRIVATE
    src/main.c
    src/cmd_ai.c
    src/tflm_sine.cpp
    src/model.cpp
)
```

## prj.conf
```kconfig
# --- C++ + TFLM ---
CONFIG_CPP=y
CONFIG_STD_CPP17=y
CONFIG_TENSORFLOW_LITE_MICRO=y
CONFIG_TENSORFLOW_LITE_MICRO_CMSIS_NN_KERNELS=y
CONFIG_REQUIRES_FLOAT_PRINTF=y
CONFIG_FPU=y
CONFIG_MAIN_STACK_SIZE=4096

# --- App functionality ---
CONFIG_GPIO=y

# --- Logging ---
CONFIG_LOG=y
CONFIG_LOG_MODE_DEFERRED=y
CONFIG_LOG_BUFFER_SIZE=2048

# --- Shell over UART ---
CONFIG_SHELL=y
CONFIG_SHELL_BACKEND_SERIAL=y
CONFIG_SHELL_PROMPT_UART="g474> "
CONFIG_SHELL_HISTORY=y
CONFIG_SHELL_TAB=y
CONFIG_SHELL_TAB_AUTOCOMPLETION=y
CONFIG_SHELL_STACK_SIZE=4096

# --- Built-in shell modules ---
CONFIG_KERNEL_SHELL=y
CONFIG_DEVICE_SHELL=y
CONFIG_THREAD_MONITOR=y
CONFIG_THREAD_NAME=y
CONFIG_THREAD_STACK_INFO=y
CONFIG_INIT_STACKS=y
```

## src/main.c
```c
/*
 * ai_sine — TensorFlow Lite Micro on Cortex-M4 demo.
 *
 * - Initializes the TFLM interpreter at boot.
 * - Heartbeat thread blinks LD2 every 1 s so user can see the device is alive.
 * - Inference is exposed via shell commands `ai sine|bench|info` (cmd_ai.c).
 */

#include <zephyr/kernel.h>
#include <zephyr/drivers/gpio.h>
#include <zephyr/logging/log.h>

#include "tflm_sine.h"

LOG_MODULE_REGISTER(ai_sine, LOG_LEVEL_INF);

#define LED0_NODE DT_ALIAS(led0)
static const struct gpio_dt_spec led = GPIO_DT_SPEC_GET(LED0_NODE, gpios);

int main(void)
{
	int rc = tflm_sine_init();
	if (rc != 0) {
		LOG_ERR("TFLM init failed: %d", rc);
		return rc;
	}
	LOG_INF("TFLM ready (arena %u B). Try `ai info`, `ai sine 1.5708`, `ai bench`.",
		tflm_sine_arena_size());

	if (!gpio_is_ready_dt(&led)) {
		LOG_WRN("LED not ready; skipping heartbeat");
		return 0;
	}
	gpio_pin_configure_dt(&led, GPIO_OUTPUT_INACTIVE);

	while (1) {
		gpio_pin_toggle_dt(&led);
		k_msleep(1000);
	}
	return 0;
}
```

## src/cmd_ai.c
```c
/*
 * Custom shell command tree: `ai ...`
 *
 * Exposes the TFLM sine model via:
 *   ai sine  <x>           — one inference, prints predicted sin(x) and error
 *   ai bench [iterations]  — average / min / max inference time in microseconds
 *   ai info                — model status and arena size
 */

#include <zephyr/kernel.h>
#include <zephyr/shell/shell.h>
#include <zephyr/sys/util.h>
#include <stdlib.h>
#include <math.h>

#include "tflm_sine.h"

static int cmd_ai_info(const struct shell *sh, size_t argc, char **argv)
{
	ARG_UNUSED(argc);
	ARG_UNUSED(argv);

	shell_print(sh, "Model     : sine (int8-quantized FullyConnected MLP)");
	shell_print(sh, "Framework : TensorFlow Lite Micro + CMSIS-NN");
	shell_print(sh, "Arena size: %u bytes", tflm_sine_arena_size());
	shell_print(sh, "Trained on: x in [0, 2π], target = sin(x)");
	shell_print(sh, "Use       : `ai sine 1.5708`  → expect ≈ 1.0");
	return 0;
}

static int cmd_ai_sine(const struct shell *sh, size_t argc, char **argv)
{
	if (argc != 2) {
		shell_error(sh, "usage: ai sine <x_radians>");
		return -EINVAL;
	}

	char *end;
	float x = strtof(argv[1], &end);
	if (*end != '\0') {
		shell_error(sh, "invalid float: '%s'", argv[1]);
		return -EINVAL;
	}

	float y;
	int rc = tflm_sine_infer(x, &y);
	if (rc != 0) {
		shell_error(sh, "inference failed: %d", rc);
		return rc;
	}

	float expected = sinf(x);
	float err = y - expected;
	shell_print(sh, "x = %.5f", (double)x);
	shell_print(sh, "predicted sin(x) = %.5f", (double)y);
	shell_print(sh, "actual    sin(x) = %.5f", (double)expected);
	shell_print(sh, "error            = %+.5f", (double)err);
	return 0;
}

static int cmd_ai_bench(const struct shell *sh, size_t argc, char **argv)
{
	uint32_t n = 1000;

	if (argc == 2) {
		char *end;
		long v = strtol(argv[1], &end, 10);
		if (*end != '\0' || v < 1) {
			shell_error(sh, "iterations must be a positive integer");
			return -EINVAL;
		}
		n = (uint32_t)v;
	} else if (argc > 2) {
		shell_error(sh, "usage: ai bench [iterations]");
		return -EINVAL;
	}

	uint32_t cyc_per_us = sys_clock_hw_cycles_per_sec() / 1000000U;
	uint32_t min_cyc = UINT32_MAX, max_cyc = 0;
	uint64_t total_cyc = 0;
	float y;

	/* warm up to fault any lazy allocations / cache effects */
	for (int i = 0; i < 4; ++i) {
		tflm_sine_infer(0.0f, &y);
	}

	for (uint32_t i = 0; i < n; ++i) {
		/* sweep x across [0, 2π] so we exercise the whole input range */
		float x = (float)i * (6.2831853f / (float)n);
		uint32_t t0 = k_cycle_get_32();
		tflm_sine_infer(x, &y);
		uint32_t dt = k_cycle_get_32() - t0;
		total_cyc += dt;
		if (dt < min_cyc) { min_cyc = dt; }
		if (dt > max_cyc) { max_cyc = dt; }
	}

	uint32_t avg_cyc = (uint32_t)(total_cyc / n);
	shell_print(sh, "iterations : %u", n);
	shell_print(sh, "cpu freq   : %u Hz", sys_clock_hw_cycles_per_sec());
	shell_print(sh, "avg        : %u cycles  (%u.%03u us)",
		    avg_cyc, avg_cyc / cyc_per_us,
		    (avg_cyc * 1000U / cyc_per_us) % 1000U);
	shell_print(sh, "min        : %u cycles  (%u.%03u us)",
		    min_cyc, min_cyc / cyc_per_us,
		    (min_cyc * 1000U / cyc_per_us) % 1000U);
	shell_print(sh, "max        : %u cycles  (%u.%03u us)",
		    max_cyc, max_cyc / cyc_per_us,
		    (max_cyc * 1000U / cyc_per_us) % 1000U);
	shell_print(sh, "throughput : ~%u inf/sec",
		    (uint32_t)(sys_clock_hw_cycles_per_sec() / avg_cyc));
	return 0;
}

SHELL_STATIC_SUBCMD_SET_CREATE(sub_ai,
	SHELL_CMD(info,  NULL, "Show model + framework info",            cmd_ai_info),
	SHELL_CMD_ARG(sine,  NULL, "Predict sin(x) for given x (radians)",
		      cmd_ai_sine,  2, 0),
	SHELL_CMD_ARG(bench, NULL, "Benchmark inference time [iterations]",
		      cmd_ai_bench, 1, 1),
	SHELL_SUBCMD_SET_END
);

SHELL_CMD_REGISTER(ai, &sub_ai, "TFLM sine model commands", NULL);
```

## src/tflm_sine.cpp
```c
/*
 * TFLM-based sine approximator (int8-quantized model from the upstream
 * Zephyr hello_world sample). Exposes a C interface in tflm_sine.h.
 */

#include "tflm_sine.h"
#include "model.hpp"

#include <tensorflow/lite/micro/micro_mutable_op_resolver.h>
#include <tensorflow/lite/micro/micro_log.h>
#include <tensorflow/lite/micro/micro_interpreter.h>
#include <tensorflow/lite/micro/system_setup.h>
#include <tensorflow/lite/schema/schema_generated.h>

#include <math.h>

namespace {

constexpr int kArenaSize = 2000;
alignas(16) uint8_t g_arena[kArenaSize];

const tflite::Model        *s_model       = nullptr;
tflite::MicroInterpreter   *g_interpreter = nullptr;
TfLiteTensor               *g_input       = nullptr;
TfLiteTensor               *g_output      = nullptr;
bool                        g_ready       = false;

}  /* namespace */

extern "C" int tflm_sine_init(void)
{
	s_model = tflite::GetModel(::g_model);
	if (s_model->version() != TFLITE_SCHEMA_VERSION) {
		MicroPrintf("model schema %d != supported %d",
			    s_model->version(), TFLITE_SCHEMA_VERSION);
		return -1;
	}

	static tflite::MicroMutableOpResolver<1> resolver;
	resolver.AddFullyConnected();

	static tflite::MicroInterpreter interpreter(
		s_model, resolver, g_arena, kArenaSize);
	g_interpreter = &interpreter;

	if (g_interpreter->AllocateTensors() != kTfLiteOk) {
		MicroPrintf("AllocateTensors failed");
		return -2;
	}

	g_input  = g_interpreter->input(0);
	g_output = g_interpreter->output(0);
	g_ready  = true;
	return 0;
}

extern "C" int tflm_sine_infer(float x, float *y)
{
	if (!g_ready || g_input == nullptr || g_output == nullptr || y == nullptr) {
		return -1;
	}

	/* Quantize float input -> int8 using tensor's scale + zero-point. */
	int32_t q = (int32_t)lroundf(x / g_input->params.scale)
	             + g_input->params.zero_point;
	if (q < -128) { q = -128; }
	if (q >  127) { q =  127; }
	g_input->data.int8[0] = (int8_t)q;

	if (g_interpreter->Invoke() != kTfLiteOk) {
		return -2;
	}

	int8_t qy = g_output->data.int8[0];
	*y = (qy - g_output->params.zero_point) * g_output->params.scale;
	return 0;
}

extern "C" uint32_t tflm_sine_arena_size(void)
{
	return (uint32_t)kArenaSize;
}
```

## src/tflm_sine.h
```c
/*
 * C-callable wrapper around the TFLM sine model.
 * Implementation in tflm_sine.cpp (C++ — TFLM is C++).
 */

#ifndef TFLM_SINE_H
#define TFLM_SINE_H

#include <stdint.h>
#include <stdbool.h>

#ifdef __cplusplus
extern "C" {
#endif

/* Initialize interpreter and allocate tensors. Returns 0 on success. */
int tflm_sine_init(void);

/* Run one inference. x is in radians (the model was trained on [0, 2π]).
 * On success, *y is the model's predicted sin(x). Returns 0 on success.
 */
int tflm_sine_infer(float x, float *y);

/* Tensor arena size in bytes (for reporting). */
uint32_t tflm_sine_arena_size(void);

#ifdef __cplusplus
}
#endif

#endif /* TFLM_SINE_H */
```
