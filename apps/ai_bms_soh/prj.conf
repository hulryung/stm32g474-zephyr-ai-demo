## CMakeLists.txt
```
cmake_minimum_required(VERSION 3.20.0)

find_package(Zephyr REQUIRED HINTS $ENV{ZEPHYR_BASE})
project(ai_bms_soh LANGUAGES C CXX)

set(NO_THREADSAFE_STATICS $<TARGET_PROPERTY:compiler-cpp,no_threadsafe_statics>)
zephyr_compile_options($<$<COMPILE_LANGUAGE:CXX>:${NO_THREADSAFE_STATICS}>)

target_sources(app PRIVATE
    src/main.c
    src/cmd_soh.c
    src/cycles_db.cpp
    src/tflm_soh.cpp
    src/model.cpp
)
```

## prj.conf
```kconfig
CONFIG_CPP=y
CONFIG_STD_CPP17=y
CONFIG_TENSORFLOW_LITE_MICRO=y
CONFIG_TENSORFLOW_LITE_MICRO_CMSIS_NN_KERNELS=y
CONFIG_REQUIRES_FLOAT_PRINTF=y
CONFIG_FPU=y
CONFIG_MAIN_STACK_SIZE=4096

CONFIG_GPIO=y

CONFIG_LOG=y
CONFIG_LOG_MODE_DEFERRED=y
CONFIG_LOG_BUFFER_SIZE=2048

CONFIG_SHELL=y
CONFIG_SHELL_BACKEND_SERIAL=y
CONFIG_SHELL_PROMPT_UART="g474> "
CONFIG_SHELL_HISTORY=y
CONFIG_SHELL_TAB=y
CONFIG_SHELL_TAB_AUTOCOMPLETION=y
CONFIG_SHELL_STACK_SIZE=4096

CONFIG_KERNEL_SHELL=y
CONFIG_DEVICE_SHELL=y
CONFIG_THREAD_MONITOR=y
CONFIG_THREAD_NAME=y
CONFIG_THREAD_STACK_INFO=y
CONFIG_INIT_STACKS=y
```

## src/main.c
```c
#include <zephyr/kernel.h>
#include <zephyr/drivers/gpio.h>
#include <zephyr/logging/log.h>

#include "tflm_soh.h"

LOG_MODULE_REGISTER(ai_bms_soh, LOG_LEVEL_INF);

#define LED0_NODE DT_ALIAS(led0)
static const struct gpio_dt_spec led = GPIO_DT_SPEC_GET(LED0_NODE, gpios);

int main(void)
{
	int rc = tflm_soh_init();
	if (rc != 0) {
		LOG_ERR("TFLM init failed: %d", rc);
		return rc;
	}
	LOG_INF("ai_bms_soh up — try `soh list`, `soh scan`, `soh estimate aged`");

	if (gpio_is_ready_dt(&led)) {
		gpio_pin_configure_dt(&led, GPIO_OUTPUT_INACTIVE);
		while (1) {
			gpio_pin_toggle_dt(&led);
			k_msleep(1000);
		}
	}
	return 0;
}
```

## src/cmd_soh.c
```c
/*
 * Shell command tree: `soh ...`
 *
 *   soh list                 — list embedded sample cycles
 *   soh info                 — model info
 *   soh estimate <name>      — predict capacity for one cycle
 *   soh scan                 — predict for every embedded cycle, print error
 *   soh bench [iterations]   — inference latency
 */

#include <zephyr/kernel.h>
#include <zephyr/shell/shell.h>
#include <zephyr/sys/util.h>
#include <stdlib.h>
#include <string.h>
#include <math.h>

#include "tflm_soh.h"
#include "cycles_db.h"

static const struct soh_cycle *find_cycle(const char *name)
{
	for (unsigned int i = 0; i < g_cycle_count; ++i) {
		if (!strcmp(g_cycles[i].name, name)) {
			return &g_cycles[i];
		}
	}
	return NULL;
}

static int cmd_list(const struct shell *sh, size_t argc, char **argv)
{
	ARG_UNUSED(argc); ARG_UNUSED(argv);
	shell_print(sh, "%-7s %-7s %-5s %s",
		    "name", "cell", "idx", "true capacity");
	for (unsigned int i = 0; i < g_cycle_count; ++i) {
		const struct soh_cycle *c = &g_cycles[i];
		shell_print(sh, "%-7s %-7s %-5u %.4f Ah",
			    c->name, c->cell, c->index,
			    (double)c->true_capacity_ah);
	}
	return 0;
}

static int cmd_info(const struct shell *sh, size_t argc, char **argv)
{
	ARG_UNUSED(argc); ARG_UNUSED(argv);
	shell_print(sh, "Model    : MLP regressor (int8)");
	shell_print(sh, "Trained  : NASA PCoE B0005/B0006/B0007 healthy + aged cycles");
	shell_print(sh, "Holdout  : B0018 (embedded cycles all from this cell)");
	shell_print(sh, "Cycles   : %u embedded", g_cycle_count);
	shell_print(sh, "Arena    : %u bytes", tflm_soh_arena_size());
	shell_print(sh, "Output   : capacity in Ah, range [1.0, 2.0]");
	return 0;
}

static int estimate_cycle(const struct shell *sh, const struct soh_cycle *c)
{
	float pred;
	int rc = tflm_soh_estimate(c->voltage_norm, &pred);
	if (rc != 0) {
		shell_error(sh, "inference failed: %d", rc);
		return rc;
	}
	float err = pred - c->true_capacity_ah;
	float pct = (c->true_capacity_ah > 0.0f) ?
		    (fabsf(err) / c->true_capacity_ah * 100.0f) : 0.0f;
	shell_print(sh, "%-7s true=%.4f Ah  predicted=%.4f Ah  error=%+.4f Ah (%.1f%%)",
		    c->name,
		    (double)c->true_capacity_ah,
		    (double)pred,
		    (double)err,
		    (double)pct);
	return 0;
}

static int cmd_estimate(const struct shell *sh, size_t argc, char **argv)
{
	if (argc != 2) {
		shell_error(sh, "usage: soh estimate <cycle_name>");
		return -EINVAL;
	}
	const struct soh_cycle *c = find_cycle(argv[1]);
	if (!c) {
		shell_error(sh, "unknown cycle '%s' (try `soh list`)", argv[1]);
		return -EINVAL;
	}
	return estimate_cycle(sh, c);
}

static int cmd_scan(const struct shell *sh, size_t argc, char **argv)
{
	ARG_UNUSED(argc); ARG_UNUSED(argv);
	shell_print(sh, "SOH estimation across all embedded cycles:");
	float total_abs_err = 0.0f;
	for (unsigned int i = 0; i < g_cycle_count; ++i) {
		float pred;
		if (tflm_soh_estimate(g_cycles[i].voltage_norm, &pred) != 0) {
			continue;
		}
		float err = pred - g_cycles[i].true_capacity_ah;
		total_abs_err += fabsf(err);
		estimate_cycle(sh, &g_cycles[i]);
	}
	if (g_cycle_count > 0) {
		shell_print(sh, "MAE: %.4f Ah (%u cycles)",
			    (double)(total_abs_err / g_cycle_count), g_cycle_count);
	}
	return 0;
}

static int cmd_bench(const struct shell *sh, size_t argc, char **argv)
{
	uint32_t n = 1000;
	if (argc == 2) { n = (uint32_t)strtoul(argv[1], NULL, 10); if (!n) n = 1000; }
	if (g_cycle_count == 0) { return -ENODATA; }
	const float *window = g_cycles[0].voltage_norm;
	float pred;

	for (int i = 0; i < 4; ++i) tflm_soh_estimate(window, &pred);

	uint32_t cyc_per_us = sys_clock_hw_cycles_per_sec() / 1000000U;
	uint32_t mn = UINT32_MAX, mx = 0;
	uint64_t total = 0;
	for (uint32_t i = 0; i < n; ++i) {
		uint32_t t0 = k_cycle_get_32();
		tflm_soh_estimate(window, &pred);
		uint32_t dt = k_cycle_get_32() - t0;
		total += dt;
		if (dt < mn) mn = dt;
		if (dt > mx) mx = dt;
	}
	uint32_t avg = (uint32_t)(total / n);
	shell_print(sh, "iterations : %u", n);
	shell_print(sh, "avg        : %u cycles  (%u.%03u us)",
		    avg, avg / cyc_per_us, (avg * 1000U / cyc_per_us) % 1000U);
	shell_print(sh, "min        : %u cycles  (%u.%03u us)",
		    mn, mn / cyc_per_us, (mn * 1000U / cyc_per_us) % 1000U);
	shell_print(sh, "max        : %u cycles  (%u.%03u us)",
		    mx, mx / cyc_per_us, (mx * 1000U / cyc_per_us) % 1000U);
	shell_print(sh, "throughput : ~%u inf/sec",
		    (uint32_t)(sys_clock_hw_cycles_per_sec() / avg));
	return 0;
}

SHELL_STATIC_SUBCMD_SET_CREATE(sub_soh,
	SHELL_CMD(list,    NULL, "List embedded cycles + true capacity",   cmd_list),
	SHELL_CMD(info,    NULL, "Model info",                              cmd_info),
	SHELL_CMD_ARG(estimate, NULL, "soh estimate <cycle_name>",
		      cmd_estimate, 2, 0),
	SHELL_CMD(scan,    NULL, "Estimate every embedded cycle + MAE",     cmd_scan),
	SHELL_CMD_ARG(bench, NULL, "Inference latency [iterations]",
		      cmd_bench, 1, 1),
	SHELL_SUBCMD_SET_END
);

SHELL_CMD_REGISTER(soh, &sub_soh,
		   "Battery SOH (state of health) regression demo", NULL);
```

## src/cycles_db.cpp
```c
/* Generated — DO NOT EDIT */
#include "cycles_db.h"

const unsigned int g_cycle_count = 3;
const struct soh_cycle g_cycles[] = {
    {
        .name = "early",
        .cell = "B0018",
        .index = 0,
        .true_capacity_ah = 1.8550f,
        .voltage_norm = {
            +0.882219f,
            +0.569933f,
            +0.516675f,
            +0.479717f,
            +0.449252f,
            +0.420132f,
            +0.392644f,
            +0.366708f,
            +0.341704f,
            +0.317695f,
            +0.294884f,
            +0.272839f,
            +0.251508f,
            +0.231363f,
            +0.211955f,
            +0.194255f,
            +0.177787f,
            +0.162895f,
            +0.149286f,
            +0.136579f,
            +0.124047f,
            +0.111265f,
            +0.098037f,
            +0.083668f,
            +0.067476f,
            +0.048986f,
            +0.024955f,
            -0.011611f,
            -0.079479f,
            -0.223626f,
            -0.613054f,
            -0.312389f,
        },
    },
    {
        .name = "mid",
        .cell = "B0018",
        .index = 66,
        .true_capacity_ah = 1.5223f,
        .voltage_norm = {
            +0.883471f,
            +0.575782f,
            +0.517594f,
            +0.479436f,
            +0.445214f,
            +0.405906f,
            +0.367840f,
            +0.337099f,
            +0.307961f,
            +0.280152f,
            +0.253667f,
            +0.229095f,
            +0.205914f,
            +0.184800f,
            +0.165010f,
            +0.147134f,
            +0.130491f,
            +0.114702f,
            +0.099120f,
            +0.083407f,
            +0.066908f,
            +0.049196f,
            +0.029269f,
            +0.005303f,
            -0.025652f,
            -0.072685f,
            -0.156891f,
            -0.317533f,
            -0.726938f,
            -0.097852f,
            +0.048591f,
            +0.119838f,
        },
    },
    {
        .name = "aged",
        .cell = "B0018",
        .index = 131,
        .true_capacity_ah = 1.3411f,
        .voltage_norm = {
            +0.879378f,
            +0.551911f,
            +0.487980f,
            +0.447979f,
            +0.410082f,
            +0.367694f,
            +0.328608f,
            +0.296042f,
            +0.264911f,
            +0.234929f,
            +0.206683f,
            +0.180390f,
            +0.155910f,
            +0.133417f,
            +0.112345f,
            +0.092606f,
            +0.073943f,
            +0.055603f,
            +0.037293f,
            +0.018409f,
            -0.001762f,
            -0.023739f,
            -0.049403f,
            -0.082518f,
            -0.129927f,
            -0.202344f,
            -0.320219f,
            -0.529439f,
            -0.363312f,
            -0.038284f,
            +0.073044f,
            +0.133976f,
        },
    },
};
```

## src/cycles_db.h
```c
/* Generated — DO NOT EDIT */
#ifndef CYCLES_DB_H
#define CYCLES_DB_H
#include <stddef.h>

#define SOH_WINDOW 32

struct soh_cycle {
    const char  *name;
    const char  *cell;
    unsigned int index;
    float        true_capacity_ah;
    float        voltage_norm[SOH_WINDOW];
};

extern const unsigned int g_cycle_count;
extern const struct soh_cycle g_cycles[];
#endif
```

## src/model.hpp
```c
/* Generated — DO NOT EDIT */
#ifndef MODEL_HPP
#define MODEL_HPP
extern const unsigned char g_model[];
extern const unsigned int  g_model_len;
#endif
```

## src/tflm_soh.cpp
```c
/*
 * SOH regressor inference. Model: Dense(32->32->16->8->1) with ReLU, linear
 * output. Output range [-1, +1] denormalizes to capacity in Ah using
 * CAP_MIN/CAP_MAX from train.py.
 */

#include "tflm_soh.h"
#include "model.hpp"

#include <tensorflow/lite/micro/micro_mutable_op_resolver.h>
#include <tensorflow/lite/micro/micro_log.h>
#include <tensorflow/lite/micro/micro_interpreter.h>
#include <tensorflow/lite/micro/system_setup.h>
#include <tensorflow/lite/schema/schema_generated.h>

#include <math.h>
#include <stdint.h>

namespace {

/* Must match CAP_MIN / CAP_MAX in train.py. */
constexpr float CAP_MIN = 1.0f;
constexpr float CAP_MAX = 2.0f;

constexpr int kArenaSize = 4 * 1024;
alignas(16) uint8_t g_arena[kArenaSize];

const tflite::Model       *s_model       = nullptr;
tflite::MicroInterpreter  *s_interpreter = nullptr;
TfLiteTensor              *s_input       = nullptr;
TfLiteTensor              *s_output      = nullptr;
bool                       s_ready       = false;

}

extern "C" int tflm_soh_init(void)
{
	s_model = tflite::GetModel(::g_model);
	if (s_model->version() != TFLITE_SCHEMA_VERSION) {
		MicroPrintf("model schema mismatch");
		return -1;
	}

	static tflite::MicroMutableOpResolver<3> resolver;
	resolver.AddFullyConnected();
	resolver.AddRelu();
	resolver.AddReshape();

	static tflite::MicroInterpreter interpreter(
		s_model, resolver, g_arena, kArenaSize);
	s_interpreter = &interpreter;

	if (s_interpreter->AllocateTensors() != kTfLiteOk) {
		MicroPrintf("AllocateTensors failed");
		return -2;
	}

	s_input  = s_interpreter->input(0);
	s_output = s_interpreter->output(0);

	s_ready = true;
	return 0;
}

extern "C" int tflm_soh_estimate(const float *window, float *cap_out)
{
	if (!s_ready || !window || !cap_out) {
		return -1;
	}

	const float in_scale  = s_input->params.scale;
	const int   in_zp     = s_input->params.zero_point;

	for (int i = 0; i < TFLM_SOH_WINDOW; ++i) {
		int32_t q = (int32_t)lroundf(window[i] / in_scale) + in_zp;
		if (q < -128) { q = -128; }
		if (q >  127) { q =  127; }
		s_input->data.int8[i] = (int8_t)q;
	}

	if (s_interpreter->Invoke() != kTfLiteOk) {
		return -2;
	}

	const float out_scale = s_output->params.scale;
	const int   out_zp    = s_output->params.zero_point;
	float y_norm = (s_output->data.int8[0] - out_zp) * out_scale;
	/* Clamp: occasionally the int8 model overshoots [-1,+1] slightly. */
	if (y_norm < -1.0f) { y_norm = -1.0f; }
	if (y_norm >  1.0f) { y_norm =  1.0f; }
	*cap_out = (y_norm + 1.0f) * 0.5f * (CAP_MAX - CAP_MIN) + CAP_MIN;
	return 0;
}

extern "C" uint32_t tflm_soh_arena_size(void)
{
	return (uint32_t)kArenaSize;
}
```

## src/tflm_soh.h
```c
#ifndef TFLM_SOH_H
#define TFLM_SOH_H

#include <stdint.h>

#ifdef __cplusplus
extern "C" {
#endif

#define TFLM_SOH_WINDOW 32

int      tflm_soh_init(void);

/* window: normalized voltage curve (length 32). Returns predicted capacity
 * in ampere-hours via *cap_out. Returns 0 on success. */
int      tflm_soh_estimate(const float *window, float *cap_out);

uint32_t tflm_soh_arena_size(void);

#ifdef __cplusplus
}
#endif

#endif
```
