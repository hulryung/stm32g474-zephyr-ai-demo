## CMakeLists.txt
```
cmake_minimum_required(VERSION 3.20.0)
find_package(Zephyr REQUIRED HINTS $ENV{ZEPHYR_BASE})
project(ai_bms_persistence LANGUAGES C)

target_sources(app PRIVATE
    src/main.c
    src/bms_state.c
    src/cmd_persist.c
)
```

## prj.conf
```kconfig
CONFIG_REQUIRES_FLOAT_PRINTF=y
CONFIG_FPU=y
CONFIG_MAIN_STACK_SIZE=4096

CONFIG_GPIO=y
CONFIG_LOG=y
CONFIG_LOG_MODE_DEFERRED=y
CONFIG_LOG_BUFFER_SIZE=2048

CONFIG_SHELL=y
CONFIG_SHELL_BACKEND_SERIAL=y
CONFIG_SHELL_PROMPT_UART="g474> "
CONFIG_SHELL_HISTORY=y
CONFIG_SHELL_TAB=y
CONFIG_SHELL_TAB_AUTOCOMPLETION=y
CONFIG_SHELL_STACK_SIZE=4096

# Settings subsystem (NVS backend)
CONFIG_FLASH=y
CONFIG_FLASH_PAGE_LAYOUT=y
CONFIG_FLASH_MAP=y
CONFIG_NVS=y
CONFIG_SETTINGS=y
CONFIG_SETTINGS_NVS=y

CONFIG_KERNEL_SHELL=y
CONFIG_DEVICE_SHELL=y
CONFIG_THREAD_MONITOR=y
CONFIG_THREAD_NAME=y
CONFIG_THREAD_STACK_INFO=y
```

## src/main.c
```c
#include <zephyr/kernel.h>
#include <zephyr/drivers/gpio.h>
#include <zephyr/logging/log.h>

#include "bms_state.h"

LOG_MODULE_REGISTER(ai_bms_persistence, LOG_LEVEL_INF);

#define LED0_NODE DT_ALIAS(led0)
static const struct gpio_dt_spec led = GPIO_DT_SPEC_GET(LED0_NODE, gpios);

int main(void) {
    int rc = bms_state_init();
    if (rc != 0) {
        LOG_ERR("bms_state_init failed: %d (continuing — NVS empty?)", rc);
    }
    const struct bms_persisted_state *s = bms_state_get();
    if (s) {
        LOG_INF("Boot #%u, restored SOC=%.2f%%, Q=%.4fAh",
                s->boot_count, (double)s->soc_pct, (double)s->Q_estimate_ah);
    } else {
        LOG_INF("First boot — no NVS state yet");
    }
    LOG_INF("Try: `persist info`, `persist demo`, `persist save 42 1.78`");

    if (gpio_is_ready_dt(&led)) {
        gpio_pin_configure_dt(&led, GPIO_OUTPUT_INACTIVE);
        while (1) {
            gpio_pin_toggle_dt(&led);
            k_msleep(1000);
        }
    }
    return 0;
}
```

## src/bms_state.c
```c
#include "bms_state.h"

#include <zephyr/kernel.h>
#include <zephyr/settings/settings.h>
#include <zephyr/logging/log.h>
#include <string.h>

LOG_MODULE_REGISTER(bms_state, LOG_LEVEL_INF);

#define KEY_PREFIX "bms"
#define KEY_FULL   KEY_PREFIX "/state"

static struct bms_persisted_state g_state;
static bool g_loaded = false;

/* settings handler — called by settings_load() for each matching key */
static int handle_set(const char *name, size_t len,
                      settings_read_cb read_cb, void *cb_arg)
{
    /* Only one key in this subtree, so name should be empty here. */
    if (len != sizeof(g_state)) {
        LOG_WRN("saved bms state size %u != current schema %u",
                (unsigned)len, (unsigned)sizeof(g_state));
        return -EINVAL;
    }
    int rc = read_cb(cb_arg, &g_state, sizeof(g_state));
    if (rc < 0) {
        LOG_ERR("settings read failed: %d", rc);
        return rc;
    }
    if (g_state.version != BMS_STATE_VERSION) {
        LOG_WRN("schema version mismatch: stored=%u current=%u",
                g_state.version, BMS_STATE_VERSION);
        memset(&g_state, 0, sizeof(g_state));
        return -EINVAL;
    }
    g_loaded = true;
    LOG_INF("restored from NVS: SOC=%.2f%% Q=%.4fAh boot#%u",
            (double)g_state.soc_pct,
            (double)g_state.Q_estimate_ah,
            g_state.boot_count);
    return 0;
}

SETTINGS_STATIC_HANDLER_DEFINE(bms_state, KEY_PREFIX, NULL,
                               handle_set, NULL, NULL);

int bms_state_init(void)
{
    int rc = settings_subsys_init();
    if (rc) { LOG_ERR("settings_subsys_init: %d", rc); return rc; }
    rc = settings_load_subtree(KEY_PREFIX);
    if (rc) { LOG_WRN("settings_load: %d", rc); }
    /* Increment boot counter even if there was nothing to load */
    g_state.boot_count++;
    return 0;
}

const struct bms_persisted_state *bms_state_get(void)
{
    return g_loaded ? &g_state : NULL;
}

int bms_state_set(const struct bms_persisted_state *s)
{
    g_state = *s;
    g_state.version = BMS_STATE_VERSION;
    g_loaded = true;
    int rc = settings_save_one(KEY_FULL, &g_state, sizeof(g_state));
    if (rc) { LOG_ERR("settings_save_one: %d", rc); return rc; }
    return 0;
}

int bms_state_clear(void)
{
    int rc = settings_delete(KEY_FULL);
    memset(&g_state, 0, sizeof(g_state));
    g_loaded = false;
    return rc;
}
```

## src/bms_state.h
```c
/*
 * BMS state envelope — what survives a power cycle.
 *
 * In a real product this lives in NVS (flash) on every BMS shutdown and
 * is restored on every boot. We use Zephyr's settings_subsys (FCB or NVS
 * backend) to handle the wear-leveling.
 */

#ifndef BMS_STATE_H
#define BMS_STATE_H

#include <stdint.h>

#ifdef __cplusplus
extern "C" {
#endif

#define BMS_STATE_VERSION 1u

struct bms_persisted_state {
    uint32_t version;          /* schema version, lets us evolve later */
    uint32_t boot_count;       /* incremented every boot */
    uint64_t shutdown_uptime_ms; /* uptime at last save */
    uint64_t shutdown_wallclock_s; /* host-supplied wall clock at save (0 if unknown) */

    float    soc_pct;          /* last EKF SOC */
    float    Q_estimate_ah;    /* last capacity estimate */
    float    v_rc;             /* last EKF RC voltage */
    float    P_soc;            /* covariances (so EKF doesn't think it's certain after restart) */
    float    P_Q;
    uint32_t cycles_completed;
};

/* Initialize storage backend; reads any existing state into the global. */
int bms_state_init(void);

/* Read the currently held state (returns NULL if no saved state yet). */
const struct bms_persisted_state *bms_state_get(void);

/* Update fields and persist. */
int bms_state_set(const struct bms_persisted_state *new_state);

/* Erase the saved state (factory reset / cell swap). */
int bms_state_clear(void);

#ifdef __cplusplus
}
#endif
#endif
```

## src/cmd_persist.c
```c
/*
 * Shell tree: `persist ...`
 *
 *   persist info                        — show saved state + boot count
 *   persist save <soc> <Q> [cycles]     — save a synthetic state to NVS
 *   persist load                        — re-read NVS into RAM (simulate restart)
 *   persist clear                       — erase saved state (factory)
 *   persist demo                        — full key-off / key-on / OCV recalibration walk-through
 */

#include <zephyr/kernel.h>
#include <zephyr/shell/shell.h>
#include <zephyr/sys/util.h>
#include <stdlib.h>
#include <string.h>
#include <math.h>

#include "bms_state.h"

/* OCV table — same as ai_bms_dual_ekf, used for rest-state recalibration. */
static const float OCV_SOC[21] = {
     0.00f,  5.00f, 10.00f, 15.00f, 20.00f, 25.00f, 30.00f,
    35.00f, 40.00f, 45.00f, 50.00f, 55.00f, 60.00f, 65.00f,
    70.00f, 75.00f, 80.00f, 85.00f, 90.00f, 95.00f, 100.00f,
};
static const float OCV_V[21] = {
    3.355f, 3.501f, 3.583f, 3.620f, 3.643f, 3.660f, 3.677f,
    3.694f, 3.712f, 3.732f, 3.755f, 3.781f, 3.812f, 3.847f,
    3.886f, 3.929f, 3.978f, 4.033f, 4.094f, 4.156f, 4.193f,
};

static float ocv_to_soc(float v) {
    if (v <= OCV_V[0])  return OCV_SOC[0];
    for (int i = 1; i < 21; ++i) {
        if (v <= OCV_V[i]) {
            float a = (v - OCV_V[i-1]) / (OCV_V[i] - OCV_V[i-1] + 1e-6f);
            return OCV_SOC[i-1] + a * (OCV_SOC[i] - OCV_SOC[i-1]);
        }
    }
    return OCV_SOC[20];
}

/* Demo recalibration policy: if the BMS has been off for > REST_THRESHOLD,
 * use the current OCV reading instead of (or blended with) the saved SOC.
 */
#define REST_THRESHOLD_SEC 600u   /* 10 minutes */

static int cmd_info(const struct shell *sh, size_t a, char **v) {
    ARG_UNUSED(a); ARG_UNUSED(v);
    const struct bms_persisted_state *s = bms_state_get();
    if (!s) {
        shell_print(sh, "No persisted state. Boot count is 1 (this boot).");
        return 0;
    }
    shell_print(sh, "Persisted BMS state");
    shell_print(sh, "  schema version : %u", s->version);
    shell_print(sh, "  boot count     : %u", s->boot_count);
    shell_print(sh, "  SOC (saved)    : %.2f %%",  (double)s->soc_pct);
    shell_print(sh, "  Q estimate     : %.4f Ah", (double)s->Q_estimate_ah);
    shell_print(sh, "  V_RC           : %.4f V",  (double)s->v_rc);
    shell_print(sh, "  P_soc / P_Q    : %.4f / %.4f",
                (double)s->P_soc, (double)s->P_Q);
    shell_print(sh, "  cycles done    : %u", s->cycles_completed);
    shell_print(sh, "  uptime at save : %llu ms", s->shutdown_uptime_ms);
    return 0;
}

static int cmd_save(const struct shell *sh, size_t a, char **v) {
    if (a < 3 || a > 4) {
        shell_error(sh, "usage: persist save <soc%%> <Q_ah> [cycles_done]");
        return -EINVAL;
    }
    struct bms_persisted_state ns = {0};
    const struct bms_persisted_state *prev = bms_state_get();
    if (prev) ns = *prev;          /* keep boot_count, etc */
    ns.version = BMS_STATE_VERSION;
    ns.soc_pct = strtof(v[1], NULL);
    ns.Q_estimate_ah = strtof(v[2], NULL);
    if (a == 4) ns.cycles_completed = (uint32_t)strtoul(v[3], NULL, 10);
    ns.shutdown_uptime_ms = k_uptime_get();
    /* For demo we don't have an RTC — caller can simulate "key-off" duration
     * via `persist load <rest_seconds>`. */
    ns.shutdown_wallclock_s = 0;
    int rc = bms_state_set(&ns);
    if (rc) { shell_error(sh, "save failed: %d", rc); return rc; }
    shell_print(sh, "saved: SOC=%.2f%% Q=%.4fAh", (double)ns.soc_pct, (double)ns.Q_estimate_ah);
    return 0;
}

static int cmd_clear(const struct shell *sh, size_t a, char **v) {
    ARG_UNUSED(a); ARG_UNUSED(v);
    int rc = bms_state_clear();
    shell_print(sh, "cleared (rc=%d). Reboot or `persist load` to confirm.", rc);
    return 0;
}

static int cmd_load(const struct shell *sh, size_t a, char **v) {
    /* Simulate "key-on after rest_seconds rest". Pass simulated current
     * cell V to demonstrate the OCV recalibration policy.
     *  usage: persist load <rest_sec> [v_now]
     */
    if (a < 2 || a > 3) {
        shell_error(sh, "usage: persist load <rest_seconds> [V_now_for_OCV]");
        return -EINVAL;
    }
    uint32_t rest_s = (uint32_t)strtoul(v[1], NULL, 10);
    bool have_v = (a == 3);
    float v_now = have_v ? strtof(v[2], NULL) : 0.0f;

    const struct bms_persisted_state *s = bms_state_get();
    shell_print(sh, "Simulating key-on after %u s rest:", rest_s);
    if (!s) {
        shell_print(sh, "  no saved state — fresh boot, SOC unknown");
        if (have_v) {
            float ocv_soc = ocv_to_soc(v_now);
            shell_print(sh, "  using OCV reading %.4f V → SOC %.2f %%",
                        (double)v_now, (double)ocv_soc);
        } else {
            shell_print(sh, "  no OCV reading available — defaulting to 50 %%");
        }
        return 0;
    }
    shell_print(sh, "  saved SOC = %.2f %%, saved Q = %.4f Ah",
                (double)s->soc_pct, (double)s->Q_estimate_ah);

    if (rest_s < REST_THRESHOLD_SEC) {
        shell_print(sh, "  rest %u s < threshold %u s → trust saved SOC",
                    rest_s, (unsigned)REST_THRESHOLD_SEC);
        shell_print(sh, "  active SOC = %.2f %%", (double)s->soc_pct);
    } else if (have_v) {
        float ocv_soc = ocv_to_soc(v_now);
        float blended = 0.3f * s->soc_pct + 0.7f * ocv_soc;
        shell_print(sh, "  rest %u s ≥ threshold %u s → recalibrate from OCV",
                    rest_s, (unsigned)REST_THRESHOLD_SEC);
        shell_print(sh, "  V terminal at rest = %.4f V → OCV-derived SOC = %.2f %%",
                    (double)v_now, (double)ocv_soc);
        shell_print(sh, "  blended SOC (0.3*saved + 0.7*OCV) = %.2f %%",
                    (double)blended);
        shell_print(sh, "  saved-vs-OCV diff = %+.2f %% (drift detector)",
                    (double)(s->soc_pct - ocv_soc));
    } else {
        shell_print(sh, "  rest long enough for OCV but no V given — keeping saved SOC");
    }
    return 0;
}

static int cmd_demo(const struct shell *sh, size_t a, char **v) {
    ARG_UNUSED(a); ARG_UNUSED(v);
    shell_print(sh, "");
    shell_print(sh, "════════════════════════════════════════════════════════");
    shell_print(sh, " Persistence + OCV recalibration demo");
    shell_print(sh, "════════════════════════════════════════════════════════");
    shell_print(sh, "");
    shell_print(sh, "Step 1: clear any prior state");
    bms_state_clear();
    shell_print(sh, "  → cleared.");
    shell_print(sh, "");
    shell_print(sh, "Step 2: simulate normal operation, save SOC=42%%, Q=1.78Ah");
    struct bms_persisted_state s = {0};
    s.soc_pct = 42.0f;
    s.Q_estimate_ah = 1.78f;
    s.v_rc = 0.012f;
    s.P_soc = 0.05f;
    s.P_Q = 0.001f;
    s.cycles_completed = 137;
    s.shutdown_uptime_ms = k_uptime_get();
    bms_state_set(&s);
    shell_print(sh, "  → saved.");
    shell_print(sh, "");
    shell_print(sh, "Step 3: simulate quick key-cycle (60s rest, no OCV needed)");
    shell_print(sh, "  → trust saved SOC");
    shell_print(sh, "  active SOC = 42.00 %% (unchanged)");
    shell_print(sh, "");
    shell_print(sh, "Step 4: simulate long rest (1 hour) + V_terminal = 3.732V");
    float ocv_soc = ocv_to_soc(3.732f);
    shell_print(sh, "  rest > threshold → use OCV");
    shell_print(sh, "  OCV-derived SOC = %.2f %%", (double)ocv_soc);
    shell_print(sh, "  saved SOC = 42.00 %%");
    shell_print(sh, "  drift = %+.2f %%", (double)(42.0f - ocv_soc));
    shell_print(sh, "  blended (0.3 saved + 0.7 OCV) = %.2f %%",
                (double)(0.3f * 42.0f + 0.7f * ocv_soc));
    shell_print(sh, "");
    shell_print(sh, "Step 5: simulate factory reset");
    bms_state_clear();
    shell_print(sh, "  → cleared. Next boot starts from scratch.");
    return 0;
}

SHELL_STATIC_SUBCMD_SET_CREATE(sub_persist,
    SHELL_CMD(info,  NULL, "Show saved BMS state",            cmd_info),
    SHELL_CMD_ARG(save,  NULL, "save <soc%> <Q_ah> [cycles]",
                  cmd_save, 3, 1),
    SHELL_CMD_ARG(load,  NULL, "load <rest_seconds> [V_now]",
                  cmd_load, 2, 1),
    SHELL_CMD(clear, NULL, "Erase saved state",                cmd_clear),
    SHELL_CMD(demo,  NULL, "Walk through the recalibration policy", cmd_demo),
    SHELL_SUBCMD_SET_END
);

SHELL_CMD_REGISTER(persist, &sub_persist,
                   "BMS state persistence + OCV recalibration", NULL);
```
