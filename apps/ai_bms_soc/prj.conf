## CMakeLists.txt
```
cmake_minimum_required(VERSION 3.20.0)

find_package(Zephyr REQUIRED HINTS $ENV{ZEPHYR_BASE})
project(ai_bms_soc LANGUAGES C CXX)

set(NO_THREADSAFE_STATICS $<TARGET_PROPERTY:compiler-cpp,no_threadsafe_statics>)
zephyr_compile_options($<$<COMPILE_LANGUAGE:CXX>:${NO_THREADSAFE_STATICS}>)

target_sources(app PRIVATE
    src/main.c
    src/cmd_soc.c
    src/soc_classical.c
    src/soc_ml.cpp
    src/soc_calib.cpp
    src/model_mlp.cpp
    src/model_lstm.cpp
    src/model_hybrid.cpp
)
```

## prj.conf
```kconfig
CONFIG_CPP=y
CONFIG_STD_CPP17=y
CONFIG_TENSORFLOW_LITE_MICRO=y
CONFIG_TENSORFLOW_LITE_MICRO_CMSIS_NN_KERNELS=y
CONFIG_REQUIRES_FLOAT_PRINTF=y
CONFIG_FPU=y
CONFIG_MAIN_STACK_SIZE=8192

CONFIG_GPIO=y

CONFIG_LOG=y
CONFIG_LOG_MODE_DEFERRED=y
CONFIG_LOG_BUFFER_SIZE=4096

CONFIG_SHELL=y
CONFIG_SHELL_BACKEND_SERIAL=y
CONFIG_SHELL_PROMPT_UART="g474> "
CONFIG_SHELL_HISTORY=y
CONFIG_SHELL_TAB=y
CONFIG_SHELL_TAB_AUTOCOMPLETION=y
CONFIG_SHELL_STACK_SIZE=8192

CONFIG_KERNEL_SHELL=y
CONFIG_DEVICE_SHELL=y
CONFIG_THREAD_MONITOR=y
CONFIG_THREAD_NAME=y
CONFIG_THREAD_STACK_INFO=y
CONFIG_INIT_STACKS=y
```

## src/main.c
```c
/*
 * ai_bms_soc — Six SOC estimators side-by-side on a Cortex-M4.
 *
 * 1. Coulomb counting     (classical baseline)
 * 2. OCV lookup           (classical, rest-state only)
 * 3. EKF + ECM            (classical production-grade)
 * 4. MLP                  (per-sample TinyML)
 * 5. LSTM                 (sequence TinyML)
 * 6. Hybrid EKF + MLP     (modern hybrid pattern)
 */

#include <zephyr/kernel.h>
#include <zephyr/drivers/gpio.h>
#include <zephyr/logging/log.h>

#include "soc_estimators.h"

LOG_MODULE_REGISTER(ai_bms_soc, LOG_LEVEL_INF);

#define LED0_NODE DT_ALIAS(led0)
static const struct gpio_dt_spec led = GPIO_DT_SPEC_GET(LED0_NODE, gpios);

int main(void)
{
    int rc;
    rc = soc_mlp_init();
    if (rc != 0) { LOG_ERR("MLP init: %d",    rc); return rc; }
    rc = soc_lstm_init();
    if (rc != 0) {
        LOG_ERR("LSTM init: %d (continuing — LSTM commands will return 0)", rc);
        /* Don't fail boot — let user run the other 5 estimators. */
    }
    rc = soc_hybrid_init();
    if (rc != 0) { LOG_ERR("Hybrid init: %d", rc); return rc; }

    LOG_INF("ai_bms_soc up — try `soc compare aged`, `soc benchall`, `soc info`");

    if (gpio_is_ready_dt(&led)) {
        gpio_pin_configure_dt(&led, GPIO_OUTPUT_INACTIVE);
        while (1) {
            gpio_pin_toggle_dt(&led);
            k_msleep(1000);
        }
    }
    return 0;
}
```

## src/cmd_soc.c
```c
/*
 * Shell command tree: `soc ...`
 *
 *   soc list                          — list embedded sample windows
 *   soc info                          — model + EKF param info
 *   soc compare <name>                — run all 6 estimators on one sample, table
 *   soc cycle <name> <method>         — single estimator on one sample
 *   soc bench <method> [iterations]   — latency for one estimator
 *   soc benchall                      — bench all 6 on the same sample
 */

#include <zephyr/kernel.h>
#include <zephyr/shell/shell.h>
#include <zephyr/sys/util.h>
#include <stdlib.h>
#include <string.h>
#include <math.h>

#include "soc_estimators.h"

static const struct soc_sample *find_sample(const char *name)
{
    for (unsigned i = 0; i < g_sample_count; ++i) {
        if (!strcmp(g_samples[i].name, name)) return &g_samples[i];
    }
    return NULL;
}

/* Aggregate all 6 estimators on one sample, return SOC for each */
struct estimates {
    float cc, ocv, ekf, mlp, lstm, hybrid;
};

static void run_all(const struct soc_sample *s, struct estimates *e)
{
    e->cc     = soc_cc_window(s, /*soc0=*/100.0f);
    /* OCV: use the last sample's voltage (not really fair — voltage is
     * depressed by IR drop during discharge — but that's the point. */
    e->ocv    = soc_ocv_lookup(s->v[SOC_WINDOW-1]);
    e->ekf    = soc_ekf_window(s, 100.0f);
    e->mlp    = soc_mlp_window(s);
    e->lstm   = soc_lstm_window(s);
    e->hybrid = soc_hybrid_window(s, 100.0f);
}

static int cmd_list(const struct shell *sh, size_t argc, char **argv)
{
    ARG_UNUSED(argc); ARG_UNUSED(argv);
    shell_print(sh, "%-7s %-7s %-9s %-9s %-9s",
                "name", "cell", "cap (Ah)", "SOC start", "SOC end");
    for (unsigned i = 0; i < g_sample_count; ++i) {
        const struct soc_sample *s = &g_samples[i];
        shell_print(sh, "%-7s %-7s %.4f    %.2f      %.2f",
                    s->name, s->cell, (double)s->capacity_ah,
                    (double)s->soc_true[0],
                    (double)s->soc_true[SOC_WINDOW-1]);
    }
    return 0;
}

static int cmd_info(const struct shell *sh, size_t argc, char **argv)
{
    ARG_UNUSED(argc); ARG_UNUSED(argv);
    shell_print(sh, "Embedded test cycles : %u (from B0018 holdout cell)", g_sample_count);
    shell_print(sh, "Window length        : %d samples", SOC_WINDOW);
    shell_print(sh, "");
    shell_print(sh, "Classical SOC stack:");
    shell_print(sh, "  ECM R0   = %.4f ohms", (double)g_ecm_R0);
    shell_print(sh, "  ECM R1   = %.4f ohms", (double)g_ecm_R1);
    shell_print(sh, "  ECM C1   = %.1f F  (tau=%.1fs)",
                (double)g_ecm_C1, (double)(g_ecm_R1*g_ecm_C1));
    shell_print(sh, "  Q nom    = %.4f Ah", (double)g_ecm_Qnom);
    shell_print(sh, "  OCV bins = %u (range %.3f..%.3f V)",
                g_sococv_n,
                (double)g_sococv_ocv[0],
                (double)g_sococv_ocv[g_sococv_n-1]);
    shell_print(sh, "");
    shell_print(sh, "ML stack:");
    shell_print(sh, "  MLP    arena = %u B", soc_mlp_arena_size());
    shell_print(sh, "  LSTM   arena = %u B", soc_lstm_arena_size());
    shell_print(sh, "  Hybrid arena = %u B", soc_hybrid_arena_size());
    return 0;
}

static void print_row(const struct shell *sh, const char *method,
                      float pred, float truth)
{
    float err = pred - truth;
    shell_print(sh, "  %-22s %7.2f %%   %+7.2f %%",
                method, (double)pred, (double)err);
}

static int cmd_compare(const struct shell *sh, size_t argc, char **argv)
{
    if (argc != 2) {
        shell_error(sh, "usage: soc compare <name>");
        return -EINVAL;
    }
    const struct soc_sample *s = find_sample(argv[1]);
    if (!s) {
        shell_error(sh, "unknown sample '%s' (try `soc list`)", argv[1]);
        return -EINVAL;
    }
    float truth = s->soc_true[SOC_WINDOW-1];
    struct estimates e;
    run_all(s, &e);
    shell_print(sh, "");
    shell_print(sh, "Sample: %s (%s)  capacity=%.4f Ah",
                s->name, s->cell, (double)s->capacity_ah);
    shell_print(sh, "True end-of-window SOC: %.2f %%", (double)truth);
    shell_print(sh, "");
    shell_print(sh, "  %-22s %-9s %-9s",
                "method", "predicted", "error");
    shell_print(sh, "  ──────────────────────────────────────────────────");
    print_row(sh, "1. coulomb counting",   e.cc,     truth);
    print_row(sh, "2. OCV lookup",          e.ocv,    truth);
    print_row(sh, "3. EKF (3-state ECM)",   e.ekf,    truth);
    print_row(sh, "4. MLP (per-sample)",    e.mlp,    truth);
    print_row(sh, "5. LSTM (sequence)",     e.lstm,   truth);
    print_row(sh, "6. Hybrid EKF + MLP",    e.hybrid, truth);
    return 0;
}

static int cmd_cycle(const struct shell *sh, size_t argc, char **argv)
{
    if (argc != 3) {
        shell_error(sh, "usage: soc cycle <name> <method>");
        shell_error(sh, "       method: cc | ocv | ekf | mlp | lstm | hybrid");
        return -EINVAL;
    }
    const struct soc_sample *s = find_sample(argv[1]);
    if (!s) { shell_error(sh, "unknown sample '%s'", argv[1]); return -EINVAL; }
    float pred = NAN;
    if      (!strcmp(argv[2], "cc"))     pred = soc_cc_window(s, 100.0f);
    else if (!strcmp(argv[2], "ocv"))    pred = soc_ocv_lookup(s->v[SOC_WINDOW-1]);
    else if (!strcmp(argv[2], "ekf"))    pred = soc_ekf_window(s, 100.0f);
    else if (!strcmp(argv[2], "mlp"))    pred = soc_mlp_window(s);
    else if (!strcmp(argv[2], "lstm"))   pred = soc_lstm_window(s);
    else if (!strcmp(argv[2], "hybrid")) pred = soc_hybrid_window(s, 100.0f);
    else { shell_error(sh, "unknown method '%s'", argv[2]); return -EINVAL; }
    float truth = s->soc_true[SOC_WINDOW-1];
    shell_print(sh, "%-7s %-7s  predicted=%.2f %%  true=%.2f %%  error=%+.2f %%",
                s->name, argv[2],
                (double)pred, (double)truth, (double)(pred - truth));
    return 0;
}

static int cmd_bench(const struct shell *sh, size_t argc, char **argv)
{
    if (argc < 2 || argc > 3) {
        shell_error(sh, "usage: soc bench <method> [iterations]");
        return -EINVAL;
    }
    uint32_t n = (argc == 3) ? (uint32_t)strtoul(argv[2], NULL, 10) : 1000U;
    if (!n) n = 1000;
    const struct soc_sample *s = &g_samples[0];

    /* Pre-warm */
    for (int i = 0; i < 4; ++i) {
        if      (!strcmp(argv[1], "cc"))     soc_cc_window(s, 100.0f);
        else if (!strcmp(argv[1], "ocv"))    soc_ocv_lookup(s->v[0]);
        else if (!strcmp(argv[1], "ekf"))    soc_ekf_window(s, 100.0f);
        else if (!strcmp(argv[1], "mlp"))    soc_mlp_window(s);
        else if (!strcmp(argv[1], "lstm"))   soc_lstm_window(s);
        else if (!strcmp(argv[1], "hybrid")) soc_hybrid_window(s, 100.0f);
        else { shell_error(sh, "unknown method '%s'", argv[1]); return -EINVAL; }
    }

    uint32_t cyc_per_us = sys_clock_hw_cycles_per_sec() / 1000000U;
    uint32_t mn = UINT32_MAX, mx = 0;
    uint64_t total = 0;
    for (uint32_t k = 0; k < n; ++k) {
        uint32_t t0 = k_cycle_get_32();
        if      (!strcmp(argv[1], "cc"))     soc_cc_window(s, 100.0f);
        else if (!strcmp(argv[1], "ocv"))    soc_ocv_lookup(s->v[0]);
        else if (!strcmp(argv[1], "ekf"))    soc_ekf_window(s, 100.0f);
        else if (!strcmp(argv[1], "mlp"))    soc_mlp_window(s);
        else if (!strcmp(argv[1], "lstm"))   soc_lstm_window(s);
        else                                  soc_hybrid_window(s, 100.0f);
        uint32_t dt = k_cycle_get_32() - t0;
        total += dt;
        if (dt < mn) mn = dt;
        if (dt > mx) mx = dt;
    }
    uint32_t avg = (uint32_t)(total / n);
    shell_print(sh, "%s: avg=%u cyc (%u.%03u us)  min=%u  max=%u  ~%u/sec",
                argv[1],
                avg, avg / cyc_per_us, (avg * 1000U / cyc_per_us) % 1000U,
                mn, mx,
                (uint32_t)(sys_clock_hw_cycles_per_sec() / avg));
    return 0;
}

static int cmd_benchall(const struct shell *sh, size_t argc, char **argv)
{
    ARG_UNUSED(argc); ARG_UNUSED(argv);
    const char *methods[] = {"cc", "ocv", "ekf", "mlp", "lstm", "hybrid"};
    for (size_t i = 0; i < ARRAY_SIZE(methods); ++i) {
        char arg1[16];
        char arg2[8];
        strncpy(arg1, methods[i], sizeof(arg1));
        strncpy(arg2, "200", sizeof(arg2));
        char *argv2[] = {(char*)"bench", arg1, arg2};
        cmd_bench(sh, 3, argv2);
    }
    return 0;
}

SHELL_STATIC_SUBCMD_SET_CREATE(sub_soc,
    SHELL_CMD(list,    NULL, "List embedded test windows",   cmd_list),
    SHELL_CMD(info,    NULL, "EKF + ML stack info",          cmd_info),
    SHELL_CMD_ARG(compare, NULL, "soc compare <name> — run all 6 estimators",
                  cmd_compare, 2, 0),
    SHELL_CMD_ARG(cycle, NULL, "soc cycle <name> <method>",
                  cmd_cycle, 3, 0),
    SHELL_CMD_ARG(bench, NULL, "soc bench <method> [iterations]",
                  cmd_bench, 2, 1),
    SHELL_CMD(benchall, NULL, "Bench all 6 estimators",      cmd_benchall),
    SHELL_SUBCMD_SET_END
);

SHELL_CMD_REGISTER(soc, &sub_soc,
                   "SOC estimation — 6 techniques head-to-head", NULL);
```

## src/model_hybrid.cpp
```c
/* Generated — DO NOT EDIT */
#include "model_hybrid.hpp"

alignas(8) const unsigned char g_model_hybrid[2816] = {
    0x1c, 0x00, 0x00, 0x00, 0x54, 0x46, 0x4c, 0x33, 0x14, 0x00, 0x20, 0x00,
    0x1c, 0x00, 0x18, 0x00, 0x14, 0x00, 0x10, 0x00, 0x0c, 0x00, 0x00, 0x00,
    0x08, 0x00, 0x04, 0x00, 0x14, 0x00, 0x00, 0x00, 0x1c, 0x00, 0x00, 0x00,
    0x98, 0x00, 0x00, 0x00, 0xf0, 0x00, 0x00, 0x00, 0x88, 0x02, 0x00, 0x00,
    0x98, 0x02, 0x00, 0x00, 0xa8, 0x0a, 0x00, 0x00, 0x03, 0x00, 0x00, 0x00,
    0x01, 0x00, 0x00, 0x00, 0x10, 0x00, 0x00, 0x00, 0x00, 0x00, 0x0a, 0x00,
    0x10, 0x00, 0x0c, 0x00, 0x08, 0x00, 0x04, 0x00, 0x0a, 0x00, 0x00, 0x00,
    0x0c, 0x00, 0x00, 0x00, 0x1c, 0x00, 0x00, 0x00, 0x3c, 0x00, 0x00, 0x00,
    0x0f, 0x00, 0x00, 0x00, 0x73, 0x65, 0x72, 0x76, 0x69, 0x6e, 0x67, 0x5f,
    0x64, 0x65, 0x66, 0x61, 0x75, 0x6c, 0x74, 0x00, 0x01, 0x00, 0x00, 0x00,
    0x04, 0x00, 0x00, 0x00, 0x90, 0xff, 0xff, 0xff, 0x09, 0x00, 0x00, 0x00,
    0x04, 0x00, 0x00, 0x00, 0x08, 0x00, 0x00, 0x00, 0x6f, 0x75, 0x74, 0x70,
    0x75, 0x74, 0x5f, 0x30, 0x00, 0x00, 0x00, 0x00, 0x01, 0x00, 0x00, 0x00,
    0x04, 0x00, 0x00, 0x00, 0x0a, 0xfe, 0xff, 0xff, 0x04, 0x00, 0x00, 0x00,
    0x0e, 0x00, 0x00, 0x00, 0x6b, 0x65, 0x72, 0x61, 0x73, 0x5f, 0x74, 0x65,
    0x6e, 0x73, 0x6f, 0x72, 0x5f, 0x38, 0x00, 0x00, 0x02, 0x00, 0x00, 0x00,
    0x34, 0x00, 0x00, 0x00, 0x04, 0x00, 0x00, 0x00, 0xdc, 0xff, 0xff, 0xff,
    0x0c, 0x00, 0x00, 0x00, 0x04, 0x00, 0x00, 0x00, 0x13, 0x00, 0x00, 0x00,
    0x43, 0x4f, 0x4e, 0x56, 0x45, 0x52, 0x53, 0x49, 0x4f, 0x4e, 0x5f, 0x4d,
    0x45, 0x54, 0x41, 0x44, 0x41, 0x54, 0x41, 0x00, 0x08, 0x00, 0x0c, 0x00,
    0x08, 0x00, 0x04, 0x00, 0x08, 0x00, 0x00, 0x00, 0x0b, 0x00, 0x00, 0x00,
    0x04, 0x00, 0x00, 0x00, 0x13, 0x00, 0x00, 0x00, 0x6d, 0x69, 0x6e, 0x5f,
    0x72, 0x75, 0x6e, 0x74, 0x69, 0x6d, 0x65, 0x5f, 0x76, 0x65, 0x72, 0x73,
    0x69, 0x6f, 0x6e, 0x00, 0x0d, 0x00, 0x00, 0x00, 0x94, 0x01, 0x00, 0x00,
    0x8c, 0x01, 0x00, 0x00, 0x78, 0x01, 0x00, 0x00, 0x5c, 0x01, 0x00, 0x00,
    0x3c, 0x01, 0x00, 0x00, 0x0c, 0x01, 0x00, 0x00, 0xdc, 0x00, 0x00, 0x00,
    0xac, 0x00, 0x00, 0x00, 0xa4, 0x00, 0x00, 0x00, 0x9c, 0x00, 0x00, 0x00,
    0x94, 0x00, 0x00, 0x00, 0x74, 0x00, 0x00, 0x00, 0x04, 0x00, 0x00, 0x00,
    0xba, 0xfe, 0xff, 0xff, 0x04, 0x00, 0x00, 0x00, 0x60, 0x00, 0x00, 0x00,
    0x0c, 0x00, 0x00, 0x00, 0x08, 0x00, 0x0e, 0x00, 0x08, 0x00, 0x04, 0x00,
    0x08, 0x00, 0x00, 0x00, 0x10, 0x00, 0x00, 0x00, 0x28, 0x00, 0x00, 0x00,
    0x00, 0x00, 0x06, 0x00, 0x08, 0x00, 0x04, 0x00, 0x06, 0x00, 0x00, 0x00,
    0x04, 0x00, 0x00, 0x00, 0x01, 0x00, 0x00, 0x00, 0xeb, 0x03, 0x00, 0x00,
    0x0c, 0x00, 0x18, 0x00, 0x14, 0x00, 0x10, 0x00, 0x0c, 0x00, 0x04, 0x00,
    0x0c, 0x00, 0x00, 0x00, 0x88, 0x0c, 0xde, 0x74, 0x2b, 0x93, 0x57, 0x7e,
    0x02, 0x00, 0x00, 0x00, 0x02, 0x00, 0x00, 0x00, 0x04, 0x00, 0x00, 0x00,
    0x06, 0x00, 0x00, 0x00, 0x32, 0x2e, 0x32, 0x31, 0x2e, 0x30, 0x00, 0x00,
    0x26, 0xff, 0xff, 0xff, 0x04, 0x00, 0x00, 0x00, 0x10, 0x00, 0x00, 0x00,
    0x31, 0x2e, 0x31, 0x34, 0x2e, 0x30, 0x00, 0x00, 0x00, 0x00, 0x00, 0x00,
    0x00, 0x00, 0x00, 0x00, 0xb0, 0xfe, 0xff, 0xff, 0xb4, 0xfe, 0xff, 0xff,
    0xb8, 0xfe, 0xff, 0xff, 0x4e, 0xff, 0xff, 0xff, 0x04, 0x00, 0x00, 0x00,
    0x20, 0x00, 0x00, 0x00, 0x35, 0x9d, 0x81, 0x6a, 0xb2, 0x4c, 0xe5, 0x81,
    0xe0, 0x00, 0x7f, 0xd9, 0x81, 0xd4, 0x1c, 0x1b, 0xc1, 0xef, 0xb4, 0x81,
    0x0b, 0xd1, 0x29, 0x7f, 0x1a, 0x81, 0xe6, 0x57, 0xeb, 0x41, 0x7f, 0x26,
    0x7a, 0xff, 0xff, 0xff, 0x04, 0x00, 0x00, 0x00, 0x20, 0x00, 0x00, 0x00,
    0x94, 0x13, 0x00, 0x00, 0x00, 0x00, 0x00, 0x00, 0x6b, 0x07, 0x00, 0x00,
    0x3c, 0x3a, 0x00, 0x00, 0x00, 0x00, 0x00, 0x00, 0x43, 0x1b, 0x00, 0x00,
    0x7d, 0x17, 0x00, 0x00, 0x5c, 0x1b, 0x00, 0x00, 0xa6, 0xff, 0xff, 0xff,
    0x04, 0x00, 0x00, 0x00, 0x20, 0x00, 0x00, 0x00, 0x7f, 0xfc, 0x57, 0x0a,
    0xb3, 0xa8, 0x5d, 0xbf, 0xc4, 0xb0, 0x54, 0x7f, 0x30, 0xcb, 0x53, 0xe8,
    0x2c, 0xe5, 0xc0, 0x67, 0x21, 0x44, 0x54, 0x7f, 0x47, 0x32, 0x57, 0x8a,
    0xfb, 0x81, 0x89, 0x26, 0xd2, 0xff, 0xff, 0xff, 0x04, 0x00, 0x00, 0x00,
    0x10, 0x00, 0x00, 0x00, 0x45, 0xf6, 0xff, 0xff, 0xbb, 0x05, 0x00, 0x00,
    0xf3, 0x11, 0x00, 0x00, 0x00, 0x00, 0x00, 0x00, 0xee, 0xff, 0xff, 0xff,
    0x04, 0x00, 0x00, 0x00, 0x04, 0x00, 0x00, 0x00, 0x7f, 0x25, 0xcb, 0x51,
    0x00, 0x00, 0x06, 0x00, 0x08, 0x00, 0x04, 0x00, 0x06, 0x00, 0x00, 0x00,
    0x04, 0x00, 0x00, 0x00, 0x04, 0x00, 0x00, 0x00, 0xbf, 0xfa, 0xff, 0xff,
    0x84, 0xff, 0xff, 0xff, 0x88, 0xff, 0xff, 0xff, 0x0f, 0x00, 0x00, 0x00,
    0x4d, 0x4c, 0x49, 0x52, 0x20, 0x43, 0x6f, 0x6e, 0x76, 0x65, 0x72, 0x74,
    0x65, 0x64, 0x2e, 0x00, 0x01, 0x00, 0x00, 0x00, 0x14, 0x00, 0x00, 0x00,
    0x00, 0x00, 0x0e, 0x00, 0x18, 0x00, 0x14, 0x00, 0x10, 0x00, 0x0c, 0x00,
    0x08, 0x00, 0x04, 0x00, 0x0e, 0x00, 0x00, 0x00, 0x14, 0x00, 0x00, 0x00,
    0x1c, 0x00, 0x00, 0x00, 0xec, 0x00, 0x00, 0x00, 0xf0, 0x00, 0x00, 0x00,
    0xf4, 0x00, 0x00, 0x00, 0x04, 0x00, 0x00, 0x00, 0x6d, 0x61, 0x69, 0x6e,
    0x00, 0x00, 0x00, 0x00, 0x03, 0x00, 0x00, 0x00, 0x94, 0x00, 0x00, 0x00,
    0x4c, 0x00, 0x00, 0x00, 0x04, 0x00, 0x00, 0x00, 0xca, 0xff, 0xff, 0xff,
    0x14, 0x00, 0x00, 0x00, 0x00, 0x00, 0x00, 0x08, 0x10, 0x00, 0x00, 0x00,
    0x14, 0x00, 0x00, 0x00, 0x04, 0x00, 0x04, 0x00, 0x04, 0x00, 0x00, 0x00,
    0x01, 0x00, 0x00, 0x00, 0x09, 0x00, 0x00, 0x00, 0x03, 0x00, 0x00, 0x00,
    0x08, 0x00, 0x00, 0x00, 0x02, 0x00, 0x00, 0x00, 0x01, 0x00, 0x00, 0x00,
    0x00, 0x00, 0x0e, 0x00, 0x14, 0x00, 0x00, 0x00, 0x10, 0x00, 0x0c, 0x00,
    0x0b, 0x00, 0x04, 0x00, 0x0e, 0x00, 0x00, 0x00, 0x10, 0x00, 0x00, 0x00,
    0x00, 0x00, 0x00, 0x08, 0x10, 0x00, 0x00, 0x00, 0x14, 0x00, 0x00, 0x00,
    0xba, 0xff, 0xff, 0xff, 0x00, 0x00, 0x00, 0x01, 0x01, 0x00, 0x00, 0x00,
    0x08, 0x00, 0x00, 0x00, 0x03, 0x00, 0x00, 0x00, 0x07, 0x00, 0x00, 0x00,
    0x04, 0x00, 0x00, 0x00, 0x03, 0x00, 0x00, 0x00, 0x00, 0x00, 0x0e, 0x00,
    0x16, 0x00, 0x00, 0x00, 0x10, 0x00, 0x0c, 0x00, 0x0b, 0x00, 0x04, 0x00,
    0x0e, 0x00, 0x00, 0x00, 0x18, 0x00, 0x00, 0x00, 0x00, 0x00, 0x00, 0x08,
    0x18, 0x00, 0x00, 0x00, 0x1c, 0x00, 0x00, 0x00, 0x00, 0x00, 0x06, 0x00,
    0x08, 0x00, 0x07, 0x00, 0x06, 0x00, 0x00, 0x00, 0x00, 0x00, 0x00, 0x01,
    0x01, 0x00, 0x00, 0x00, 0x07, 0x00, 0x00, 0x00, 0x03, 0x00, 0x00, 0x00,
    0x00, 0x00, 0x00, 0x00, 0x06, 0x00, 0x00, 0x00, 0x05, 0x00, 0x00, 0x00,
    0x01, 0x00, 0x00, 0x00, 0x09, 0x00, 0x00, 0x00, 0x01, 0x00, 0x00, 0x00,
    0x00, 0x00, 0x00, 0x00, 0x0a, 0x00, 0x00, 0x00, 0x64, 0x06, 0x00, 0x00,
    0xdc, 0x05, 0x00, 0x00, 0x48, 0x05, 0x00, 0x00, 0x84, 0x04, 0x00, 0x00,
    0xe8, 0x03, 0x00, 0x00, 0xf4, 0x02, 0x00, 0x00, 0x28, 0x02, 0x00, 0x00,
    0x54, 0x01, 0x00, 0x00, 0x80, 0x00, 0x00, 0x00, 0x04, 0x00, 0x00, 0x00,
    0xda, 0xf9, 0xff, 0xff, 0x00, 0x00, 0x00, 0x01, 0x18, 0x00, 0x00, 0x00,
    0x20, 0x00, 0x00, 0x00, 0x3c, 0x00, 0x00, 0x00, 0x0a, 0x00, 0x00, 0x00,
    0x00, 0x00, 0x00, 0x09, 0x50, 0x00, 0x00, 0x00, 0x02, 0x00, 0x00, 0x00,
    0xff, 0xff, 0xff, 0xff, 0x01, 0x00, 0x00, 0x00, 0xc4, 0xf9, 0xff, 0xff,
    0x08, 0x00, 0x00, 0x00, 0x10, 0x00, 0x00, 0x00, 0x01, 0x00, 0x00, 0x00,
    0x7a, 0x00, 0x00, 0x00, 0x00, 0x00, 0x00, 0x00, 0x01, 0x00, 0x00, 0x00,
    0x0a, 0x6e, 0x02, 0x3c, 0x1b, 0x00, 0x00, 0x00, 0x53, 0x74, 0x61, 0x74,
    0x65, 0x66, 0x75, 0x6c, 0x50, 0x61, 0x72, 0x74, 0x69, 0x74, 0x69, 0x6f,
    0x6e, 0x65, 0x64, 0x43, 0x61, 0x6c, 0x6c, 0x5f, 0x31, 0x3a, 0x30, 0x00,
    0x02, 0x00, 0x00, 0x00, 0x01, 0x00, 0x00, 0x00, 0x01, 0x00, 0x00, 0x00,
    0x52, 0xfa, 0xff, 0xff, 0x00, 0x00, 0x00, 0x01, 0x18, 0x00, 0x00, 0x00,
    0x20, 0x00, 0x00, 0x00, 0x3c, 0x00, 0x00, 0x00, 0x09, 0x00, 0x00, 0x00,
    0x00, 0x00, 0x00, 0x09, 0xa8, 0x00, 0x00, 0x00, 0x02, 0x00, 0x00, 0x00,
    0xff, 0xff, 0xff, 0xff, 0x04, 0x00, 0x00, 0x00, 0x3c, 0xfa, 0xff, 0xff,
    0x08, 0x00, 0x00, 0x00, 0x10, 0x00, 0x00, 0x00, 0x01, 0x00, 0x00, 0x00,
    0x80, 0xff, 0xff, 0xff, 0xff, 0xff, 0xff, 0xff, 0x01, 0x00, 0x00, 0x00,
    0xde, 0xb1, 0x98, 0x3c, 0x73, 0x00, 0x00, 0x00, 0x73, 0x6f, 0x63, 0x5f,
    0x68, 0x79, 0x62, 0x72, 0x69, 0x64, 0x5f, 0x72, 0x65, 0x73, 0x69, 0x64,
    0x75, 0x61, 0x6c, 0x5f, 0x31, 0x2f, 0x64, 0x65, 0x6e, 0x73, 0x65, 0x5f,
    0x36, 0x5f, 0x31, 0x2f, 0x4d, 0x61, 0x74, 0x4d, 0x75, 0x6c, 0x3b, 0x73,
    0x6f, 0x63, 0x5f, 0x68, 0x79, 0x62, 0x72, 0x69, 0x64, 0x5f, 0x72, 0x65,
    0x73, 0x69, 0x64, 0x75, 0x61, 0x6c, 0x5f, 0x31, 0x2f, 0x64, 0x65, 0x6e,
    0x73, 0x65, 0x5f, 0x36, 0x5f, 0x31, 0x2f, 0x52, 0x65, 0x6c, 0x75, 0x3b,
    0x73, 0x6f, 0x63, 0x5f, 0x68, 0x79, 0x62, 0x72, 0x69, 0x64, 0x5f, 0x72,
    0x65, 0x73, 0x69, 0x64, 0x75, 0x61, 0x6c, 0x5f, 0x31, 0x2f, 0x64, 0x65,
    0x6e, 0x73, 0x65, 0x5f, 0x36, 0x5f, 0x31, 0x2f, 0x42, 0x69, 0x61, 0x73,
    0x41, 0x64, 0x64, 0x00, 0x02, 0x00, 0x00, 0x00, 0x01, 0x00, 0x00, 0x00,
    0x04, 0x00, 0x00, 0x00, 0x22, 0xfb, 0xff, 0xff, 0x00, 0x00, 0x00, 0x01,
    0x18, 0x00, 0x00, 0x00, 0x20, 0x00, 0x00, 0x00, 0x3c, 0x00, 0x00, 0x00,
    0x08, 0x00, 0x00, 0x00, 0x00, 0x00, 0x00, 0x09, 0xa8, 0x00, 0x00, 0x00,
    0x02, 0x00, 0x00, 0x00, 0xff, 0xff, 0xff, 0xff, 0x08, 0x00, 0x00, 0x00,
    0x0c, 0xfb, 0xff, 0xff, 0x08, 0x00, 0x00, 0x00, 0x10, 0x00, 0x00, 0x00,
    0x01, 0x00, 0x00, 0x00, 0x80, 0xff, 0xff, 0xff, 0xff, 0xff, 0xff, 0xff,
    0x01, 0x00, 0x00, 0x00, 0x5c, 0x6f, 0x07, 0x3c, 0x73, 0x00, 0x00, 0x00,
    0x73, 0x6f, 0x63, 0x5f, 0x68, 0x79, 0x62, 0x72, 0x69, 0x64, 0x5f, 0x72,
    0x65, 0x73, 0x69, 0x64, 0x75, 0x61, 0x6c, 0x5f, 0x31, 0x2f, 0x64, 0x65,
    0x6e, 0x73, 0x65, 0x5f, 0x35, 0x5f, 0x31, 0x2f, 0x4d, 0x61, 0x74, 0x4d,
    0x75, 0x6c, 0x3b, 0x73, 0x6f, 0x63, 0x5f, 0x68, 0x79, 0x62, 0x72, 0x69,
    0x64, 0x5f, 0x72, 0x65, 0x73, 0x69, 0x64, 0x75, 0x61, 0x6c, 0x5f, 0x31,
    0x2f, 0x64, 0x65, 0x6e, 0x73, 0x65, 0x5f, 0x35, 0x5f, 0x31, 0x2f, 0x52,
    0x65, 0x6c, 0x75, 0x3b, 0x73, 0x6f, 0x63, 0x5f, 0x68, 0x79, 0x62, 0x72,
    0x69, 0x64, 0x5f, 0x72, 0x65, 0x73, 0x69, 0x64, 0x75, 0x61, 0x6c, 0x5f,
    0x31, 0x2f, 0x64, 0x65, 0x6e, 0x73, 0x65, 0x5f, 0x35, 0x5f, 0x31, 0x2f,
    0x42, 0x69, 0x61, 0x73, 0x41, 0x64, 0x64, 0x00, 0x02, 0x00, 0x00, 0x00,
    0x01, 0x00, 0x00, 0x00, 0x08, 0x00, 0x00, 0x00, 0x76, 0xfc, 0xff, 0xff,
    0x00, 0x00, 0x00, 0x01, 0x14, 0x00, 0x00, 0x00, 0x84, 0x00, 0x00, 0x00,
    0x07, 0x00, 0x00, 0x00, 0x00, 0x00, 0x00, 0x09, 0xa4, 0x00, 0x00, 0x00,
    0xcc, 0xfb, 0xff, 0xff, 0x08, 0x00, 0x00, 0x00, 0x48, 0x00, 0x00, 0x00,
    0x08, 0x00, 0x00, 0x00, 0x00, 0x00, 0x00, 0x00, 0x00, 0x00, 0x00, 0x00,
    0x00, 0x00, 0x00, 0x00, 0x00, 0x00, 0x00, 0x00, 0x00, 0x00, 0x00, 0x00,
    0x00, 0x00, 0x00, 0x00, 0x00, 0x00, 0x00, 0x00, 0x00, 0x00, 0x00, 0x00,
    0x00, 0x00, 0x00, 0x00, 0x00, 0x00, 0x00, 0x00, 0x00, 0x00, 0x00, 0x00,
    0x00, 0x00, 0x00, 0x00, 0x00, 0x00, 0x00, 0x00, 0x00, 0x00, 0x00, 0x00,
    0x00, 0x00, 0x00, 0x00, 0x00, 0x00, 0x00, 0x00, 0x08, 0x00, 0x00, 0x00,
    0xd7, 0xbd, 0xd4, 0x3b, 0x79, 0x44, 0x84, 0x3b, 0x2d, 0xb6, 0x02, 0x3c,
    0x3f, 0x4f, 0xbd, 0x3b, 0xa7, 0x57, 0xa3, 0x3b, 0x3b, 0x42, 0x0d, 0x3c,
    0xdf, 0x04, 0xf0, 0x3b, 0x75, 0x29, 0x01, 0x3c, 0x26, 0x00, 0x00, 0x00,
    0x73, 0x6f, 0x63, 0x5f, 0x68, 0x79, 0x62, 0x72, 0x69, 0x64, 0x5f, 0x72,
    0x65, 0x73, 0x69, 0x64, 0x75, 0x61, 0x6c, 0x5f, 0x31, 0x2f, 0x64, 0x65,
    0x6e, 0x73, 0x65, 0x5f, 0x35, 0x5f, 0x31, 0x2f, 0x4d, 0x61, 0x74, 0x4d,
    0x75, 0x6c, 0x00, 0x00, 0x02, 0x00, 0x00, 0x00, 0x08, 0x00, 0x00, 0x00,
    0x04, 0x00, 0x00, 0x00, 0x3e, 0xfd, 0xff, 0xff, 0x00, 0x00, 0x00, 0x01,
    0x14, 0x00, 0x00, 0x00, 0x88, 0x00, 0x00, 0x00, 0x06, 0x00, 0x00, 0x00,
    0x00, 0x00, 0x00, 0x02, 0xd0, 0x00, 0x00, 0x00, 0x94, 0xfc, 0xff, 0xff,
    0x08, 0x00, 0x00, 0x00, 0x4c, 0x00, 0x00, 0x00, 0x08, 0x00, 0x00, 0x00,
    0x00, 0x00, 0x00, 0x00, 0x00, 0x00, 0x00, 0x00, 0x00, 0x00, 0x00, 0x00,
    0x00, 0x00, 0x00, 0x00, 0x00, 0x00, 0x00, 0x00, 0x00, 0x00, 0x00, 0x00,
    0x00, 0x00, 0x00, 0x00, 0x00, 0x00, 0x00, 0x00, 0x00, 0x00, 0x00, 0x00,
    0x00, 0x00, 0x00, 0x00, 0x00, 0x00, 0x00, 0x00, 0x00, 0x00, 0x00, 0x00,
    0x00, 0x00, 0x00, 0x00, 0x00, 0x00, 0x00, 0x00, 0x00, 0x00, 0x00, 0x00,
    0x00, 0x00, 0x00, 0x00, 0x00, 0x00, 0x00, 0x00, 0x08, 0x00, 0x00, 0x00,
    0x81, 0xae, 0x3d, 0x38, 0x67, 0xdc, 0xeb, 0x37, 0x28, 0x16, 0x69, 0x38,
    0x1f, 0xca, 0x28, 0x38, 0x17, 0xa3, 0x11, 0x38, 0xed, 0xe4, 0x7b, 0x38,
    0x9e, 0x00, 0x56, 0x38, 0xb9, 0x52, 0x66, 0x38, 0x4c, 0x00, 0x00, 0x00,
    0x73, 0x6f, 0x63, 0x5f, 0x68, 0x79, 0x62, 0x72, 0x69, 0x64, 0x5f, 0x72,
    0x65, 0x73, 0x69, 0x64, 0x75, 0x61, 0x6c, 0x5f, 0x31, 0x2f, 0x64, 0x65,
    0x6e, 0x73, 0x65, 0x5f, 0x35, 0x5f, 0x31, 0x2f, 0x52, 0x65, 0x6c, 0x75,
    0x3b, 0x73, 0x6f, 0x63, 0x5f, 0x68, 0x79, 0x62, 0x72, 0x69, 0x64, 0x5f,
    0x72, 0x65, 0x73, 0x69, 0x64, 0x75, 0x61, 0x6c, 0x5f, 0x31, 0x2f, 0x64,
    0x65, 0x6e, 0x73, 0x65, 0x5f, 0x35, 0x5f, 0x31, 0x2f, 0x42, 0x69, 0x61,
    0x73, 0x41, 0x64, 0x64, 0x00, 0x00, 0x00, 0x00, 0x01, 0x00, 0x00, 0x00,
    0x08, 0x00, 0x00, 0x00, 0x2e, 0xfe, 0xff, 0xff, 0x00, 0x00, 0x00, 0x01,
    0x14, 0x00, 0x00, 0x00, 0x54, 0x00, 0x00, 0x00, 0x05, 0x00, 0x00, 0x00,
    0x00, 0x00, 0x00, 0x09, 0x74, 0x00, 0x00, 0x00, 0x84, 0xfd, 0xff, 0xff,
    0x08, 0x00, 0x00, 0x00, 0x28, 0x00, 0x00, 0x00, 0x04, 0x00, 0x00, 0x00,
    0x00, 0x00, 0x00, 0x00, 0x00, 0x00, 0x00, 0x00, 0x00, 0x00, 0x00, 0x00,
    0x00, 0x00, 0x00, 0x00, 0x00, 0x00, 0x00, 0x00, 0x00, 0x00, 0x00, 0x00,
    0x00, 0x00, 0x00, 0x00, 0x00, 0x00, 0x00, 0x00, 0x04, 0x00, 0x00, 0x00,
    0x94, 0xf6, 0xd1, 0x3b, 0xbc, 0x20, 0xed, 0x3b, 0xd5, 0xf7, 0x0b, 0x3c,
    0xaa, 0x2e, 0x7f, 0x3b, 0x26, 0x00, 0x00, 0x00, 0x73, 0x6f, 0x63, 0x5f,
    0x68, 0x79, 0x62, 0x72, 0x69, 0x64, 0x5f, 0x72, 0x65, 0x73, 0x69, 0x64,
    0x75, 0x61, 0x6c, 0x5f, 0x31, 0x2f, 0x64, 0x65, 0x6e, 0x73, 0x65, 0x5f,
    0x36, 0x5f, 0x31, 0x2f, 0x4d, 0x61, 0x74, 0x4d, 0x75, 0x6c, 0x00, 0x00,
    0x02, 0x00, 0x00, 0x00, 0x04, 0x00, 0x00, 0x00, 0x08, 0x00, 0x00, 0x00,
    0xc6, 0xfe, 0xff, 0xff, 0x00, 0x00, 0x00, 0x01, 0x14, 0x00, 0x00, 0x00,
    0x58, 0x00, 0x00, 0x00, 0x04, 0x00, 0x00, 0x00, 0x00, 0x00, 0x00, 0x02,
    0xa0, 0x00, 0x00, 0x00, 0x1c, 0xfe, 0xff, 0xff, 0x08, 0x00, 0x00, 0x00,
    0x2c, 0x00, 0x00, 0x00, 0x04, 0x00, 0x00, 0x00, 0x00, 0x00, 0x00, 0x00,
    0x00, 0x00, 0x00, 0x00, 0x00, 0x00, 0x00, 0x00, 0x00, 0x00, 0x00, 0x00,
    0x00, 0x00, 0x00, 0x00, 0x00, 0x00, 0x00, 0x00, 0x00, 0x00, 0x00, 0x00,
    0x00, 0x00, 0x00, 0x00, 0x00, 0x00, 0x00, 0x00, 0x04, 0x00, 0x00, 0x00,
    0xbb, 0x28, 0x5e, 0x38, 0xd3, 0xe6, 0x7a, 0x38, 0x28, 0x19, 0x94, 0x38,
    0x9d, 0x00, 0x07, 0x38, 0x4c, 0x00, 0x00, 0x00, 0x73, 0x6f, 0x63, 0x5f,
    0x68, 0x79, 0x62, 0x72, 0x69, 0x64, 0x5f, 0x72, 0x65, 0x73, 0x69, 0x64,
    0x75, 0x61, 0x6c, 0x5f, 0x31, 0x2f, 0x64, 0x65, 0x6e, 0x73, 0x65, 0x5f,
    0x36, 0x5f, 0x31, 0x2f, 0x52, 0x65, 0x6c, 0x75, 0x3b, 0x73, 0x6f, 0x63,
    0x5f, 0x68, 0x79, 0x62, 0x72, 0x69, 0x64, 0x5f, 0x72, 0x65, 0x73, 0x69,
    0x64, 0x75, 0x61, 0x6c, 0x5f, 0x31, 0x2f, 0x64, 0x65, 0x6e, 0x73, 0x65,
    0x5f, 0x36, 0x5f, 0x31, 0x2f, 0x42, 0x69, 0x61, 0x73, 0x41, 0x64, 0x64,
    0x00, 0x00, 0x00, 0x00, 0x01, 0x00, 0x00, 0x00, 0x04, 0x00, 0x00, 0x00,
    0x86, 0xff, 0xff, 0xff, 0x00, 0x00, 0x00, 0x01, 0x14, 0x00, 0x00, 0x00,
    0x34, 0x00, 0x00, 0x00, 0x03, 0x00, 0x00, 0x00, 0x00, 0x00, 0x00, 0x09,
    0x54, 0x00, 0x00, 0x00, 0xdc, 0xfe, 0xff, 0xff, 0x08, 0x00, 0x00, 0x00,
    0x14, 0x00, 0x00, 0x00, 0x01, 0x00, 0x00, 0x00, 0x00, 0x00, 0x00, 0x00,
    0x00, 0x00, 0x00, 0x00, 0x00, 0x00, 0x00, 0x00, 0x01, 0x00, 0x00, 0x00,
    0x98, 0xa9, 0x15, 0x3c, 0x26, 0x00, 0x00, 0x00, 0x73, 0x6f, 0x63, 0x5f,
    0x68, 0x79, 0x62, 0x72, 0x69, 0x64, 0x5f, 0x72, 0x65, 0x73, 0x69, 0x64,
    0x75, 0x61, 0x6c, 0x5f, 0x31, 0x2f, 0x64, 0x65, 0x6e, 0x73, 0x65, 0x5f,
    0x37, 0x5f, 0x31, 0x2f, 0x4d, 0x61, 0x74, 0x4d, 0x75, 0x6c, 0x00, 0x00,
    0x02, 0x00, 0x00, 0x00, 0x01, 0x00, 0x00, 0x00, 0x04, 0x00, 0x00, 0x00,
    0x00, 0x00, 0x16, 0x00, 0x1c, 0x00, 0x18, 0x00, 0x17, 0x00, 0x10, 0x00,
    0x0c, 0x00, 0x08, 0x00, 0x00, 0x00, 0x00, 0x00, 0x00, 0x00, 0x07, 0x00,
    0x16, 0x00, 0x00, 0x00, 0x00, 0x00, 0x00, 0x01, 0x14, 0x00, 0x00, 0x00,
    0x30, 0x00, 0x00, 0x00, 0x02, 0x00, 0x00, 0x00, 0x00, 0x00, 0x00, 0x02,
    0x4c, 0x00, 0x00, 0x00, 0x6c, 0xff, 0xff, 0xff, 0x08, 0x00, 0x00, 0x00,
    0x10, 0x00, 0x00, 0x00, 0x01, 0x00, 0x00, 0x00, 0x00, 0x00, 0x00, 0x00,
    0x00, 0x00, 0x00, 0x00, 0x01, 0x00, 0x00, 0x00, 0x5d, 0x89, 0x32, 0x39,
    0x23, 0x00, 0x00, 0x00, 0x73, 0x6f, 0x63, 0x5f, 0x68, 0x79, 0x62, 0x72,
    0x69, 0x64, 0x5f, 0x72, 0x65, 0x73, 0x69, 0x64, 0x75, 0x61, 0x6c, 0x5f,
    0x31, 0x2f, 0x64, 0x65, 0x6e, 0x73, 0x65, 0x5f, 0x37, 0x5f, 0x31, 0x2f,
    0x41, 0x64, 0x64, 0x00, 0x01, 0x00, 0x00, 0x00, 0x01, 0x00, 0x00, 0x00,
    0x00, 0x00, 0x16, 0x00, 0x20, 0x00, 0x1c, 0x00, 0x1b, 0x00, 0x14, 0x00,
    0x10, 0x00, 0x0c, 0x00, 0x00, 0x00, 0x00, 0x00, 0x08, 0x00, 0x07, 0x00,
    0x16, 0x00, 0x00, 0x00, 0x00, 0x00, 0x00, 0x01, 0x18, 0x00, 0x00, 0x00,
    0x2c, 0x00, 0x00, 0x00, 0x48, 0x00, 0x00, 0x00, 0x01, 0x00, 0x00, 0x00,
    0x00, 0x00, 0x00, 0x09, 0x64, 0x00, 0x00, 0x00, 0x02, 0x00, 0x00, 0x00,
    0xff, 0xff, 0xff, 0xff, 0x04, 0x00, 0x00, 0x00, 0x0c, 0x00, 0x0c, 0x00,
    0x00, 0x00, 0x00, 0x00, 0x08, 0x00, 0x04, 0x00, 0x0c, 0x00, 0x00, 0x00,
    0x08, 0x00, 0x00, 0x00, 0x10, 0x00, 0x00, 0x00, 0x01, 0x00, 0x00, 0x00,
    0xef, 0xff, 0xff, 0xff, 0xff, 0xff, 0xff, 0xff, 0x01, 0x00, 0x00, 0x00,
    0x4b, 0x40, 0xe4, 0x3b, 0x20, 0x00, 0x00, 0x00, 0x73, 0x65, 0x72, 0x76,
    0x69, 0x6e, 0x67, 0x5f, 0x64, 0x65, 0x66, 0x61, 0x75, 0x6c, 0x74, 0x5f,
    0x6b, 0x65, 0x72, 0x61, 0x73, 0x5f, 0x74, 0x65, 0x6e, 0x73, 0x6f, 0x72,
    0x5f, 0x38, 0x3a, 0x30, 0x00, 0x00, 0x00, 0x00, 0x02, 0x00, 0x00, 0x00,
    0x01, 0x00, 0x00, 0x00, 0x04, 0x00, 0x00, 0x00, 0x01, 0x00, 0x00, 0x00,
    0x10, 0x00, 0x00, 0x00, 0x0c, 0x00, 0x10, 0x00, 0x0f, 0x00, 0x00, 0x00,
    0x08, 0x00, 0x04, 0x00, 0x0c, 0x00, 0x00, 0x00, 0x09, 0x00, 0x00, 0x00,
    0x04, 0x00, 0x00, 0x00, 0x00, 0x00, 0x00, 0x09,
};
const unsigned int g_model_hybrid_len = 2816;
```

## src/model_hybrid.hpp
```c
/* Generated — DO NOT EDIT */
#ifndef MODEL_HYBRID_HPP
#define MODEL_HYBRID_HPP
extern const unsigned char g_model_hybrid[];
extern const unsigned int  g_model_hybrid_len;
#endif
```

## src/model_lstm.hpp
```c
/* Generated — DO NOT EDIT */
#ifndef MODEL_LSTM_HPP
#define MODEL_LSTM_HPP
extern const unsigned char g_model_lstm[];
extern const unsigned int  g_model_lstm_len;
#endif
```

## src/model_mlp.cpp
```c
/* Generated — DO NOT EDIT */
#include "model_mlp.hpp"

alignas(8) const unsigned char g_model_mlp[3104] = {
    0x20, 0x00, 0x00, 0x00, 0x54, 0x46, 0x4c, 0x33, 0x00, 0x00, 0x00, 0x00,
    0x14, 0x00, 0x20, 0x00, 0x1c, 0x00, 0x18, 0x00, 0x14, 0x00, 0x10, 0x00,
    0x0c, 0x00, 0x00, 0x00, 0x08, 0x00, 0x04, 0x00, 0x14, 0x00, 0x00, 0x00,
    0x1c, 0x00, 0x00, 0x00, 0x98, 0x00, 0x00, 0x00, 0xf0, 0x00, 0x00, 0x00,
    0x2c, 0x03, 0x00, 0x00, 0x3c, 0x03, 0x00, 0x00, 0xc4, 0x0b, 0x00, 0x00,
    0x03, 0x00, 0x00, 0x00, 0x01, 0x00, 0x00, 0x00, 0x10, 0x00, 0x00, 0x00,
    0x00, 0x00, 0x0a, 0x00, 0x10, 0x00, 0x0c, 0x00, 0x08, 0x00, 0x04, 0x00,
    0x0a, 0x00, 0x00, 0x00, 0x0c, 0x00, 0x00, 0x00, 0x1c, 0x00, 0x00, 0x00,
    0x3c, 0x00, 0x00, 0x00, 0x0f, 0x00, 0x00, 0x00, 0x73, 0x65, 0x72, 0x76,
    0x69, 0x6e, 0x67, 0x5f, 0x64, 0x65, 0x66, 0x61, 0x75, 0x6c, 0x74, 0x00,
    0x01, 0x00, 0x00, 0x00, 0x04, 0x00, 0x00, 0x00, 0x90, 0xff, 0xff, 0xff,
    0x09, 0x00, 0x00, 0x00, 0x04, 0x00, 0x00, 0x00, 0x08, 0x00, 0x00, 0x00,
    0x6f, 0x75, 0x74, 0x70, 0x75, 0x74, 0x5f, 0x30, 0x00, 0x00, 0x00, 0x00,
    0x01, 0x00, 0x00, 0x00, 0x04, 0x00, 0x00, 0x00, 0x66, 0xfd, 0xff, 0xff,
    0x04, 0x00, 0x00, 0x00, 0x0c, 0x00, 0x00, 0x00, 0x6b, 0x65, 0x72, 0x61,
    0x73, 0x5f, 0x74, 0x65, 0x6e, 0x73, 0x6f, 0x72, 0x00, 0x00, 0x00, 0x00,
    0x02, 0x00, 0x00, 0x00, 0x34, 0x00, 0x00, 0x00, 0x04, 0x00, 0x00, 0x00,
    0xdc, 0xff, 0xff, 0xff, 0x0c, 0x00, 0x00, 0x00, 0x04, 0x00, 0x00, 0x00,
    0x13, 0x00, 0x00, 0x00, 0x43, 0x4f, 0x4e, 0x56, 0x45, 0x52, 0x53, 0x49,
    0x4f, 0x4e, 0x5f, 0x4d, 0x45, 0x54, 0x41, 0x44, 0x41, 0x54, 0x41, 0x00,
    0x08, 0x00, 0x0c, 0x00, 0x08, 0x00, 0x04, 0x00, 0x08, 0x00, 0x00, 0x00,
    0x0b, 0x00, 0x00, 0x00, 0x04, 0x00, 0x00, 0x00, 0x13, 0x00, 0x00, 0x00,
    0x6d, 0x69, 0x6e, 0x5f, 0x72, 0x75, 0x6e, 0x74, 0x69, 0x6d, 0x65, 0x5f,
    0x76, 0x65, 0x72, 0x73, 0x69, 0x6f, 0x6e, 0x00, 0x0d, 0x00, 0x00, 0x00,
    0x38, 0x02, 0x00, 0x00, 0x30, 0x02, 0x00, 0x00, 0x1c, 0x02, 0x00, 0x00,
    0xfc, 0x01, 0x00, 0x00, 0xcc, 0x01, 0x00, 0x00, 0x3c, 0x01, 0x00, 0x00,
    0xec, 0x00, 0x00, 0x00, 0xac, 0x00, 0x00, 0x00, 0xa4, 0x00, 0x00, 0x00,
    0x9c, 0x00, 0x00, 0x00, 0x94, 0x00, 0x00, 0x00, 0x74, 0x00, 0x00, 0x00,
    0x04, 0x00, 0x00, 0x00, 0x16, 0xfe, 0xff, 0xff, 0x04, 0x00, 0x00, 0x00,
    0x60, 0x00, 0x00, 0x00, 0x0c, 0x00, 0x00, 0x00, 0x08, 0x00, 0x0e, 0x00,
    0x08, 0x00, 0x04, 0x00, 0x08, 0x00, 0x00, 0x00, 0x10, 0x00, 0x00, 0x00,
    0x28, 0x00, 0x00, 0x00, 0x00, 0x00, 0x06, 0x00, 0x08, 0x00, 0x04, 0x00,
    0x06, 0x00, 0x00, 0x00, 0x04, 0x00, 0x00, 0x00, 0x01, 0x00, 0x00, 0x00,
    0xeb, 0x03, 0x00, 0x00, 0x0c, 0x00, 0x18, 0x00, 0x14, 0x00, 0x10, 0x00,
    0x0c, 0x00, 0x04, 0x00, 0x0c, 0x00, 0x00, 0x00, 0xc7, 0xbf, 0x67, 0x2f,
    0x15, 0x59, 0xe7, 0x2b, 0x02, 0x00, 0x00, 0x00, 0x02, 0x00, 0x00, 0x00,
    0x04, 0x00, 0x00, 0x00, 0x06, 0x00, 0x00, 0x00, 0x32, 0x2e, 0x32, 0x31,
    0x2e, 0x30, 0x00, 0x00, 0x82, 0xfe, 0xff, 0xff, 0x04, 0x00, 0x00, 0x00,
    0x10, 0x00, 0x00, 0x00, 0x31, 0x2e, 0x31, 0x34, 0x2e, 0x30, 0x00, 0x00,
    0x00, 0x00, 0x00, 0x00, 0x00, 0x00, 0x00, 0x00, 0x0c, 0xfe, 0xff, 0xff,
    0x10, 0xfe, 0xff, 0xff, 0x14, 0xfe, 0xff, 0xff, 0xaa, 0xfe, 0xff, 0xff,
    0x04, 0x00, 0x00, 0x00, 0x30, 0x00, 0x00, 0x00, 0x7f, 0xae, 0x13, 0x7f,
    0xb1, 0x56, 0x5d, 0x81, 0x14, 0x7f, 0xf5, 0xfe, 0xfe, 0x7f, 0x10, 0xf0,
    0x5e, 0x7f, 0x70, 0x81, 0xeb, 0x7f, 0x26, 0xf5, 0x81, 0xa6, 0x44, 0x81,
    0x24, 0xc2, 0xc6, 0xbd, 0x7f, 0x81, 0xd9, 0xbc, 0x7f, 0x58, 0x4a, 0x81,
    0xcc, 0x9d, 0x3e, 0x7f, 0x99, 0x2a, 0xa3, 0x81, 0xe6, 0xfe, 0xff, 0xff,
    0x04, 0x00, 0x00, 0x00, 0x40, 0x00, 0x00, 0x00, 0xd9, 0xff, 0xff, 0xff,
    0x45, 0xe6, 0xff, 0xff, 0x69, 0x0d, 0x00, 0x00, 0x32, 0xf2, 0xff, 0xff,
    0xfc, 0xef, 0xff, 0xff, 0x71, 0x25, 0x00, 0x00, 0x71, 0xe5, 0xff, 0xff,
    0xed, 0x13, 0x00, 0x00, 0x83, 0x0f, 0x00, 0x00, 0xf8, 0x11, 0x00, 0x00,
    0x1d, 0x14, 0x00, 0x00, 0xe3, 0xfb, 0xff, 0xff, 0x0d, 0x20, 0x00, 0x00,
    0xbc, 0x05, 0x00, 0x00, 0xc6, 0xf0, 0xff, 0xff, 0xe0, 0xfe, 0xff, 0xff,
    0x32, 0xff, 0xff, 0xff, 0x04, 0x00, 0x00, 0x00, 0x80, 0x00, 0x00, 0x00,
    0x15, 0x1c, 0x89, 0x07, 0x1b, 0x86, 0x8c, 0xfb, 0x89, 0x4a, 0x31, 0x1c,
    0x41, 0xe1, 0xdb, 0x81, 0xf4, 0xed, 0x25, 0xd1, 0xd4, 0x40, 0xf9, 0x3e,
    0x0e, 0x4a, 0xf1, 0x8d, 0x40, 0x27, 0x81, 0xbe, 0xfb, 0x08, 0x2a, 0x81,
    0x47, 0x41, 0xc1, 0xfc, 0x1c, 0x2a, 0x37, 0x89, 0x45, 0x02, 0x03, 0xcd,
    0xd6, 0x18, 0x1b, 0xee, 0xca, 0x30, 0xab, 0x4d, 0x3b, 0x48, 0xe7, 0x81,
    0xfb, 0x1c, 0xa7, 0xc9, 0xda, 0x31, 0xe7, 0x81, 0x03, 0x50, 0xf6, 0x25,
    0x21, 0x3e, 0x1d, 0xd5, 0x33, 0xb4, 0xe2, 0xce, 0xe7, 0x14, 0x81, 0x28,
    0xe6, 0xd3, 0xaf, 0xc2, 0x35, 0xbc, 0xbf, 0x3e, 0xbd, 0x2a, 0xe6, 0xe0,
    0x2d, 0x08, 0x30, 0x32, 0xeb, 0x06, 0x0d, 0x16, 0xdb, 0x81, 0xe6, 0x53,
    0xe7, 0x35, 0x1d, 0x1a, 0x38, 0xbb, 0xdf, 0x83, 0xae, 0x11, 0x9d, 0x1e,
    0x36, 0x79, 0x65, 0x81, 0x5d, 0x23, 0xa7, 0x18, 0xbe, 0xff, 0xff, 0xff,
    0x04, 0x00, 0x00, 0x00, 0x20, 0x00, 0x00, 0x00, 0x00, 0x00, 0x00, 0x00,
    0xab, 0x16, 0x00, 0x00, 0x15, 0x17, 0x00, 0x00, 0x0d, 0x27, 0x00, 0x00,
    0x63, 0xfa, 0xff, 0xff, 0x97, 0xde, 0xff, 0xff, 0x49, 0x12, 0x00, 0x00,
    0x6c, 0x23, 0x00, 0x00, 0xea, 0xff, 0xff, 0xff, 0x04, 0x00, 0x00, 0x00,
    0x08, 0x00, 0x00, 0x00, 0xdb, 0x89, 0xdf, 0xbf, 0x7f, 0x10, 0x2f, 0x8e,
    0x00, 0x00, 0x06, 0x00, 0x08, 0x00, 0x04, 0x00, 0x06, 0x00, 0x00, 0x00,
    0x04, 0x00, 0x00, 0x00, 0x04, 0x00, 0x00, 0x00, 0x42, 0x07, 0x00, 0x00,
    0x84, 0xff, 0xff, 0xff, 0x88, 0xff, 0xff, 0xff, 0x0f, 0x00, 0x00, 0x00,
    0x4d, 0x4c, 0x49, 0x52, 0x20, 0x43, 0x6f, 0x6e, 0x76, 0x65, 0x72, 0x74,
    0x65, 0x64, 0x2e, 0x00, 0x01, 0x00, 0x00, 0x00, 0x14, 0x00, 0x00, 0x00,
    0x00, 0x00, 0x0e, 0x00, 0x18, 0x00, 0x14, 0x00, 0x10, 0x00, 0x0c, 0x00,
    0x08, 0x00, 0x04, 0x00, 0x0e, 0x00, 0x00, 0x00, 0x14, 0x00, 0x00, 0x00,
    0x1c, 0x00, 0x00, 0x00, 0xec, 0x00, 0x00, 0x00, 0xf0, 0x00, 0x00, 0x00,
    0xf4, 0x00, 0x00, 0x00, 0x04, 0x00, 0x00, 0x00, 0x6d, 0x61, 0x69, 0x6e,
    0x00, 0x00, 0x00, 0x00, 0x03, 0x00, 0x00, 0x00, 0x94, 0x00, 0x00, 0x00,
    0x4c, 0x00, 0x00, 0x00, 0x04, 0x00, 0x00, 0x00, 0xca, 0xff, 0xff, 0xff,
    0x14, 0x00, 0x00, 0x00, 0x00, 0x00, 0x00, 0x08, 0x10, 0x00, 0x00, 0x00,
    0x14, 0x00, 0x00, 0x00, 0x04, 0x00, 0x04, 0x00, 0x04, 0x00, 0x00, 0x00,
    0x01, 0x00, 0x00, 0x00, 0x09, 0x00, 0x00, 0x00, 0x03, 0x00, 0x00, 0x00,
    0x08, 0x00, 0x00, 0x00, 0x02, 0x00, 0x00, 0x00, 0x01, 0x00, 0x00, 0x00,
    0x00, 0x00, 0x0e, 0x00, 0x14, 0x00, 0x00, 0x00, 0x10, 0x00, 0x0c, 0x00,
    0x0b, 0x00, 0x04, 0x00, 0x0e, 0x00, 0x00, 0x00, 0x10, 0x00, 0x00, 0x00,
    0x00, 0x00, 0x00, 0x08, 0x10, 0x00, 0x00, 0x00, 0x14, 0x00, 0x00, 0x00,
    0xba, 0xff, 0xff, 0xff, 0x00, 0x00, 0x00, 0x01, 0x01, 0x00, 0x00, 0x00,
    0x08, 0x00, 0x00, 0x00, 0x03, 0x00, 0x00, 0x00, 0x07, 0x00, 0x00, 0x00,
    0x04, 0x00, 0x00, 0x00, 0x03, 0x00, 0x00, 0x00, 0x00, 0x00, 0x0e, 0x00,
    0x16, 0x00, 0x00, 0x00, 0x10, 0x00, 0x0c, 0x00, 0x0b, 0x00, 0x04, 0x00,
    0x0e, 0x00, 0x00, 0x00, 0x18, 0x00, 0x00, 0x00, 0x00, 0x00, 0x00, 0x08,
    0x18, 0x00, 0x00, 0x00, 0x1c, 0x00, 0x00, 0x00, 0x00, 0x00, 0x06, 0x00,
    0x08, 0x00, 0x07, 0x00, 0x06, 0x00, 0x00, 0x00, 0x00, 0x00, 0x00, 0x01,
    0x01, 0x00, 0x00, 0x00, 0x07, 0x00, 0x00, 0x00, 0x03, 0x00, 0x00, 0x00,
    0x00, 0x00, 0x00, 0x00, 0x06, 0x00, 0x00, 0x00, 0x05, 0x00, 0x00, 0x00,
    0x01, 0x00, 0x00, 0x00, 0x09, 0x00, 0x00, 0x00, 0x01, 0x00, 0x00, 0x00,
    0x00, 0x00, 0x00, 0x00, 0x0a, 0x00, 0x00, 0x00, 0xdc, 0x06, 0x00, 0x00,
    0x5c, 0x06, 0x00, 0x00, 0xd8, 0x05, 0x00, 0x00, 0xfc, 0x04, 0x00, 0x00,
    0x38, 0x04, 0x00, 0x00, 0x04, 0x03, 0x00, 0x00, 0xe0, 0x01, 0x00, 0x00,
    0x34, 0x01, 0x00, 0x00, 0x80, 0x00, 0x00, 0x00, 0x04, 0x00, 0x00, 0x00,
    0x62, 0xf9, 0xff, 0xff, 0x00, 0x00, 0x00, 0x01, 0x18, 0x00, 0x00, 0x00,
    0x20, 0x00, 0x00, 0x00, 0x3c, 0x00, 0x00, 0x00, 0x0a, 0x00, 0x00, 0x00,
    0x00, 0x00, 0x00, 0x09, 0x50, 0x00, 0x00, 0x00, 0x02, 0x00, 0x00, 0x00,
    0xff, 0xff, 0xff, 0xff, 0x01, 0x00, 0x00, 0x00, 0x4c, 0xf9, 0xff, 0xff,
    0x08, 0x00, 0x00, 0x00, 0x10, 0x00, 0x00, 0x00, 0x01, 0x00, 0x00, 0x00,
    0x05, 0x00, 0x00, 0x00, 0x00, 0x00, 0x00, 0x00, 0x01, 0x00, 0x00, 0x00,
    0x09, 0x61, 0x05, 0x3c, 0x1b, 0x00, 0x00, 0x00, 0x53, 0x74, 0x61, 0x74,
    0x65, 0x66, 0x75, 0x6c, 0x50, 0x61, 0x72, 0x74, 0x69, 0x74, 0x69, 0x6f,
    0x6e, 0x65, 0x64, 0x43, 0x61, 0x6c, 0x6c, 0x5f, 0x31, 0x3a, 0x30, 0x00,
    0x02, 0x00, 0x00, 0x00, 0x01, 0x00, 0x00, 0x00, 0x01, 0x00, 0x00, 0x00,
    0xda, 0xf9, 0xff, 0xff, 0x00, 0x00, 0x00, 0x01, 0x18, 0x00, 0x00, 0x00,
    0x20, 0x00, 0x00, 0x00, 0x40, 0x00, 0x00, 0x00, 0x09, 0x00, 0x00, 0x00,
    0x00, 0x00, 0x00, 0x09, 0x88, 0x00, 0x00, 0x00, 0x02, 0x00, 0x00, 0x00,
    0xff, 0xff, 0xff, 0xff, 0x08, 0x00, 0x00, 0x00, 0xc4, 0xf9, 0xff, 0xff,
    0x08, 0x00, 0x00, 0x00, 0x14, 0x00, 0x00, 0x00, 0x01, 0x00, 0x00, 0x00,
    0x80, 0xff, 0xff, 0xff, 0xff, 0xff, 0xff, 0xff, 0x00, 0x00, 0x00, 0x00,
    0x01, 0x00, 0x00, 0x00, 0xcd, 0x17, 0x0b, 0x3c, 0x4f, 0x00, 0x00, 0x00,
    0x73, 0x6f, 0x63, 0x5f, 0x6d, 0x6c, 0x70, 0x5f, 0x31, 0x2f, 0x64, 0x65,
    0x6e, 0x73, 0x65, 0x5f, 0x31, 0x5f, 0x32, 0x2f, 0x4d, 0x61, 0x74, 0x4d,
    0x75, 0x6c, 0x3b, 0x73, 0x6f, 0x63, 0x5f, 0x6d, 0x6c, 0x70, 0x5f, 0x31,
    0x2f, 0x64, 0x65, 0x6e, 0x73, 0x65, 0x5f, 0x31, 0x5f, 0x32, 0x2f, 0x52,
    0x65, 0x6c, 0x75, 0x3b, 0x73, 0x6f, 0x63, 0x5f, 0x6d, 0x6c, 0x70, 0x5f,
    0x31, 0x2f, 0x64, 0x65, 0x6e, 0x73, 0x65, 0x5f, 0x31, 0x5f, 0x32, 0x2f,
    0x42, 0x69, 0x61, 0x73, 0x41, 0x64, 0x64, 0x00, 0x02, 0x00, 0x00, 0x00,
    0x01, 0x00, 0x00, 0x00, 0x08, 0x00, 0x00, 0x00, 0x8a, 0xfa, 0xff, 0xff,
    0x00, 0x00, 0x00, 0x01, 0x18, 0x00, 0x00, 0x00, 0x20, 0x00, 0x00, 0x00,
    0x3c, 0x00, 0x00, 0x00, 0x08, 0x00, 0x00, 0x00, 0x00, 0x00, 0x00, 0x09,
    0x80, 0x00, 0x00, 0x00, 0x02, 0x00, 0x00, 0x00, 0xff, 0xff, 0xff, 0xff,
    0x10, 0x00, 0x00, 0x00, 0x74, 0xfa, 0xff, 0xff, 0x08, 0x00, 0x00, 0x00,
    0x10, 0x00, 0x00, 0x00, 0x01, 0x00, 0x00, 0x00, 0x80, 0xff, 0xff, 0xff,
    0xff, 0xff, 0xff, 0xff, 0x01, 0x00, 0x00, 0x00, 0x89, 0x96, 0x59, 0x3b,
    0x49, 0x00, 0x00, 0x00, 0x73, 0x6f, 0x63, 0x5f, 0x6d, 0x6c, 0x70, 0x5f,
    0x31, 0x2f, 0x64, 0x65, 0x6e, 0x73, 0x65, 0x5f, 0x31, 0x2f, 0x4d, 0x61,
    0x74, 0x4d, 0x75, 0x6c, 0x3b, 0x73, 0x6f, 0x63, 0x5f, 0x6d, 0x6c, 0x70,
    0x5f, 0x31, 0x2f, 0x64, 0x65, 0x6e, 0x73, 0x65, 0x5f, 0x31, 0x2f, 0x52,
    0x65, 0x6c, 0x75, 0x3b, 0x73, 0x6f, 0x63, 0x5f, 0x6d, 0x6c, 0x70, 0x5f,
    0x31, 0x2f, 0x64, 0x65, 0x6e, 0x73, 0x65, 0x5f, 0x31, 0x2f, 0x42, 0x69,
    0x61, 0x73, 0x41, 0x64, 0x64, 0x00, 0x00, 0x00, 0x02, 0x00, 0x00, 0x00,
    0x01, 0x00, 0x00, 0x00, 0x10, 0x00, 0x00, 0x00, 0xae, 0xfb, 0xff, 0xff,
    0x00, 0x00, 0x00, 0x01, 0x14, 0x00, 0x00, 0x00, 0xe8, 0x00, 0x00, 0x00,
    0x07, 0x00, 0x00, 0x00, 0x00, 0x00, 0x00, 0x09, 0xfc, 0x00, 0x00, 0x00,
    0x0c, 0xfb, 0xff, 0xff, 0x08, 0x00, 0x00, 0x00, 0x8c, 0x00, 0x00, 0x00,
    0x10, 0x00, 0x00, 0x00, 0x00, 0x00, 0x00, 0x00, 0x00, 0x00, 0x00, 0x00,
    0x00, 0x00, 0x00, 0x00, 0x00, 0x00, 0x00, 0x00, 0x00, 0x00, 0x00, 0x00,
    0x00, 0x00, 0x00, 0x00, 0x00, 0x00, 0x00, 0x00, 0x00, 0x00, 0x00, 0x00,
    0x00, 0x00, 0x00, 0x00, 0x00, 0x00, 0x00, 0x00, 0x00, 0x00, 0x00, 0x00,
    0x00, 0x00, 0x00, 0x00, 0x00, 0x00, 0x00, 0x00, 0x00, 0x00, 0x00, 0x00,
    0x00, 0x00, 0x00, 0x00, 0x00, 0x00, 0x00, 0x00, 0x00, 0x00, 0x00, 0x00,
    0x00, 0x00, 0x00, 0x00, 0x00, 0x00, 0x00, 0x00, 0x00, 0x00, 0x00, 0x00,
    0x00, 0x00, 0x00, 0x00, 0x00, 0x00, 0x00, 0x00, 0x00, 0x00, 0x00, 0x00,
    0x00, 0x00, 0x00, 0x00, 0x00, 0x00, 0x00, 0x00, 0x00, 0x00, 0x00, 0x00,
    0x00, 0x00, 0x00, 0x00, 0x00, 0x00, 0x00, 0x00, 0x00, 0x00, 0x00, 0x00,
    0x00, 0x00, 0x00, 0x00, 0x00, 0x00, 0x00, 0x00, 0x00, 0x00, 0x00, 0x00,
    0x00, 0x00, 0x00, 0x00, 0x10, 0x00, 0x00, 0x00, 0x10, 0x84, 0xae, 0x3b,
    0x88, 0xe0, 0x92, 0x3b, 0x2d, 0xcc, 0xa6, 0x3b, 0x81, 0xd1, 0xa7, 0x3b,
    0x2e, 0x16, 0x73, 0x3a, 0xa0, 0x35, 0x25, 0x3b, 0xec, 0x65, 0xa5, 0x3b,
    0x41, 0xbf, 0xb5, 0x3b, 0xe1, 0xad, 0x74, 0x3b, 0x90, 0x75, 0xc8, 0x3b,
    0xa7, 0x78, 0x4b, 0x3b, 0xb5, 0x83, 0xe9, 0x3b, 0x0d, 0x8c, 0x71, 0x3b,
    0x34, 0xc6, 0xb9, 0x3b, 0x4f, 0x27, 0xc9, 0x3b, 0x79, 0x0a, 0x97, 0x3b,
    0x18, 0x00, 0x00, 0x00, 0x73, 0x6f, 0x63, 0x5f, 0x6d, 0x6c, 0x70, 0x5f,
    0x31, 0x2f, 0x64, 0x65, 0x6e, 0x73, 0x65, 0x5f, 0x31, 0x2f, 0x4d, 0x61,
    0x74, 0x4d, 0x75, 0x6c, 0x00, 0x00, 0x00, 0x00, 0x02, 0x00, 0x00, 0x00,
    0x10, 0x00, 0x00, 0x00, 0x03, 0x00, 0x00, 0x00, 0xce, 0xfc, 0xff, 0xff,
    0x00, 0x00, 0x00, 0x01, 0x14, 0x00, 0x00, 0x00, 0xe4, 0x00, 0x00, 0x00,
    0x06, 0x00, 0x00, 0x00, 0x00, 0x00, 0x00, 0x02, 0x10, 0x01, 0x00, 0x00,
    0x2c, 0xfc, 0xff, 0xff, 0x08, 0x00, 0x00, 0x00, 0x88, 0x00, 0x00, 0x00,
    0x10, 0x00, 0x00, 0x00, 0x00, 0x00, 0x00, 0x00, 0x00, 0x00, 0x00, 0x00,
    0x00, 0x00, 0x00, 0x00, 0x00, 0x00, 0x00, 0x00, 0x00, 0x00, 0x00, 0x00,
    0x00, 0x00, 0x00, 0x00, 0x00, 0x00, 0x00, 0x00, 0x00, 0x00, 0x00, 0x00,
    0x00, 0x00, 0x00, 0x00, 0x00, 0x00, 0x00, 0x00, 0x00, 0x00, 0x00, 0x00,
    0x00, 0x00, 0x00, 0x00, 0x00, 0x00, 0x00, 0x00, 0x00, 0x00, 0x00, 0x00,
    0x00, 0x00, 0x00, 0x00, 0x00, 0x00, 0x00, 0x00, 0x00, 0x00, 0x00, 0x00,
    0x00, 0x00, 0x00, 0x00, 0x00, 0x00, 0x00, 0x00, 0x00, 0x00, 0x00, 0x00,
    0x00, 0x00, 0x00, 0x00, 0x00, 0x00, 0x00, 0x00, 0x00, 0x00, 0x00, 0x00,
    0x00, 0x00, 0x00, 0x00, 0x00, 0x00, 0x00, 0x00, 0x00, 0x00, 0x00, 0x00,
    0x00, 0x00, 0x00, 0x00, 0x00, 0x00, 0x00, 0x00, 0x00, 0x00, 0x00, 0x00,
    0x00, 0x00, 0x00, 0x00, 0x00, 0x00, 0x00, 0x00, 0x00, 0x00, 0x00, 0x00,
    0x10, 0x00, 0x00, 0x00, 0x01, 0x98, 0x11, 0x38, 0x2b, 0x12, 0xf5, 0x37,
    0x94, 0x27, 0x0b, 0x38, 0x99, 0x01, 0x0c, 0x38, 0xec, 0xcc, 0xca, 0x36,
    0x67, 0xd4, 0x89, 0x37, 0xb2, 0xfc, 0x09, 0x38, 0x67, 0xa0, 0x17, 0x38,
    0x0d, 0x21, 0xcc, 0x37, 0xd3, 0x3c, 0x27, 0x38, 0x20, 0xc0, 0xa9, 0x37,
    0x8f, 0xd0, 0x42, 0x38, 0x1c, 0x84, 0xc9, 0x37, 0x7f, 0xfc, 0x1a, 0x38,
    0x1d, 0xd1, 0x27, 0x38, 0xbe, 0x04, 0xfc, 0x37, 0x30, 0x00, 0x00, 0x00,
    0x73, 0x6f, 0x63, 0x5f, 0x6d, 0x6c, 0x70, 0x5f, 0x31, 0x2f, 0x64, 0x65,
    0x6e, 0x73, 0x65, 0x5f, 0x31, 0x2f, 0x52, 0x65, 0x6c, 0x75, 0x3b, 0x73,
    0x6f, 0x63, 0x5f, 0x6d, 0x6c, 0x70, 0x5f, 0x31, 0x2f, 0x64, 0x65, 0x6e,
    0x73, 0x65, 0x5f, 0x31, 0x2f, 0x42, 0x69, 0x61, 0x73, 0x41, 0x64, 0x64,
    0x00, 0x00, 0x00, 0x00, 0x01, 0x00, 0x00, 0x00, 0x10, 0x00, 0x00, 0x00,
    0xfe, 0xfd, 0xff, 0xff, 0x00, 0x00, 0x00, 0x01, 0x14, 0x00, 0x00, 0x00,
    0x88, 0x00, 0x00, 0x00, 0x05, 0x00, 0x00, 0x00, 0x00, 0x00, 0x00, 0x09,
    0x9c, 0x00, 0x00, 0x00, 0x5c, 0xfd, 0xff, 0xff, 0x08, 0x00, 0x00, 0x00,
    0x4c, 0x00, 0x00, 0x00, 0x08, 0x00, 0x00, 0x00, 0x00, 0x00, 0x00, 0x00,
    0x00, 0x00, 0x00, 0x00, 0x00, 0x00, 0x00, 0x00, 0x00, 0x00, 0x00, 0x00,
    0x00, 0x00, 0x00, 0x00, 0x00, 0x00, 0x00, 0x00, 0x00, 0x00, 0x00, 0x00,
    0x00, 0x00, 0x00, 0x00, 0x00, 0x00, 0x00, 0x00, 0x00, 0x00, 0x00, 0x00,
    0x00, 0x00, 0x00, 0x00, 0x00, 0x00, 0x00, 0x00, 0x00, 0x00, 0x00, 0x00,
    0x00, 0x00, 0x00, 0x00, 0x00, 0x00, 0x00, 0x00, 0x00, 0x00, 0x00, 0x00,
    0x00, 0x00, 0x00, 0x00, 0x08, 0x00, 0x00, 0x00, 0xdc, 0x79, 0x6b, 0x3b,
    0x58, 0xc4, 0x25, 0x3c, 0x7e, 0x75, 0xe1, 0x3b, 0xda, 0x8a, 0xad, 0x3b,
    0x71, 0x67, 0x39, 0x3c, 0x29, 0x36, 0xb2, 0x3b, 0x0e, 0xcb, 0x79, 0x3c,
    0xfe, 0x97, 0xbe, 0x3b, 0x1a, 0x00, 0x00, 0x00, 0x73, 0x6f, 0x63, 0x5f,
    0x6d, 0x6c, 0x70, 0x5f, 0x31, 0x2f, 0x64, 0x65, 0x6e, 0x73, 0x65, 0x5f,
    0x31, 0x5f, 0x32, 0x2f, 0x4d, 0x61, 0x74, 0x4d, 0x75, 0x6c, 0x00, 0x00,
    0x02, 0x00, 0x00, 0x00, 0x08, 0x00, 0x00, 0x00, 0x10, 0x00, 0x00, 0x00,
    0xbe, 0xfe, 0xff, 0xff, 0x00, 0x00, 0x00, 0x01, 0x14, 0x00, 0x00, 0x00,
    0x88, 0x00, 0x00, 0x00, 0x04, 0x00, 0x00, 0x00, 0x00, 0x00, 0x00, 0x02,
    0xb8, 0x00, 0x00, 0x00, 0x1c, 0xfe, 0xff, 0xff, 0x08, 0x00, 0x00, 0x00,
    0x4c, 0x00, 0x00, 0x00, 0x08, 0x00, 0x00, 0x00, 0x00, 0x00, 0x00, 0x00,
    0x00, 0x00, 0x00, 0x00, 0x00, 0x00, 0x00, 0x00, 0x00, 0x00, 0x00, 0x00,
    0x00, 0x00, 0x00, 0x00, 0x00, 0x00, 0x00, 0x00, 0x00, 0x00, 0x00, 0x00,
    0x00, 0x00, 0x00, 0x00, 0x00, 0x00, 0x00, 0x00, 0x00, 0x00, 0x00, 0x00,
    0x00, 0x00, 0x00, 0x00, 0x00, 0x00, 0x00, 0x00, 0x00, 0x00, 0x00, 0x00,
    0x00, 0x00, 0x00, 0x00, 0x00, 0x00, 0x00, 0x00, 0x00, 0x00, 0x00, 0x00,
    0x00, 0x00, 0x00, 0x00, 0x08, 0x00, 0x00, 0x00, 0xc3, 0x24, 0x48, 0x37,
    0xe8, 0xe4, 0x0c, 0x38, 0x2b, 0xa1, 0xbf, 0x37, 0xbf, 0x80, 0x93, 0x37,
    0xb5, 0x95, 0x1d, 0x38, 0xb4, 0x78, 0x97, 0x37, 0x02, 0x50, 0x54, 0x38,
    0xe9, 0xfe, 0xa1, 0x37, 0x34, 0x00, 0x00, 0x00, 0x73, 0x6f, 0x63, 0x5f,
    0x6d, 0x6c, 0x70, 0x5f, 0x31, 0x2f, 0x64, 0x65, 0x6e, 0x73, 0x65, 0x5f,
    0x31, 0x5f, 0x32, 0x2f, 0x52, 0x65, 0x6c, 0x75, 0x3b, 0x73, 0x6f, 0x63,
    0x5f, 0x6d, 0x6c, 0x70, 0x5f, 0x31, 0x2f, 0x64, 0x65, 0x6e, 0x73, 0x65,
    0x5f, 0x31, 0x5f, 0x32, 0x2f, 0x42, 0x69, 0x61, 0x73, 0x41, 0x64, 0x64,
    0x00, 0x00, 0x00, 0x00, 0x01, 0x00, 0x00, 0x00, 0x08, 0x00, 0x00, 0x00,
    0x96, 0xff, 0xff, 0xff, 0x00, 0x00, 0x00, 0x01, 0x14, 0x00, 0x00, 0x00,
    0x30, 0x00, 0x00, 0x00, 0x03, 0x00, 0x00, 0x00, 0x00, 0x00, 0x00, 0x09,
    0x44, 0x00, 0x00, 0x00, 0xf4, 0xfe, 0xff, 0xff, 0x08, 0x00, 0x00, 0x00,
    0x10, 0x00, 0x00, 0x00, 0x01, 0x00, 0x00, 0x00, 0x00, 0x00, 0x00, 0x00,
    0x00, 0x00, 0x00, 0x00, 0x01, 0x00, 0x00, 0x00, 0xa4, 0xb4, 0x16, 0x3c,
    0x1a, 0x00, 0x00, 0x00, 0x73, 0x6f, 0x63, 0x5f, 0x6d, 0x6c, 0x70, 0x5f,
    0x31, 0x2f, 0x64, 0x65, 0x6e, 0x73, 0x65, 0x5f, 0x32, 0x5f, 0x31, 0x2f,
    0x4d, 0x61, 0x74, 0x4d, 0x75, 0x6c, 0x00, 0x00, 0x02, 0x00, 0x00, 0x00,
    0x01, 0x00, 0x00, 0x00, 0x08, 0x00, 0x00, 0x00, 0x00, 0x00, 0x16, 0x00,
    0x1c, 0x00, 0x18, 0x00, 0x17, 0x00, 0x10, 0x00, 0x0c, 0x00, 0x08, 0x00,
    0x00, 0x00, 0x00, 0x00, 0x00, 0x00, 0x07, 0x00, 0x16, 0x00, 0x00, 0x00,
    0x00, 0x00, 0x00, 0x01, 0x14, 0x00, 0x00, 0x00, 0x34, 0x00, 0x00, 0x00,
    0x02, 0x00, 0x00, 0x00, 0x00, 0x00, 0x00, 0x02, 0x44, 0x00, 0x00, 0x00,
    0x74, 0xff, 0xff, 0xff, 0x08, 0x00, 0x00, 0x00, 0x14, 0x00, 0x00, 0x00,
    0x01, 0x00, 0x00, 0x00, 0x00, 0x00, 0x00, 0x00, 0x00, 0x00, 0x00, 0x00,
    0x00, 0x00, 0x00, 0x00, 0x01, 0x00, 0x00, 0x00, 0x30, 0xc4, 0xa3, 0x38,
    0x17, 0x00, 0x00, 0x00, 0x73, 0x6f, 0x63, 0x5f, 0x6d, 0x6c, 0x70, 0x5f,
    0x31, 0x2f, 0x64, 0x65, 0x6e, 0x73, 0x65, 0x5f, 0x32, 0x5f, 0x31, 0x2f,
    0x41, 0x64, 0x64, 0x00, 0x01, 0x00, 0x00, 0x00, 0x01, 0x00, 0x00, 0x00,
    0x00, 0x00, 0x16, 0x00, 0x20, 0x00, 0x1c, 0x00, 0x1b, 0x00, 0x14, 0x00,
    0x10, 0x00, 0x0c, 0x00, 0x00, 0x00, 0x00, 0x00, 0x08, 0x00, 0x07, 0x00,
    0x16, 0x00, 0x00, 0x00, 0x00, 0x00, 0x00, 0x01, 0x18, 0x00, 0x00, 0x00,
    0x2c, 0x00, 0x00, 0x00, 0x4c, 0x00, 0x00, 0x00, 0x01, 0x00, 0x00, 0x00,
    0x00, 0x00, 0x00, 0x09, 0x64, 0x00, 0x00, 0x00, 0x02, 0x00, 0x00, 0x00,
    0xff, 0xff, 0xff, 0xff, 0x03, 0x00, 0x00, 0x00, 0x0c, 0x00, 0x0c, 0x00,
    0x00, 0x00, 0x00, 0x00, 0x08, 0x00, 0x04, 0x00, 0x0c, 0x00, 0x00, 0x00,
    0x08, 0x00, 0x00, 0x00, 0x14, 0x00, 0x00, 0x00, 0x01, 0x00, 0x00, 0x00,
    0xf7, 0xff, 0xff, 0xff, 0xff, 0xff, 0xff, 0xff, 0x00, 0x00, 0x00, 0x00,
    0x01, 0x00, 0x00, 0x00, 0xe0, 0x92, 0xd5, 0x3b, 0x1e, 0x00, 0x00, 0x00,
    0x73, 0x65, 0x72, 0x76, 0x69, 0x6e, 0x67, 0x5f, 0x64, 0x65, 0x66, 0x61,
    0x75, 0x6c, 0x74, 0x5f, 0x6b, 0x65, 0x72, 0x61, 0x73, 0x5f, 0x74, 0x65,
    0x6e, 0x73, 0x6f, 0x72, 0x3a, 0x30, 0x00, 0x00, 0x02, 0x00, 0x00, 0x00,
    0x01, 0x00, 0x00, 0x00, 0x03, 0x00, 0x00, 0x00, 0x01, 0x00, 0x00, 0x00,
    0x10, 0x00, 0x00, 0x00, 0x0c, 0x00, 0x10, 0x00, 0x0f, 0x00, 0x00, 0x00,
    0x08, 0x00, 0x04, 0x00, 0x0c, 0x00, 0x00, 0x00, 0x09, 0x00, 0x00, 0x00,
    0x04, 0x00, 0x00, 0x00, 0x00, 0x00, 0x00, 0x09,
};
const unsigned int g_model_mlp_len = 3104;
```

## src/model_mlp.hpp
```c
/* Generated — DO NOT EDIT */
#ifndef MODEL_MLP_HPP
#define MODEL_MLP_HPP
extern const unsigned char g_model_mlp[];
extern const unsigned int  g_model_mlp_len;
#endif
```
