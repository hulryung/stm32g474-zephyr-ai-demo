## CMakeLists.txt
```
cmake_minimum_required(VERSION 3.20.0)

find_package(Zephyr REQUIRED HINTS $ENV{ZEPHYR_BASE})
project(ai_anomaly LANGUAGES C CXX)

set(NO_THREADSAFE_STATICS $<TARGET_PROPERTY:compiler-cpp,no_threadsafe_statics>)
zephyr_compile_options($<$<COMPILE_LANGUAGE:CXX>:${NO_THREADSAFE_STATICS}>)

target_sources(app PRIVATE
    src/main.c
    src/cmd_anomaly.c
    src/signal_gen.c
    src/tflm_anomaly.cpp
    src/model.cpp
)
```

## prj.conf
```kconfig
# --- C++ + TFLM ---
CONFIG_CPP=y
CONFIG_STD_CPP17=y
CONFIG_TENSORFLOW_LITE_MICRO=y
CONFIG_TENSORFLOW_LITE_MICRO_CMSIS_NN_KERNELS=y
CONFIG_REQUIRES_FLOAT_PRINTF=y
CONFIG_FPU=y
CONFIG_MAIN_STACK_SIZE=4096

# --- App functionality ---
CONFIG_GPIO=y

# --- Logging ---
CONFIG_LOG=y
CONFIG_LOG_MODE_DEFERRED=y
CONFIG_LOG_BUFFER_SIZE=2048

# --- Shell over UART ---
CONFIG_SHELL=y
CONFIG_SHELL_BACKEND_SERIAL=y
CONFIG_SHELL_PROMPT_UART="g474> "
CONFIG_SHELL_HISTORY=y
CONFIG_SHELL_TAB=y
CONFIG_SHELL_TAB_AUTOCOMPLETION=y
CONFIG_SHELL_STACK_SIZE=4096

# --- Built-in shell modules (helpful for debugging) ---
CONFIG_KERNEL_SHELL=y
CONFIG_DEVICE_SHELL=y
CONFIG_THREAD_MONITOR=y
CONFIG_THREAD_NAME=y
CONFIG_THREAD_STACK_INFO=y
CONFIG_INIT_STACKS=y
```

## src/main.c
```c
/*
 * ai_anomaly — autoencoder-based anomaly detection demo on Cortex-M4.
 *
 * - Initializes TFLM at boot.
 * - LD2 1 Hz heartbeat.
 * - All interaction via shell (cmd_anomaly.c). Run `anomaly score`,
 *   `anomaly inject pulse 0.5`, `anomaly stream on 500`, etc.
 */

#include <zephyr/kernel.h>
#include <zephyr/drivers/gpio.h>
#include <zephyr/logging/log.h>

#include "tflm_anomaly.h"
#include "signal_gen.h"

LOG_MODULE_REGISTER(ai_anomaly, LOG_LEVEL_INF);

#define LED0_NODE DT_ALIAS(led0)
static const struct gpio_dt_spec led = GPIO_DT_SPEC_GET(LED0_NODE, gpios);

int main(void)
{
	signal_gen_init();

	int rc = tflm_anomaly_init();
	if (rc != 0) {
		LOG_ERR("TFLM init failed: %d", rc);
		return rc;
	}
	LOG_INF("ai_anomaly up — try `anomaly score`, `anomaly inject pulse 0.5`, "
		"`anomaly stream on 500`");

	if (!gpio_is_ready_dt(&led)) {
		LOG_WRN("LED not ready, skipping heartbeat");
		return 0;
	}
	gpio_pin_configure_dt(&led, GPIO_OUTPUT_INACTIVE);

	while (1) {
		gpio_pin_toggle_dt(&led);
		k_msleep(1000);
	}
	return 0;
}
```

## src/cmd_anomaly.c
```c
/*
 * Shell command tree: `anomaly ...`
 *
 *   anomaly score                        — generate one window, run inference, print score
 *   anomaly bench [iterations]           — measure inference latency
 *   anomaly state                        — show current injection setting
 *   anomaly inject none|pulse|drift|noise [amplitude]
 *   anomaly stream on|off [period_ms]    — periodic auto-print of score
 *   anomaly threshold [value]            — show / set warning threshold (advisory)
 */

#include <zephyr/kernel.h>
#include <zephyr/shell/shell.h>
#include <zephyr/sys/util.h>
#include <stdlib.h>
#include <string.h>

#include "tflm_anomaly.h"
#include "signal_gen.h"

static float s_threshold = 0.020f;   /* default — tune for the trained model */

/* ---- streaming thread ----------------------------------------------------*/

static struct k_thread s_stream_thr;
static K_THREAD_STACK_DEFINE(s_stream_stack, 2048);
static k_tid_t   s_stream_tid;
static bool      s_stream_on;
static uint32_t  s_stream_period_ms = 1000;
static const struct shell *s_stream_sh;

static void stream_entry(void *a, void *b, void *c)
{
	ARG_UNUSED(a); ARG_UNUSED(b); ARG_UNUSED(c);
	float window[TFLM_ANOMALY_WINDOW];
	float score;

	while (s_stream_on) {
		signal_gen_next(window);
		if (tflm_anomaly_score(window, &score) == 0 && s_stream_sh) {
			const char *flag = (score > s_threshold) ? " ★ ANOMALY" : "";
			shell_print(s_stream_sh, "score %.5f%s",
				    (double)score, flag);
		}
		k_msleep(s_stream_period_ms);
	}
	s_stream_tid = NULL;
}

/* ---- commands ------------------------------------------------------------*/

static int cmd_score(const struct shell *sh, size_t argc, char **argv)
{
	ARG_UNUSED(argc); ARG_UNUSED(argv);
	float window[TFLM_ANOMALY_WINDOW];
	float score;

	signal_gen_next(window);
	int rc = tflm_anomaly_score(window, &score);
	if (rc != 0) {
		shell_error(sh, "inference failed: %d", rc);
		return rc;
	}
	const char *flag = (score > s_threshold) ? " ★ ANOMALY" : "";
	shell_print(sh, "score    : %.5f%s", (double)score, flag);
	shell_print(sh, "threshold: %.5f", (double)s_threshold);
	return 0;
}

static int cmd_bench(const struct shell *sh, size_t argc, char **argv)
{
	uint32_t n = 1000;
	if (argc == 2) {
		n = (uint32_t)strtoul(argv[1], NULL, 10);
		if (n == 0) { n = 1000; }
	}

	float window[TFLM_ANOMALY_WINDOW];
	float score;

	/* warmup */
	for (int i = 0; i < 4; ++i) {
		signal_gen_next(window);
		tflm_anomaly_score(window, &score);
	}

	uint32_t cyc_per_us = sys_clock_hw_cycles_per_sec() / 1000000U;
	uint32_t min_cyc = UINT32_MAX, max_cyc = 0;
	uint64_t total = 0;

	for (uint32_t i = 0; i < n; ++i) {
		signal_gen_next(window);
		uint32_t t0 = k_cycle_get_32();
		tflm_anomaly_score(window, &score);
		uint32_t dt = k_cycle_get_32() - t0;
		total += dt;
		if (dt < min_cyc) { min_cyc = dt; }
		if (dt > max_cyc) { max_cyc = dt; }
	}
	uint32_t avg = (uint32_t)(total / n);
	shell_print(sh, "iterations : %u", n);
	shell_print(sh, "avg        : %u cycles  (%u.%03u us)",
		    avg, avg / cyc_per_us,
		    (avg * 1000U / cyc_per_us) % 1000U);
	shell_print(sh, "min        : %u cycles  (%u.%03u us)",
		    min_cyc, min_cyc / cyc_per_us,
		    (min_cyc * 1000U / cyc_per_us) % 1000U);
	shell_print(sh, "max        : %u cycles  (%u.%03u us)",
		    max_cyc, max_cyc / cyc_per_us,
		    (max_cyc * 1000U / cyc_per_us) % 1000U);
	shell_print(sh, "throughput : ~%u inf/sec",
		    (uint32_t)(sys_clock_hw_cycles_per_sec() / avg));
	return 0;
}

static int cmd_state(const struct shell *sh, size_t argc, char **argv)
{
	ARG_UNUSED(argc); ARG_UNUSED(argv);
	enum injection_kind kind;
	float amp;
	signal_gen_get_injection(&kind, &amp);
	const char *names[] = {"none", "pulse", "drift", "noise"};
	shell_print(sh, "injection: %s  amplitude: %.3f",
		    names[(int)kind], (double)amp);
	shell_print(sh, "threshold: %.5f", (double)s_threshold);
	shell_print(sh, "stream   : %s (period %u ms)",
		    s_stream_on ? "on" : "off", s_stream_period_ms);
	shell_print(sh, "arena    : %u bytes", tflm_anomaly_arena_size());
	return 0;
}

static int cmd_inject(const struct shell *sh, size_t argc, char **argv)
{
	if (argc < 2) {
		shell_error(sh, "usage: anomaly inject none|pulse|drift|noise [amp]");
		return -EINVAL;
	}
	float amp = (argc >= 3) ? strtof(argv[2], NULL) : 0.5f;
	if (!strcmp(argv[1], "none")) {
		signal_gen_set_injection(INJECTION_NONE, 0.0f);
	} else if (!strcmp(argv[1], "pulse")) {
		signal_gen_set_injection(INJECTION_PULSE, amp);
	} else if (!strcmp(argv[1], "drift")) {
		signal_gen_set_injection(INJECTION_DRIFT, amp);
	} else if (!strcmp(argv[1], "noise")) {
		signal_gen_set_injection(INJECTION_NOISE, amp);
	} else {
		shell_error(sh, "unknown injection '%s'", argv[1]);
		return -EINVAL;
	}
	shell_print(sh, "injection set: %s amp=%.3f", argv[1], (double)amp);
	return 0;
}

static int cmd_stream(const struct shell *sh, size_t argc, char **argv)
{
	if (argc < 2) {
		shell_error(sh, "usage: anomaly stream on|off [period_ms]");
		return -EINVAL;
	}
	if (!strcmp(argv[1], "on")) {
		if (s_stream_on) {
			shell_print(sh, "already streaming");
			return 0;
		}
		if (argc >= 3) {
			s_stream_period_ms = (uint32_t)strtoul(argv[2], NULL, 10);
			if (s_stream_period_ms < 50) { s_stream_period_ms = 50; }
		}
		s_stream_sh = sh;
		s_stream_on = true;
		s_stream_tid = k_thread_create(&s_stream_thr, s_stream_stack,
			K_THREAD_STACK_SIZEOF(s_stream_stack),
			stream_entry, NULL, NULL, NULL,
			5, 0, K_NO_WAIT);
		k_thread_name_set(s_stream_tid, "anomaly_stream");
		shell_print(sh, "streaming every %u ms (Ctrl-C... or `anomaly stream off`)",
			    s_stream_period_ms);
	} else if (!strcmp(argv[1], "off")) {
		s_stream_on = false;
		shell_print(sh, "stream stopped");
	} else {
		shell_error(sh, "expected on|off");
		return -EINVAL;
	}
	return 0;
}

static int cmd_threshold(const struct shell *sh, size_t argc, char **argv)
{
	if (argc == 1) {
		shell_print(sh, "threshold: %.5f", (double)s_threshold);
		return 0;
	}
	float v = strtof(argv[1], NULL);
	if (v <= 0.0f) {
		shell_error(sh, "threshold must be > 0");
		return -EINVAL;
	}
	s_threshold = v;
	shell_print(sh, "threshold = %.5f", (double)s_threshold);
	return 0;
}

SHELL_STATIC_SUBCMD_SET_CREATE(sub_anomaly,
	SHELL_CMD(score,     NULL, "Generate one window + score it",          cmd_score),
	SHELL_CMD_ARG(bench, NULL, "Measure inference latency [n]",
		      cmd_bench, 1, 1),
	SHELL_CMD(state,     NULL, "Show current injection / threshold / stream",
		  cmd_state),
	SHELL_CMD_ARG(inject, NULL,
		      "inject none|pulse|drift|noise [amplitude]",
		      cmd_inject, 2, 1),
	SHELL_CMD_ARG(stream, NULL,
		      "stream on|off [period_ms]",
		      cmd_stream, 2, 1),
	SHELL_CMD_ARG(threshold, NULL,
		      "Show or set warning threshold",
		      cmd_threshold, 1, 1),
	SHELL_SUBCMD_SET_END
);

SHELL_CMD_REGISTER(anomaly, &sub_anomaly,
		   "Autoencoder anomaly detection demo", NULL);
```

## src/model.hpp
```c
/* Generated by apps/ai_anomaly/train/train.py — DO NOT EDIT BY HAND */
#ifndef MODEL_HPP
#define MODEL_HPP
extern const unsigned char g_model[];
extern const unsigned int  g_model_len;
#endif
```

## src/signal_gen.c
```c
#include "signal_gen.h"

#include <math.h>
#include <stdlib.h>
#include <zephyr/kernel.h>

#define WINDOW TFLM_ANOMALY_WINDOW

static enum injection_kind s_kind = INJECTION_NONE;
static float               s_amp  = 0.0f;
static struct k_mutex      s_lock;

void signal_gen_init(void)
{
	k_mutex_init(&s_lock);
	srand((unsigned)k_uptime_get());
}

void signal_gen_set_injection(enum injection_kind kind, float amp)
{
	k_mutex_lock(&s_lock, K_FOREVER);
	s_kind = kind;
	s_amp  = amp;
	k_mutex_unlock(&s_lock);
}

void signal_gen_get_injection(enum injection_kind *kind, float *amp)
{
	k_mutex_lock(&s_lock, K_FOREVER);
	if (kind) { *kind = s_kind; }
	if (amp)  { *amp  = s_amp;  }
	k_mutex_unlock(&s_lock);
}

static float frand_pm1(void)
{
	/* uniform in [-1, 1] */
	return ((float)rand() / (float)RAND_MAX) * 2.0f - 1.0f;
}

void signal_gen_next(float *out)
{
	/* Match train.py: sin(2π·1·t + φ1) + 0.3·sin(2π·3·t + φ2) + 0.05·noise
	 * Phase is randomized per call so the AE sees varied normal windows.
	 */
	float phi1 = frand_pm1() * 3.14159265f;
	float phi2 = frand_pm1() * 3.14159265f;
	const float two_pi = 6.28318530f;

	enum injection_kind kind;
	float amp;
	signal_gen_get_injection(&kind, &amp);

	for (int i = 0; i < WINDOW; ++i) {
		float t = (float)i / (float)WINDOW;
		float v = sinf(two_pi * 1.0f * t + phi1)
		        + 0.3f * sinf(two_pi * 3.0f * t + phi2)
		        + 0.05f * frand_pm1();

		switch (kind) {
		case INJECTION_PULSE:
			if (i >= WINDOW / 2 - 1 && i <= WINDOW / 2 + 1) {
				v += amp;
			}
			break;
		case INJECTION_DRIFT:
			v += amp;
			break;
		case INJECTION_NOISE:
			v += amp * frand_pm1();
			break;
		case INJECTION_NONE:
		default:
			break;
		}

		out[i] = v;
	}
}
```

## src/signal_gen.h
```c
/*
 * On-device signal generator + injectable fault state.
 *
 * Used so the demo can run without any external hardware: every cycle we
 * synthesize one 32-sample window of a "normal" signal (matching what the
 * autoencoder was trained on), optionally perturbed by user-set faults
 * issued from shell commands.
 */

#ifndef SIGNAL_GEN_H
#define SIGNAL_GEN_H

#include "tflm_anomaly.h"

#ifdef __cplusplus
extern "C" {
#endif

enum injection_kind {
	INJECTION_NONE  = 0,
	INJECTION_PULSE = 1,   /* 3-sample bump in the middle of the window */
	INJECTION_DRIFT = 2,   /* constant offset across the entire window */
	INJECTION_NOISE = 3,   /* extra random noise on top */
};

void signal_gen_init(void);

/* Generate one window in `out` (length TFLM_ANOMALY_WINDOW). */
void signal_gen_next(float *out);

/* Configure / clear injection. amp is the magnitude (0 disables). */
void signal_gen_set_injection(enum injection_kind kind, float amp);

/* Read back current injection state for the shell `anomaly state` cmd. */
void signal_gen_get_injection(enum injection_kind *kind, float *amp);

#ifdef __cplusplus
}
#endif

#endif
```

## src/tflm_anomaly.cpp
```c
/*
 * Autoencoder inference + reconstruction-error scoring.
 * Model architecture (from train.py): Dense(16→8→4→8→16→32) with ReLU
 * activations; int8-quantized I/O.
 */

#include "tflm_anomaly.h"
#include "model.hpp"

#include <tensorflow/lite/micro/micro_mutable_op_resolver.h>
#include <tensorflow/lite/micro/micro_log.h>
#include <tensorflow/lite/micro/micro_interpreter.h>
#include <tensorflow/lite/micro/system_setup.h>
#include <tensorflow/lite/schema/schema_generated.h>

#include <math.h>
#include <stdint.h>

namespace {

constexpr int kArenaSize = 4 * 1024;       /* generous for a tiny dense model */
alignas(16) uint8_t g_arena[kArenaSize];

const tflite::Model       *s_model       = nullptr;
tflite::MicroInterpreter  *s_interpreter = nullptr;
TfLiteTensor              *s_input       = nullptr;
TfLiteTensor              *s_output      = nullptr;
bool                       s_ready       = false;

}  /* namespace */

extern "C" int tflm_anomaly_init(void)
{
	s_model = tflite::GetModel(::g_model);
	if (s_model->version() != TFLITE_SCHEMA_VERSION) {
		MicroPrintf("model schema %d != supported %d",
			    s_model->version(), TFLITE_SCHEMA_VERSION);
		return -1;
	}

	/* Dense+ReLU networks need FullyConnected + Relu; Keras sometimes
	 * also emits a separate Reshape so we add it just in case.
	 */
	static tflite::MicroMutableOpResolver<3> resolver;
	resolver.AddFullyConnected();
	resolver.AddRelu();
	resolver.AddReshape();

	static tflite::MicroInterpreter interpreter(
		s_model, resolver, g_arena, kArenaSize);
	s_interpreter = &interpreter;

	if (s_interpreter->AllocateTensors() != kTfLiteOk) {
		MicroPrintf("AllocateTensors failed");
		return -2;
	}

	s_input  = s_interpreter->input(0);
	s_output = s_interpreter->output(0);

	if (s_input->dims->data[s_input->dims->size - 1] != TFLM_ANOMALY_WINDOW ||
	    s_output->dims->data[s_output->dims->size - 1] != TFLM_ANOMALY_WINDOW) {
		MicroPrintf("unexpected tensor shape (input/output last dim)");
		return -3;
	}

	s_ready = true;
	return 0;
}

extern "C" int tflm_anomaly_score(const float *window, float *out_score)
{
	if (!s_ready || window == nullptr || out_score == nullptr) {
		return -1;
	}

	const float in_scale = s_input->params.scale;
	const int   in_zp    = s_input->params.zero_point;

	/* float -> int8 quantize into input tensor */
	for (int i = 0; i < TFLM_ANOMALY_WINDOW; ++i) {
		int32_t q = (int32_t)lroundf(window[i] / in_scale) + in_zp;
		if (q < -128) { q = -128; }
		if (q >  127) { q =  127; }
		s_input->data.int8[i] = (int8_t)q;
	}

	if (s_interpreter->Invoke() != kTfLiteOk) {
		return -2;
	}

	const float out_scale = s_output->params.scale;
	const int   out_zp    = s_output->params.zero_point;

	/* int8 -> float dequantize and accumulate squared error vs the input */
	float sse = 0.0f;
	for (int i = 0; i < TFLM_ANOMALY_WINDOW; ++i) {
		float y = (s_output->data.int8[i] - out_zp) * out_scale;
		float diff = window[i] - y;
		sse += diff * diff;
	}
	*out_score = sse / (float)TFLM_ANOMALY_WINDOW;
	return 0;
}

extern "C" uint32_t tflm_anomaly_arena_size(void)
{
	return (uint32_t)kArenaSize;
}
```

## src/tflm_anomaly.h
```c
/*
 * C-callable wrapper around the autoencoder.
 * Implementation in tflm_anomaly.cpp.
 *
 * Usage:
 *   tflm_anomaly_init();
 *   float window[32] = ...;        // signal samples in float
 *   float score;
 *   tflm_anomaly_score(window, &score);   // *score = mean squared reconstruction error
 */

#ifndef TFLM_ANOMALY_H
#define TFLM_ANOMALY_H

#include <stdint.h>

#ifdef __cplusplus
extern "C" {
#endif

#define TFLM_ANOMALY_WINDOW 32

int      tflm_anomaly_init(void);
int      tflm_anomaly_score(const float *window, float *out_score);
uint32_t tflm_anomaly_arena_size(void);

#ifdef __cplusplus
}
#endif

#endif
```
