## CMakeLists.txt
```
cmake_minimum_required(VERSION 3.20.0)
find_package(Zephyr REQUIRED HINTS $ENV{ZEPHYR_BASE})
project(ai_bms_dual_ekf LANGUAGES C)

target_sources(app PRIVATE
    src/main.c
    src/cmd_dekf.c
    src/dual_ekf.c
    src/cycles_db.c
)
```

## prj.conf
```kconfig
CONFIG_REQUIRES_FLOAT_PRINTF=y
CONFIG_FPU=y
CONFIG_MAIN_STACK_SIZE=4096
CONFIG_GPIO=y
CONFIG_LOG=y
CONFIG_LOG_MODE_DEFERRED=y
CONFIG_LOG_BUFFER_SIZE=2048
CONFIG_SHELL=y
CONFIG_SHELL_BACKEND_SERIAL=y
CONFIG_SHELL_PROMPT_UART="g474> "
CONFIG_SHELL_HISTORY=y
CONFIG_SHELL_TAB=y
CONFIG_SHELL_TAB_AUTOCOMPLETION=y
CONFIG_SHELL_STACK_SIZE=4096
CONFIG_KERNEL_SHELL=y
CONFIG_DEVICE_SHELL=y
CONFIG_THREAD_MONITOR=y
CONFIG_THREAD_NAME=y
CONFIG_THREAD_STACK_INFO=y
```

## src/main.c
```c
#include <zephyr/kernel.h>
#include <zephyr/drivers/gpio.h>
#include <zephyr/logging/log.h>

LOG_MODULE_REGISTER(ai_bms_dual_ekf, LOG_LEVEL_INF);

#define LED0_NODE DT_ALIAS(led0)
static const struct gpio_dt_spec led = GPIO_DT_SPEC_GET(LED0_NODE, gpios);

int main(void) {
    LOG_INF("ai_bms_dual_ekf — try `dekf info`, `dekf run`, `dekf table`");
    if (gpio_is_ready_dt(&led)) {
        gpio_pin_configure_dt(&led, GPIO_OUTPUT_INACTIVE);
        while (1) {
            gpio_pin_toggle_dt(&led);
            k_msleep(1000);
        }
    }
    return 0;
}
```

## src/cmd_dekf.c
```c
/*
 * Shell command tree: `dekf ...`
 *
 *   dekf info               — current SOC, Q estimate, SOH, P matrices
 *   dekf reset              — reset both EKFs to fresh-cell defaults
 *   dekf run                — replay all 84 NASA B0005 cycles in order, log Q
 *   dekf cycle <n>          — run only cycle n
 *   dekf table              — print Q_actual vs Q_estimate per cycle (scrolls)
 */

#include <zephyr/kernel.h>
#include <zephyr/shell/shell.h>
#include <zephyr/sys/util.h>
#include <stdlib.h>
#include <string.h>
#include <math.h>

#include "dual_ekf.h"
#include "cycles_db.h"

/* ECM params (literature defaults — copied from ai_bms_soc) */
#define ECM_R0  0.060f
#define ECM_R1  0.025f
#define ECM_C1  2000.0f
#define Q_NOMINAL 1.85f          /* B0005 nominal at start */

static struct dual_ekf g_dekf;
static bool            g_initialized = false;

static void ensure_init(void) {
    if (!g_initialized) {
        dual_ekf_init(&g_dekf, /*soc0=*/100.0f, /*Q=*/Q_NOMINAL,
                      ECM_R0, ECM_R1, ECM_C1);
        g_initialized = true;
    }
}

/* Run one stored cycle through the dual EKF. Uses the cycle's recorded
 * total duration to compute realistic per-step dt for the integrator.
 */
static void run_cycle(const struct cycle_record *c) {
    float dt = c->duration_s / (float)CYCLE_WINDOW;
    for (int k = 0; k < CYCLE_WINDOW; ++k) {
        dual_ekf_step(&g_dekf, c->v[k], c->i[k], dt);
    }
    dual_ekf_end_of_cycle(&g_dekf, /*ended_at=*/0.0f);
    /* Reset SOC for next charge — real BMS sees a charge cycle in between
     * but our test data is discharge-only, so just snap back to 100 %. */
    g_dekf.soc_pct = 100.0f;
    g_dekf.soc_at_cycle_start = 100.0f;
    g_dekf.v_rc = 0.0f;
}

/* ---- commands ---------------------------------------------------------- */

static int cmd_info(const struct shell *sh, size_t a, char **v) {
    ARG_UNUSED(a); ARG_UNUSED(v);
    ensure_init();
    shell_print(sh, "Cell:                B0005 (NASA PCoE)");
    shell_print(sh, "Cycles in database:  %u (every-other from 168)", g_cycle_count);
    shell_print(sh, "Nominal capacity Q0: %.4f Ah", (double)Q_NOMINAL);
    shell_print(sh, "");
    shell_print(sh, "Current dual-EKF state:");
    shell_print(sh, "  SOC          : %.2f %%", (double)dual_ekf_soc(&g_dekf));
    shell_print(sh, "  Q estimate   : %.4f Ah", (double)dual_ekf_capacity(&g_dekf));
    shell_print(sh, "  SOH          : %.1f %% of nominal",
                (double)dual_ekf_soh_pct(&g_dekf, Q_NOMINAL));
    shell_print(sh, "  P_soc        : %.4f", (double)g_dekf.P_soc);
    shell_print(sh, "  P_Q          : %.4f", (double)g_dekf.P_Q);
    return 0;
}

static int cmd_reset(const struct shell *sh, size_t a, char **v) {
    ARG_UNUSED(a); ARG_UNUSED(v);
    dual_ekf_init(&g_dekf, 100.0f, Q_NOMINAL, ECM_R0, ECM_R1, ECM_C1);
    g_initialized = true;
    shell_print(sh, "dual EKF reset to fresh cell (Q=%.4f Ah, SOC=100%%)",
                (double)Q_NOMINAL);
    return 0;
}

static int cmd_run(const struct shell *sh, size_t a, char **v) {
    ARG_UNUSED(a); ARG_UNUSED(v);
    ensure_init();
    shell_print(sh, "Replaying %u cycles…", g_cycle_count);
    shell_print(sh, "  %-6s %-12s %-12s %-12s %s",
                "cycle", "Q_actual", "Q_estim", "error", "SOH");
    for (unsigned i = 0; i < g_cycle_count; ++i) {
        run_cycle(&g_cycles[i]);
        if (i < 5 || i % 10 == 0 || i == g_cycle_count - 1) {
            float qe = dual_ekf_capacity(&g_dekf);
            float qa = g_cycles[i].Q_actual;
            shell_print(sh, "  %-6u %-12.4f %-12.4f %+-12.4f %.1f%%",
                        g_cycles[i].index,
                        (double)qa, (double)qe,
                        (double)(qe - qa),
                        (double)dual_ekf_soh_pct(&g_dekf, Q_NOMINAL));
        }
    }
    shell_print(sh, "");
    shell_print(sh, "Final: Q_estim=%.4f Ah  Q_actual=%.4f Ah  err=%+.4f Ah",
                (double)dual_ekf_capacity(&g_dekf),
                (double)g_cycles[g_cycle_count-1].Q_actual,
                (double)(dual_ekf_capacity(&g_dekf) -
                         g_cycles[g_cycle_count-1].Q_actual));
    return 0;
}

static int cmd_cycle(const struct shell *sh, size_t a, char **v) {
    if (a != 2) { shell_error(sh, "usage: dekf cycle <n>"); return -EINVAL; }
    unsigned n = (unsigned)strtoul(v[1], NULL, 10);
    if (n >= g_cycle_count) {
        shell_error(sh, "cycle %u out of range (0..%u)", n, g_cycle_count-1);
        return -EINVAL;
    }
    ensure_init();
    run_cycle(&g_cycles[n]);
    shell_print(sh, "After cycle %u (real index %u, Q_actual=%.4f Ah):",
                n, g_cycles[n].index, (double)g_cycles[n].Q_actual);
    shell_print(sh, "  Q_estimate = %.4f Ah  (err=%+.4f Ah)",
                (double)dual_ekf_capacity(&g_dekf),
                (double)(dual_ekf_capacity(&g_dekf) - g_cycles[n].Q_actual));
    shell_print(sh, "  SOH        = %.1f %%",
                (double)dual_ekf_soh_pct(&g_dekf, Q_NOMINAL));
    return 0;
}

static int cmd_table(const struct shell *sh, size_t a, char **v) {
    ARG_UNUSED(a); ARG_UNUSED(v);
    /* Re-run from fresh cell, log every cycle (warning: ~84 lines). */
    dual_ekf_init(&g_dekf, 100.0f, Q_NOMINAL, ECM_R0, ECM_R1, ECM_C1);
    shell_print(sh, "  %-6s %-12s %-12s %-12s",
                "cycle", "Q_actual", "Q_estim", "error");
    for (unsigned i = 0; i < g_cycle_count; ++i) {
        run_cycle(&g_cycles[i]);
        shell_print(sh, "  %-6u %-12.4f %-12.4f %+-12.4f",
                    g_cycles[i].index,
                    (double)g_cycles[i].Q_actual,
                    (double)dual_ekf_capacity(&g_dekf),
                    (double)(dual_ekf_capacity(&g_dekf) - g_cycles[i].Q_actual));
    }
    return 0;
}

SHELL_STATIC_SUBCMD_SET_CREATE(sub_dekf,
    SHELL_CMD(info,  NULL, "Show current dual-EKF state",       cmd_info),
    SHELL_CMD(reset, NULL, "Reset to fresh cell defaults",      cmd_reset),
    SHELL_CMD(run,   NULL, "Replay all cycles, summary log",    cmd_run),
    SHELL_CMD_ARG(cycle, NULL, "Run one cycle: dekf cycle <n>", cmd_cycle, 2, 0),
    SHELL_CMD(table, NULL, "Per-cycle Q_actual vs Q_estimate",  cmd_table),
    SHELL_SUBCMD_SET_END
);

SHELL_CMD_REGISTER(dekf, &sub_dekf,
                   "Dual EKF — SOC + capacity tracking demo", NULL);
```

## src/cycles_db.h
```c
/* Generated — DO NOT EDIT */
#ifndef CYCLES_DB_H
#define CYCLES_DB_H

#define CYCLE_WINDOW 32

#ifdef __cplusplus
extern "C" {
#endif

struct cycle_record {
    unsigned int index;       /* 0..n original cycle number in B0005 */
    float        duration_s;
    float        Q_actual;    /* Ah measured by the lab — ground truth */
    float        v[CYCLE_WINDOW];
    float        i[CYCLE_WINDOW];
    float        T[CYCLE_WINDOW];
};

extern const unsigned int        g_cycle_count;
extern const struct cycle_record g_cycles[];

#ifdef __cplusplus
}
#endif
#endif
```

## src/dual_ekf.c
```c
#include "dual_ekf.h"

#include <math.h>
#include <string.h>

/* SOC-OCV table from training data — copied from ai_bms_soc.
 * (Hardcoded for the demo since we only have one cell to track.)
 */
static const float OCV_SOC[21] = {
     0.00f,  5.00f, 10.00f, 15.00f, 20.00f, 25.00f, 30.00f,
    35.00f, 40.00f, 45.00f, 50.00f, 55.00f, 60.00f, 65.00f,
    70.00f, 75.00f, 80.00f, 85.00f, 90.00f, 95.00f, 100.00f,
};
static const float OCV_V[21] = {
    3.355f, 3.501f, 3.583f, 3.620f, 3.643f, 3.660f, 3.677f,
    3.694f, 3.712f, 3.732f, 3.755f, 3.781f, 3.812f, 3.847f,
    3.886f, 3.929f, 3.978f, 4.033f, 4.094f, 4.156f, 4.193f,
};

static float ocv_at_soc(float soc) {
    if (soc <= OCV_SOC[0])  return OCV_V[0];
    for (int i = 1; i < 21; ++i) {
        if (soc <= OCV_SOC[i]) {
            float a = (soc - OCV_SOC[i-1]) / (OCV_SOC[i] - OCV_SOC[i-1]);
            return OCV_V[i-1] + a * (OCV_V[i] - OCV_V[i-1]);
        }
    }
    return OCV_V[20];
}

static float docv_dsoc(float soc) {
    const float h = 0.5f;
    return (ocv_at_soc(soc + h) - ocv_at_soc(soc - h)) / (2.0f * h);
}

void dual_ekf_init(struct dual_ekf *e, float soc0, float Q_initial,
                   float R0, float R1, float C1)
{
    e->soc_pct = soc0;
    e->v_rc = 0.0f;
    e->P_soc = 1.0f;
    e->P_vrc = 0.01f;
    e->Q_estimate_ah = Q_initial;
    e->P_Q = 0.05f;
    e->ah_passed_in_cycle = 0.0f;
    e->soc_at_cycle_start = soc0;
    e->R0 = R0;
    e->R1 = R1;
    e->C1 = C1;
}

void dual_ekf_step(struct dual_ekf *e, float v_meas, float i_a, float dt_s)
{
    /* --- accumulate Ah for slow EKF --- */
    e->ah_passed_in_cycle += fabsf(i_a) * dt_s / 3600.0f;

    /* --- fast EKF: predict --- */
    /* SOC[%] += (i * dt / 3600 / Q) * 100  ;  i<0 discharge → SOC down */
    float dSOC = i_a * dt_s / (e->Q_estimate_ah * 36.0f);
    float a    = 1.0f - dt_s / (e->R1 * e->C1);
    if (a < 0.0f) a = 0.0f;
    float soc_pred = e->soc_pct + dSOC;
    float vrc_pred = a * e->v_rc + (dt_s / e->C1) * i_a;

    /* P_pred (diagonal approximation — full 2x2 wasn't worth the math given
     * the small cross-terms after the OCV linearization) */
    float P_soc_pred = e->P_soc + 0.001f;       /* Q_proc_soc */
    float P_vrc_pred = a*a*e->P_vrc + 0.0001f;  /* Q_proc_vrc */

    /* --- fast EKF: update with V measurement --- */
    float ocv     = ocv_at_soc(soc_pred);
    float h_dsoc  = docv_dsoc(soc_pred);
    float z_pred  = ocv - i_a * e->R0 - vrc_pred;
    float innov   = v_meas - z_pred;

    /* Innovation covariance (ignoring cross-cov) */
    float Rmeas = 0.01f;
    float S = h_dsoc*h_dsoc*P_soc_pred + P_vrc_pred + Rmeas;
    float K_soc = (P_soc_pred * h_dsoc) / S;
    float K_vrc = (-P_vrc_pred)         / S;

    e->soc_pct = soc_pred + K_soc * innov;
    e->v_rc    = vrc_pred + K_vrc * innov;
    e->P_soc   = (1.0f - K_soc * h_dsoc) * P_soc_pred;
    e->P_vrc   = (1.0f - K_vrc * (-1.0f)) * P_vrc_pred;
    if (e->P_soc < 1e-6f) e->P_soc = 1e-6f;
    if (e->P_vrc < 1e-6f) e->P_vrc = 1e-6f;

    /* clip SOC */
    if (e->soc_pct < 0.0f)   e->soc_pct = 0.0f;
    if (e->soc_pct > 100.0f) e->soc_pct = 100.0f;
}

void dual_ekf_end_of_cycle(struct dual_ekf *e, float cycle_ended_at_soc)
{
    /* Slow EKF measurement: predicted_Ah = (SOC_start - SOC_end) * Q / 100
     * observed_Ah = e->ah_passed_in_cycle
     * If predicted < observed → Q_estimate is too low → bump it up.
     * If predicted > observed → Q_estimate is too high → bump it down.
     */
    float dSOC = e->soc_at_cycle_start - cycle_ended_at_soc;
    if (dSOC < 5.0f) {
        /* Skip cycles too short to give us a reliable Q signal. */
        e->ah_passed_in_cycle = 0.0f;
        e->soc_at_cycle_start = e->soc_pct;
        return;
    }
    float predicted_Ah = (dSOC / 100.0f) * e->Q_estimate_ah;
    float innov = e->ah_passed_in_cycle - predicted_Ah;

    /* H = dSOC/100 (sensitivity of predicted Ah to Q) */
    float H = dSOC / 100.0f;
    float Rmeas_Q = 0.005f;            /* 5 mAh measurement noise */
    float Q_proc  = 0.0001f;           /* Q drifts ~mAh/cycle */
    float P_pred = e->P_Q + Q_proc;
    float S = H*H*P_pred + Rmeas_Q;
    float K = (P_pred * H) / S;

    e->Q_estimate_ah += K * innov;
    e->P_Q = (1.0f - K * H) * P_pred;
    if (e->P_Q < 1e-6f) e->P_Q = 1e-6f;
    /* Sanity clip — capacity can't grow with use */
    if (e->Q_estimate_ah < 0.5f)  e->Q_estimate_ah = 0.5f;
    if (e->Q_estimate_ah > 3.0f)  e->Q_estimate_ah = 3.0f;

    /* Reset per-cycle integrator */
    e->ah_passed_in_cycle = 0.0f;
    e->soc_at_cycle_start = e->soc_pct;
}

float dual_ekf_soc(const struct dual_ekf *e)      { return e->soc_pct; }
float dual_ekf_capacity(const struct dual_ekf *e) { return e->Q_estimate_ah; }
float dual_ekf_soh_pct(const struct dual_ekf *e, float Q_nominal) {
    return 100.0f * e->Q_estimate_ah / Q_nominal;
}
```

## src/dual_ekf.h
```c
/*
 * Dual Extended Kalman Filter — SOC + Q (capacity) co-estimation.
 *
 * Two coupled estimators:
 *   - FAST EKF (run every step):  state = [SOC, V_RC]
 *   - SLOW EKF (run every cycle): state = [Q]   (capacity tracker)
 *
 * Coupling: the SLOW EKF's measurement is the actual ampere-hours
 * delivered during a full discharge cycle. We compare it against the
 * predicted Ah (= ΔSOC × Q_estimate / 100) and update Q accordingly.
 *
 * After many cycles, Q_estimate converges to the cell's true degraded
 * capacity, and the FAST EKF's SOC accuracy stops drifting because it's
 * now using the right denominator.
 */

#ifndef DUAL_EKF_H
#define DUAL_EKF_H

#include <stdint.h>

#ifdef __cplusplus
extern "C" {
#endif

struct dual_ekf {
    /* Fast EKF state */
    float soc_pct;            /* %  */
    float v_rc;               /* V  */
    float P_soc;              /* covariance, SOC channel */
    float P_vrc;
    /* Slow EKF state */
    float Q_estimate_ah;      /* current capacity estimate */
    float P_Q;                /* covariance on Q */
    /* Per-cycle integrator */
    float ah_passed_in_cycle; /* Ah accumulated since last reset */
    float soc_at_cycle_start;
    /* ECM params (passed in at init) */
    float R0, R1, C1;
};

void dual_ekf_init(struct dual_ekf *e, float soc0, float Q_initial,
                   float R0, float R1, float C1);

/* Per-sample step (call at 100 Hz / 1 kHz). */
void dual_ekf_step(struct dual_ekf *e, float v_meas, float i_a, float dt_s);

/* Mark the end of a full discharge cycle.
 *  - true_ah_delivered: how many Ah actually came out (measured by us, the
 *    integration of |i|*dt over the cycle).
 *  - cycle_ended_at_soc: typically 0 % (full discharge to cutoff).
 *  - Updates Q_estimate based on the discrepancy between observed Ah and
 *    predicted (ΔSOC × Q_estimate / 100).
 */
void dual_ekf_end_of_cycle(struct dual_ekf *e, float cycle_ended_at_soc);

/* Read-only accessors. */
float dual_ekf_soc(const struct dual_ekf *e);
float dual_ekf_capacity(const struct dual_ekf *e);
float dual_ekf_soh_pct(const struct dual_ekf *e, float Q_nominal);

#ifdef __cplusplus
}
#endif
#endif
```
