## CMakeLists.txt
```
cmake_minimum_required(VERSION 3.20.0)
find_package(Zephyr REQUIRED HINTS $ENV{ZEPHYR_BASE})
project(ai_bms_safety LANGUAGES C)

target_sources(app PRIVATE
    src/main.c
    src/cell_state.c
    src/safety_thread.c
    src/ml_thread.c
    src/cmd_safety.c
)
```

## prj.conf
```kconfig
CONFIG_REQUIRES_FLOAT_PRINTF=y
CONFIG_FPU=y
CONFIG_MAIN_STACK_SIZE=4096

CONFIG_GPIO=y
CONFIG_LOG=y
CONFIG_LOG_MODE_DEFERRED=y
CONFIG_LOG_BUFFER_SIZE=4096

CONFIG_SHELL=y
CONFIG_SHELL_BACKEND_SERIAL=y
CONFIG_SHELL_PROMPT_UART="g474> "
CONFIG_SHELL_HISTORY=y
CONFIG_SHELL_TAB=y
CONFIG_SHELL_TAB_AUTOCOMPLETION=y
CONFIG_SHELL_STACK_SIZE=4096

CONFIG_KERNEL_SHELL=y
CONFIG_DEVICE_SHELL=y
CONFIG_THREAD_MONITOR=y
CONFIG_THREAD_NAME=y
CONFIG_THREAD_STACK_INFO=y
CONFIG_INIT_STACKS=y

# Enable spinlock for the shared snapshot
CONFIG_SPIN_VALIDATE=n
```

## src/main.c
```c
#include <zephyr/kernel.h>
#include <zephyr/drivers/gpio.h>
#include <zephyr/logging/log.h>

#include "cell_state.h"

LOG_MODULE_REGISTER(ai_bms_safety, LOG_LEVEL_INF);

extern void safety_thread_start(void);
extern void ml_thread_start(void);

#define LED0_NODE DT_ALIAS(led0)
static const struct gpio_dt_spec led = GPIO_DT_SPEC_GET(LED0_NODE, gpios);

int main(void) {
    /* Initialize a healthy snapshot so the safety thread doesn't trip
     * on uninitialized zeros (which would look like 0V undervoltage). */
    struct cell_snapshot init = {
        .v = {3.85f, 3.85f, 3.85f, 3.85f},
        .i_pack = -1.0f,
        .t_max = 25.0f,
        .timestamp_ms = k_uptime_get(),
    };
    cell_state_set(&init);

    safety_thread_start();
    ml_thread_start();

    LOG_INF("ai_bms_safety up — try `safety scenario 4` then `safety status`");
    LOG_INF("Threads: safety @ priority 2 (100 Hz), ml @ priority 10 (10 Hz)");

    if (gpio_is_ready_dt(&led)) {
        gpio_pin_configure_dt(&led, GPIO_OUTPUT_INACTIVE);
        while (1) {
            gpio_pin_toggle_dt(&led);
            k_msleep(1000);
        }
    }
    return 0;
}
```

## src/cell_state.c
```c
#include "cell_state.h"

#include <zephyr/kernel.h>
#include <string.h>

static struct cell_snapshot g_snap;
static struct status_flags  g_flags;
static struct k_spinlock    g_lock;

void cell_state_set(const struct cell_snapshot *s) {
    k_spinlock_key_t k = k_spin_lock(&g_lock);
    g_snap = *s;
    k_spin_unlock(&g_lock, k);
}

void cell_state_get(struct cell_snapshot *out) {
    k_spinlock_key_t k = k_spin_lock(&g_lock);
    *out = g_snap;
    k_spin_unlock(&g_lock, k);
}

void status_flags_get(struct status_flags *out) {
    k_spinlock_key_t k = k_spin_lock(&g_lock);
    *out = g_flags;
    k_spin_unlock(&g_lock, k);
}

/* internal — used by safety/ml threads to publish */
void status_flags_set(const struct status_flags *new_flags) {
    k_spinlock_key_t k = k_spin_lock(&g_lock);
    g_flags = *new_flags;
    k_spin_unlock(&g_lock, k);
}
```

## src/cell_state.h
```c
/*
 * Shared cell state — what both threads (safety + ML) read.
 * Updated by the shell command that simulates ADC samples.
 *
 * In a real system this would be filled by the ADC ISR via DMA into a
 * lock-free ring buffer. For the demo we just have one global atomic-ish
 * snapshot updated by `cell sim`.
 */

#ifndef CELL_STATE_H
#define CELL_STATE_H

#include <stdint.h>
#include <stdbool.h>

#ifdef __cplusplus
extern "C" {
#endif

#define N_CELLS 4

struct cell_snapshot {
    float v[N_CELLS];          /* per-cell voltage (V) */
    float i_pack;              /* pack current (A), discharge negative */
    float t_max;               /* hottest cell temperature (°C) */
    uint64_t timestamp_ms;
};

/* Hard-rule trip thresholds. UL/IEC certified equivalent — these would
 * come from compliance docs in a real product. */
#define TRIP_V_OVER       4.25f   /* per-cell over-voltage */
#define TRIP_V_UNDER      2.50f   /* per-cell under-voltage */
#define TRIP_I_OVER       150.0f  /* pack over-current (|A|) */
#define TRIP_T_OVER       65.0f   /* over-temperature (°C) */

/* ML advisory thresholds — much tighter than hard rules. */
#define ADVISORY_V_DRIFT  0.05f   /* cell-to-cell voltage spread that triggers ML check */
#define ADVISORY_T_RATE   2.0f    /* °C/min: not yet a hard trip but worth watching */

/* Read/write the shared snapshot. */
void cell_state_set(const struct cell_snapshot *s);
void cell_state_get(struct cell_snapshot *out);

/* Trip / advisory state for inspection. */
struct status_flags {
    /* Layer 1: hard rule. If any of these is set, contactor should be open. */
    bool trip_ov;
    bool trip_uv;
    bool trip_oc;
    bool trip_ot;
    /* Layer 2: ML advisory. Logged but never opens the contactor on its own. */
    bool advisory_imbalance;
    bool advisory_thermal_trend;
    bool advisory_anomaly;
    /* counters */
    uint32_t safety_iters;
    uint32_t ml_iters;
    /* last measured ML "anomaly score" (synthetic for the demo) */
    float    last_anomaly_score;
};

void status_flags_get(struct status_flags *out);

#ifdef __cplusplus
}
#endif
#endif
```

## src/cmd_safety.c
```c
/*
 * Shell tree: `cell` (input) + `safety` (output)
 *
 *   cell sim <c0> <c1> <c2> <c3> <i> <t_max>   — set the simulated snapshot
 *   cell show                                    — read back the snapshot
 *
 *   safety status                                — flags from both threads
 *   safety reset                                 — clear all trip flags
 *   safety scenario <n>                          — run a canned scenario
 *
 * Available scenarios:
 *   1 = healthy operation
 *   2 = mild cell imbalance (advisory only, no hard trip)
 *   3 = thermal rise (advisory only)
 *   4 = single-cell over-voltage (HARD TRIP)
 *   5 = pack over-current (HARD TRIP)
 *   6 = combined trend + trip (advisory fires AHEAD of hard trip)
 */

#include <zephyr/kernel.h>
#include <zephyr/shell/shell.h>
#include <zephyr/sys/util.h>
#include <stdlib.h>
#include <string.h>

#include "cell_state.h"

extern void status_flags_set(const struct status_flags *);

static int cmd_sim(const struct shell *sh, size_t a, char **v) {
    if (a != 7) {
        shell_error(sh, "usage: cell sim <c0> <c1> <c2> <c3> <i> <t_max>");
        return -EINVAL;
    }
    struct cell_snapshot s;
    s.v[0] = strtof(v[1], NULL);
    s.v[1] = strtof(v[2], NULL);
    s.v[2] = strtof(v[3], NULL);
    s.v[3] = strtof(v[4], NULL);
    s.i_pack = strtof(v[5], NULL);
    s.t_max = strtof(v[6], NULL);
    s.timestamp_ms = k_uptime_get();
    cell_state_set(&s);
    shell_print(sh, "snapshot set");
    return 0;
}

static int cmd_show(const struct shell *sh, size_t a, char **v) {
    ARG_UNUSED(a); ARG_UNUSED(v);
    struct cell_snapshot s;
    cell_state_get(&s);
    shell_print(sh, "Cell V: %.3f %.3f %.3f %.3f V",
                (double)s.v[0], (double)s.v[1], (double)s.v[2], (double)s.v[3]);
    shell_print(sh, "Pack I: %.2f A", (double)s.i_pack);
    shell_print(sh, "T_max : %.1f °C", (double)s.t_max);
    return 0;
}

static int cmd_status(const struct shell *sh, size_t a, char **v) {
    ARG_UNUSED(a); ARG_UNUSED(v);
    struct status_flags f;
    status_flags_get(&f);
    shell_print(sh, "Layer 1 (HARD RULES — would open contactor):");
    shell_print(sh, "  trip_ov : %s", f.trip_ov ? "YES ★" : "no");
    shell_print(sh, "  trip_uv : %s", f.trip_uv ? "YES ★" : "no");
    shell_print(sh, "  trip_oc : %s", f.trip_oc ? "YES ★" : "no");
    shell_print(sh, "  trip_ot : %s", f.trip_ot ? "YES ★" : "no");
    shell_print(sh, "");
    shell_print(sh, "Layer 2 (ML ADVISORY — log only, no contactor action):");
    shell_print(sh, "  advisory_imbalance      : %s", f.advisory_imbalance ? "YES" : "no");
    shell_print(sh, "  advisory_thermal_trend  : %s", f.advisory_thermal_trend ? "YES" : "no");
    shell_print(sh, "  advisory_anomaly        : %s", f.advisory_anomaly ? "YES" : "no");
    shell_print(sh, "  anomaly_score           : %.4f", (double)f.last_anomaly_score);
    shell_print(sh, "");
    shell_print(sh, "Iters: safety=%u, ml=%u  (separation = %.0f×)",
                f.safety_iters, f.ml_iters,
                (double)((f.ml_iters > 0) ? (float)f.safety_iters / f.ml_iters : 0.0f));
    return 0;
}

static int cmd_reset(const struct shell *sh, size_t a, char **v) {
    ARG_UNUSED(a); ARG_UNUSED(v);
    struct status_flags f = {0};
    status_flags_set(&f);
    shell_print(sh, "all flags + counters cleared");
    return 0;
}

static int cmd_scenario(const struct shell *sh, size_t a, char **v) {
    if (a != 2) { shell_error(sh, "usage: safety scenario <1..6>"); return -EINVAL; }
    int n = atoi(v[1]);
    struct cell_snapshot s = {0};
    s.timestamp_ms = k_uptime_get();
    const char *desc = "?";

    switch (n) {
    case 1:
        s.v[0] = 3.85f; s.v[1] = 3.86f; s.v[2] = 3.85f; s.v[3] = 3.84f;
        s.i_pack = -1.5f; s.t_max = 28.0f;
        desc = "healthy 50%% SOC discharge";
        break;
    case 2:
        s.v[0] = 3.85f; s.v[1] = 3.84f; s.v[2] = 3.85f; s.v[3] = 3.78f;  /* cell 3 sagging */
        s.i_pack = -1.5f; s.t_max = 30.0f;
        desc = "mild cell imbalance (cell 3 sagging) — advisory only";
        break;
    case 3:
        s.v[0] = 3.95f; s.v[1] = 3.95f; s.v[2] = 3.95f; s.v[3] = 3.94f;
        s.i_pack = -8.0f; s.t_max = 48.0f;
        desc = "thermal rising under heavy current — advisory only";
        break;
    case 4:
        s.v[0] = 3.85f; s.v[1] = 3.85f; s.v[2] = 4.31f; s.v[3] = 3.85f;  /* cell 2 OV */
        s.i_pack = +1.0f; s.t_max = 35.0f;
        desc = "cell 2 over-voltage 4.31 V — HARD TRIP expected";
        break;
    case 5:
        s.v[0] = 3.50f; s.v[1] = 3.51f; s.v[2] = 3.51f; s.v[3] = 3.50f;
        s.i_pack = -180.0f; s.t_max = 40.0f;                              /* huge discharge */
        desc = "pack over-current 180 A — HARD TRIP expected";
        break;
    case 6:
        s.v[0] = 4.18f; s.v[1] = 4.20f; s.v[2] = 4.19f; s.v[3] = 4.06f;  /* mild imbalance */
        s.i_pack = -3.0f; s.t_max = 52.0f;
        desc = "trend rising — ML advisory but no hard trip yet";
        break;
    default:
        shell_error(sh, "scenario must be 1..6");
        return -EINVAL;
    }
    cell_state_set(&s);
    shell_print(sh, "Scenario %d: %s", n, desc);
    shell_print(sh, "Wait ~200 ms for both threads to evaluate, then `safety status`");
    return 0;
}

SHELL_STATIC_SUBCMD_SET_CREATE(sub_cell,
    SHELL_CMD_ARG(sim,  NULL, "cell sim <c0..c3> <i> <t_max>",
                  cmd_sim, 7, 0),
    SHELL_CMD(show, NULL, "Read current cell snapshot", cmd_show),
    SHELL_SUBCMD_SET_END
);
SHELL_CMD_REGISTER(cell, &sub_cell, "Simulated cell front-end", NULL);

SHELL_STATIC_SUBCMD_SET_CREATE(sub_safety,
    SHELL_CMD(status, NULL, "Show trip + advisory flags", cmd_status),
    SHELL_CMD(reset,  NULL, "Clear all flags + counters", cmd_reset),
    SHELL_CMD_ARG(scenario, NULL, "safety scenario <1..6>",
                  cmd_scenario, 2, 0),
    SHELL_SUBCMD_SET_END
);
SHELL_CMD_REGISTER(safety, &sub_safety,
                   "Layer 1/2 BMS safety architecture demo", NULL);
```

## src/ml_thread.c
```c
/*
 * Layer 2: ML advisory thread.
 *
 * Lower priority than safety. May be preempted, may even crash, must
 * never affect Layer 1's behavior. Evaluates trends and patterns the
 * hard rules can't catch:
 *   - cell-to-cell voltage imbalance (early warning of one bad cell)
 *   - thermal rise rate (catch cooling-system degradation before T_max trips)
 *   - anomaly score from the ai_bms autoencoder pattern (synthesized here
 *     since we don't carry the full TFLM stack into this demo)
 *
 * Outputs: `advisory_*` flags + a numeric anomaly score. NEVER opens
 * the contactor.
 */

#include "cell_state.h"

#include <zephyr/kernel.h>
#include <zephyr/logging/log.h>
#include <math.h>

LOG_MODULE_REGISTER(ml, LOG_LEVEL_INF);

extern void status_flags_set(const struct status_flags *);

#define STACK_SIZE   2048
#define PRIORITY     10    /* well below safety; can be preempted */

static K_THREAD_STACK_DEFINE(ml_stack, STACK_SIZE);
static struct k_thread ml_tid;

static float prev_t_max = 25.0f;
static uint64_t prev_t_ms = 0;

static void ml_loop(void *a, void *b, void *c) {
    ARG_UNUSED(a); ARG_UNUSED(b); ARG_UNUSED(c);
    while (1) {
        struct cell_snapshot s;
        cell_state_get(&s);

        struct status_flags out;
        status_flags_get(&out);
        out.ml_iters++;
        out.advisory_imbalance = false;
        out.advisory_thermal_trend = false;
        out.advisory_anomaly = false;

        /* --- Cell imbalance check --- */
        float vmax = s.v[0], vmin = s.v[0];
        for (int c = 1; c < N_CELLS; ++c) {
            if (s.v[c] > vmax) vmax = s.v[c];
            if (s.v[c] < vmin) vmin = s.v[c];
        }
        float spread = vmax - vmin;
        if (spread > ADVISORY_V_DRIFT) {
            out.advisory_imbalance = true;
        }

        /* --- Thermal rise rate (°C/min) --- */
        if (prev_t_ms > 0 && s.timestamp_ms > prev_t_ms) {
            float dt_min = (s.timestamp_ms - prev_t_ms) / 60000.0f;
            float dT = s.t_max - prev_t_max;
            if (dt_min > 0 && (dT / dt_min) > ADVISORY_T_RATE) {
                out.advisory_thermal_trend = true;
            }
        }
        prev_t_max = s.t_max;
        prev_t_ms = s.timestamp_ms;

        /* --- Synthetic "anomaly score" --- pretend this is the AE output.
         * In production, this thread would call the same TFLM glue we use
         * in apps/ai_bms. We just compute a simple stand-in: a weighted
         * sum of how far we are from "comfortable" operating envelope.
         */
        float score = 0.0f;
        score += spread * 4.0f;                                    /* imbalance */
        score += fmaxf(0.0f, s.t_max - 35.0f) * 0.05f;             /* warm operation */
        score += fmaxf(0.0f, fabsf(s.i_pack) - 50.0f) * 0.005f;    /* heavy current */
        for (int c = 0; c < N_CELLS; ++c) {
            score += fmaxf(0.0f, s.v[c] - 4.10f) * 2.0f;           /* near OV */
            score += fmaxf(0.0f, 2.80f - s.v[c]) * 2.0f;           /* near UV */
        }
        out.last_anomaly_score = score;
        if (score > 0.25f) {
            out.advisory_anomaly = true;
        }

        status_flags_set(&out);
        k_msleep(100);   /* 10 Hz — much slower than safety */
    }
}

void ml_thread_start(void) {
    k_thread_create(&ml_tid, ml_stack, STACK_SIZE,
                    ml_loop, NULL, NULL, NULL,
                    PRIORITY, 0, K_NO_WAIT);
    k_thread_name_set(&ml_tid, "ml_advisory");
}
```

## src/safety_thread.c
```c
/*
 * Layer 1: Safety thread.
 *
 * Highest priority, runs at 100 Hz, evaluates hard-rule trip conditions
 * only. Never makes a soft / probabilistic decision. Never blocks on the
 * ML side. If this thread's deadline is missed, watchdog should reset
 * the MCU.
 *
 * In production this thread would:
 *   - own the contactor GPIO
 *   - run from CCMRAM (deterministic, no flash-wait jitter)
 *   - be monitored by an independent task watchdog
 *   - have its own stack/heap (MPU isolated from ML region)
 */

#include "cell_state.h"

#include <zephyr/kernel.h>
#include <zephyr/logging/log.h>
#include <math.h>

LOG_MODULE_REGISTER(safety, LOG_LEVEL_INF);

extern void status_flags_set(const struct status_flags *);

#define STACK_SIZE   1024
#define PRIORITY     2     /* very high; below kernel-internal threads only */

static K_THREAD_STACK_DEFINE(safety_stack, STACK_SIZE);
static struct k_thread safety_tid;

static void safety_loop(void *a, void *b, void *c) {
    ARG_UNUSED(a); ARG_UNUSED(b); ARG_UNUSED(c);
    struct status_flags out = {0};
    while (1) {
        struct cell_snapshot s;
        cell_state_get(&s);

        struct status_flags prev;
        status_flags_get(&prev);
        out = prev;
        out.safety_iters++;

        /* Hard rules — every condition is a single comparison. Auditable.
         * NB: we OR rather than reset trips so the operator sees them
         * until the demo issues `safety reset`.
         */
        for (int c = 0; c < N_CELLS; ++c) {
            if (s.v[c] > TRIP_V_OVER && !out.trip_ov) {
                out.trip_ov = true;
                LOG_WRN("★ HARD TRIP: cell %d V=%.3f > %.3f (OV)",
                        c, (double)s.v[c], (double)TRIP_V_OVER);
            }
            if (s.v[c] < TRIP_V_UNDER && !out.trip_uv) {
                out.trip_uv = true;
                LOG_WRN("★ HARD TRIP: cell %d V=%.3f < %.3f (UV)",
                        c, (double)s.v[c], (double)TRIP_V_UNDER);
            }
        }
        if (fabsf(s.i_pack) > TRIP_I_OVER && !out.trip_oc) {
            out.trip_oc = true;
            LOG_WRN("★ HARD TRIP: I=%.1f > %.1f (OC)",
                    (double)s.i_pack, (double)TRIP_I_OVER);
        }
        if (s.t_max > TRIP_T_OVER && !out.trip_ot) {
            out.trip_ot = true;
            LOG_WRN("★ HARD TRIP: T=%.1f > %.1f (OT)",
                    (double)s.t_max, (double)TRIP_T_OVER);
        }
        status_flags_set(&out);

        /* Real product: open contactor if any trip; here we just log. */
        k_msleep(10);  /* 100 Hz */
    }
}

void safety_thread_start(void) {
    k_thread_create(&safety_tid, safety_stack, STACK_SIZE,
                    safety_loop, NULL, NULL, NULL,
                    PRIORITY, 0, K_NO_WAIT);
    k_thread_name_set(&safety_tid, "safety");
}
```
